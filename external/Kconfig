## external/Kconfig
```kconfig
menu "Third party packages"

source "$SIFLI_SDK/external/CmBacktrace-v1.3.0/Kconfig"
source "$SIFLI_SDK/external/CMSIS/Kconfig"
source "$SIFLI_SDK/external/coremark/Kconfig"
source "$SIFLI_SDK/external/FlashDB/Kconfig"
source "$SIFLI_SDK/external/freetype/Kconfig"
source "$SIFLI_SDK/external/libhelix-mp3/Kconfig"
source "$SIFLI_SDK/external/lvgl_v8/Kconfig"
source "$SIFLI_SDK/external/lz4/Kconfig"
source "$SIFLI_SDK/external/mbedtls/Kconfig"
source "$SIFLI_SDK/external/nanopb/Kconfig"
source "$SIFLI_SDK/external/opus-1.4/Kconfig"
source "$SIFLI_SDK/external/quickjs/Kconfig"
source "$SIFLI_SDK/external/rlottie/Kconfig"
source "$SIFLI_SDK/external/rpmsg-lite/Kconfig"
source "$SIFLI_SDK/external/SEGGER_SystemView-master/Kconfig"
source "$SIFLI_SDK/external/sensor-lib/Kconfig"
source "$SIFLI_SDK/external/WebRTC_audio_processing/Kconfig"
source "$SIFLI_SDK/external/tinymp3/Kconfig"
source "$SIFLI_SDK/external/fsck/Kconfig"
source "$SIFLI_SDK/external/state_machine-latest/Kconfig"
source "$SIFLI_SDK/external/cJSON-1.7.17/Kconfig"
source "$SIFLI_SDK/external/webclient/Kconfig"

config PKG_SCHRIFT
    bool "SCHRIFT Library"
    default n

endmenu
```

## external/WebRTC_audio_processing/Kconfig
```kconfig
# Kconfig file for package WebRTC
menuconfig PKG_USING_WEBRTC
     bool "WebRTC: The real-time speech enhancement processing"
     default n

if PKG_USING_WEBRTC
    choice
        prompt "Select noise suppression Type"
        default WEBRTC_ANS_FIX
        config WEBRTC_ANS_FIX
            bool "fix point ns"           
        config WEBRTC_ANS_FLOAT
            bool "float point ns"
        config WEBRTC_ANS_NULL
            bool "close ns"
    endchoice 
    config WEBRTC_ANS_DEMO
        bool
        prompt "WebRTC noise suppression test demo"
        default n
    config WEBRTC_AGC_FIX
        bool
        prompt "WebRTC auto gain control"
        default n
    config WEBRTC_AGC_DEMO
        bool
        prompt "WebRTC auto gain control test demo"
        default n
    choice
        prompt "Select echo cancellation Type"
        default WEBRTC_AEC_NULL
        config WEBRTC_AEC
            bool "float point AEC"           
        config WEBRTC_AECM
            bool "fix point AECM"
        config WEBRTC_AEC_NULL
            bool "close echo cancellation"
    endchoice 
    config WEBRTC_AEC_DEMO
        bool
        prompt "WebRTC echo cancellation test demo"
        default n
    choice
        prompt "Select FFT/IFFT Type"
        default FFT_USING_WEBRTC
        config FFT_USING_ONCHIP
            bool "HARDWARE IP FFT/IFFT"
            depends on SOC_SF32LB56X || SOC_SF32LB58X
        config FFT_USING_CMSIS_DSP
            bool "CMSIS DSP FFT/IFFT"
        config FFT_USING_WEBRTC
            bool "WEBRTC default FFT/IFFT"
    endchoice
    config CMSIS_BASIC_MATH_FUN
        bool
        prompt "basic math function using cmsis"
        default n
endif
```

## external/coremark/Kconfig
```kconfig
config PKG_USING_COREMARK
    bool "Coremark"
    default n    
    
if PKG_USING_COREMARK
    config COREMARK_ITERATIONS
        int "Coremark iterations"
        default 10000    
    config COREMARK_MININUM_RUN_TIME
        int "Coremark mininum run time in second"
        default 10
endif
```

## external/fsck/Kconfig
```kconfig
config USING_FAT_CHECK
    bool "FAT filesystem check and repair"
    depends on RT_USING_DFS_ELMFAT
    default n
```

## external/libogg-1.3.6/Kconfig
```kconfig
config PKG_USING_LIBOGG
    bool "libogg - Ogg bitstream library"
    default n
    help
        libogg is the bitstream and framing library for the Ogg project.
        It provides functions for encoding and decoding ogg packets and
        pages. Used by Ogg Vorbis, Theora, and other codecs.
```

## external/lvgl_v8/Kconfig
```kconfig
# Kconfig file for package LittlevGL2RTT LVGL v8.0
config PKG_USING_LITTLEVGL2RTT
     bool "LittlevGL2RTT: The LittlevGl gui lib adapter RT-Thread"
     default n
if PKG_USING_LITTLEVGL2RTT     
menu "LVGL configuration"     
choice
    prompt "select LVGL Version."
    depends on PKG_USING_LITTLEVGL2RTT
    default LVGL_V8
    config LVGL_V7
        bool "LVGL V7"
        select DISABLE_LVGL_V8
        select DISABLE_LVGL_V9
    config LVGL_V8
        bool "LVGL V8"
        select DISABLE_LVGL_V7
        select DISABLE_LVGL_V9
endchoice

config DISABLE_LVGL_V9
    bool
config DISABLE_LVGL_V8
    bool
config DISABLE_LVGL_V7
    bool
    
if LVGL_V8
    source "$SIFLI_SDK/external/lvgl_v8/Kconfig_v8"
endif

choice
    prompt "Performance monitor position."
    depends on LV_USE_PERF_MONITOR
    default LV_PERF_MONITOR_ALIGN_BOTTOM_RIGHT
    config LV_PERF_MONITOR_ALIGN_TOP_LEFT
        bool "Top left"
    config LV_PERF_MONITOR_ALIGN_TOP_MID
        bool "Top middle"
    config LV_PERF_MONITOR_ALIGN_TOP_RIGHT
        bool "Top right"
    config LV_PERF_MONITOR_ALIGN_BOTTOM_LEFT
        bool "Bottom left"
    config LV_PERF_MONITOR_ALIGN_BOTTOM_MID
        bool "Bottom middle"
    config LV_PERF_MONITOR_ALIGN_BOTTOM_RIGHT
        bool "Bottom right"
    config LV_PERF_MONITOR_ALIGN_LEFT_MID
        bool "Left middle"
    config LV_PERF_MONITOR_ALIGN_RIGHT_MID
        bool "Right middle"
    config LV_PERF_MONITOR_ALIGN_CENTER
        bool "Center"
endchoice
choice
    bool "Default log verbosity" if LV_USE_LOG
    default CONFIG_LV_LOG_LEVEL_WARN
    help
        Specify how important log should be added.
    config CONFIG_LV_LOG_LEVEL_TRACE
        bool "A lot of logs to give detailed information"
    config CONFIG_LV_LOG_LEVEL_INFO
        bool "Log important events"
    config CONFIG_LV_LOG_LEVEL_WARN
        bool "Log if something unwanted happened but didn't cause a problem"
    config CONFIG_LV_LOG_LEVEL_ERROR
        bool "Only critical issues, when the system may fail"
    config CONFIG_LV_LOG_LEVEL_USER
        bool "Only logs added by the user"
    config CONFIG_LV_LOG_LEVEL_NONE
        bool "Do not log anything"
endchoice
choice
    prompt "Memory monitor position."
    depends on LV_USE_MEM_MONITOR
    default LV_MEM_MONITOR_ALIGN_BOTTOM_LEFT

    config LV_MEM_MONITOR_ALIGN_TOP_LEFT
        bool "Top left"
    config LV_MEM_MONITOR_ALIGN_TOP_MID
        bool "Top middle"
    config LV_MEM_MONITOR_ALIGN_TOP_RIGHT
        bool "Top right"
    config LV_MEM_MONITOR_ALIGN_BOTTOM_LEFT
        bool "Bottom left"
    config LV_MEM_MONITOR_ALIGN_BOTTOM_MID
        bool "Bottom middle"
    config LV_MEM_MONITOR_ALIGN_BOTTOM_RIGHT
        bool "Bottom right"
    config LV_MEM_MONITOR_ALIGN_LEFT_MID
        bool "Left middle"
    config LV_MEM_MONITOR_ALIGN_RIGHT_MID
        bool "Right middle"
    config LV_MEM_MONITOR_ALIGN_CENTER
        bool "Center"
endchoice
choice
    prompt "Set the default BIDI direction"
    default LV_BIDI_DIR_AUTO
    depends on LV_USE_BIDI

    config LV_BIDI_DIR_LTR
        bool "Left-to-Right"
    config LV_BIDI_DIR_RTL
        bool "Right-to-Left"
    config LV_BIDI_DIR_AUTO
        bool "Detect texts base direction"
endchoice
source "$SIFLI_SDK/middleware/lvgl/Kconfig"
endmenu
endif
```

## external/mbedtls/Kconfig
```kconfig
config PKG_SIFLI_MBEDTLS_BOOT
    bool "Seleted MBedTLS functions for boot"
    depends on !PKG_USING_MBEDTLS
    default n
config PKG_USING_SM
    depends on PKG_SIFLI_MBEDTLS_BOOT
    bool "Selected SM2/SM3"
    default n
```

## external/quickjs/Kconfig
```kconfig
config PKG_USING_QUICKJS
    bool "Enable Quick JS"
    default n
	
if PKG_USING_QUICKJS
	config QUICKJS_BIGNUM
    bool "QuickJS: Enable Big number"
    default n
	config QUICKJS_LVGL
    bool "QuickJS: Enable LVGL v7/v8 support"
    default n
	config QUICKJS_USING_PSRAM
    bool "QuickJS: Using PSRAM Heap"
    default n
	config QUICKJS_PSRAM_SIZE
    int "QuickJS: PSRAM Heap Size"
    default 524288
    depends on QUICKJS_USING_PSRAM
endif
```

## external/rlottie/Kconfig
```kconfig
config PKG_USING_RLOTTIE
    bool "Enable RLOTTIE"
    default n
	select RT_USING_CPLUSPLUS
config LOTTIE_JSON_SUPPORT
	bool "Lottie small Json parser support"
	default n
	depends on PKG_USING_RLOTTIE
```

## external/sensor-lib/Kconfig
```kconfig
config PKG_SIFLI_SENSOR_LIB
    bool "Enable sensor libs"
    default n
       if PKG_SIFLI_SENSOR_LIB
        config PKG_SENSOR_USING_PEDOMETER_C
            bool "Enable sensor libs c"
            default n         
    endif    
```

## middleware/audio/Kconfig
```kconfig
if !SOC_SF32LB55X
# Kconfig file for package WebRTC
menuconfig AUDIO
    bool "Enable Audio"
choice
    prompt "Select audio path Type"
        depends on AUDIO
    default AUDIO_PATH_USING_HCI
    config AUDIO_PATH_USING_HCPU
        bool "HCPU PATH"           
    config AUDIO_PATH_USING_LCPU
        bool "LCPU PATH"
    config AUDIO_PATH_USING_HCI
        bool "HCI PATH"
endchoice 
config AUDIO_PCM_PLC_ENABLE
    bool "Enable audio PCM PLC"
        depends on AUDIO
    default n
config AUDIO_USING_AUDPROC
    bool "Enable audio process framework"
        depends on AUDIO
    default y
config AUDIO_USING_MANAGER
    bool "Enable audio manager"
        depends on AUDIO && BF0_HCPU
    default y
config AUDIO_LOCAL_MUSIC
    bool "Enable local audio"
    depends on (AUDIO_USING_AUDPROC && AUDIO && AUDIO_USING_MANAGER && BF0_HCPU)
    select PKG_USING_LIBHELIX
    default n
config AUDIO_BT_AUDIO
    bool "Enable BT audio"
    depends on (AUDIO_USING_AUDPROC && AUDIO)
    default y
config PKG_USING_VBE_DRC
    bool "Enable Audio Virtual Bass Enhancement & DRC"
        depends on AUDIO
    default n
choice
    prompt "Default Audio RX Path"
        depends on AUDIO
    default AUDIO_MIC_USING_CODEC
    config AUDIO_MIC_USING_CODEC
        bool "Codec Onchip"
    config AUDIO_RX_USING_I2S
        bool "I2S"
    config AUDIO_RX_USING_PDM
        bool "PDM"
endchoice

choice
    prompt "Default Audio TX Path"
        depends on AUDIO
    default AUDIO_SPEAKER_USING_CODEC
    config AUDIO_SPEAKER_USING_CODEC
        bool "Codec Onchip"
    config AUDIO_TX_USING_I2S
        bool "I2S"
endchoice

config MICBIAS_USING_AS_PDM_POWER
    bool "hardware: MICBIAS pin using as pdm power"
        depends on (AUDIO_RX_USING_PDM && AUDIO)
    default n

config AUDIO_SOFTEQ
    bool "Enable audio software EQ"
        depends on AUDIO
    default n
config AUDIO_FREQSHIFT
    bool "Enable audio frequency shift"
        depends on AUDIO
    default n
 
config PKG_USING_ANYKA
    bool "Enable anyka anyblue1090 real-time speech enhancement processing"
        depends on AUDIO
    default n
config PKG_USING_AUDIO_TEST_API
    bool "mic speaker test api"
        depends on AUDIO
    default n
config PKG_USING_3MICS
    bool "total three Mics"
        depends on AUDIO
    default n
config PKG_USING_3MICS_WITHOUT_ADC
    bool "only two pdm mic"
    depends on (PKG_USING_3MICS && AUDIO && BF0_HCPU)
    default n

config MULTI_CLIENTS_AT_WORKING
    bool "multi audio app work together if no hardware conflict"
        depends on AUDIO
    default n
config SOFTWARE_TX_MIX_ENABLE
    bool "Audio TX mix support(big memory footprint)"
        depends on (MULTI_CLIENTS_AT_WORKING && AUDIO)
    default n
config BSP_ENABLE_DAC2
    bool "onchip codec DAC2 enable"
        depends on (SOC_SF32LB58X && AUDIO)
    default y
config BSP_ENABLE_ADC2
    bool "onchip codec ADC2 enable"
        depends on (SOC_SF32LB58X && AUDIO)
    default n
endif
```
