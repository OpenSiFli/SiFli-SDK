
 WCLEAR

 SYStem.Up

 Data.LOAD.ELF armle.axf /spath /lpath

 winpos 0% 0% 100% 50%
 w.d.l
 winpos 0% 50% 50% 50%
 w.v.f /l /c
 winpos 50% 50% 50% 50%
 w.v.w flags ast

 r.s pc main
 r.s r13 0x1000

 enddo
