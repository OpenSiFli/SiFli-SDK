# SF32LB58x register map
File version: 1.0
CPU: CM33 r0p1, little endian, MPU, FPU, 3 interrupt priority bits
Registers are 32-bit, read-write, reset 0x0 unless marked. A register's access mark holds for its fields unless they carry their own. Offsets are from the block's base; [hi:lo] are bit positions; 'fields as' and 'values as' point back to an identical list.

## LPSYS_GPIO
Base 0x50080000
0x00 DIR0 — Data Input Register
  [31:0] IN — GPIO[31:0] input value
0x04 DOR0 — Data Output Register
  [31:0] OUT — GPIO[31:0] output value if output enabled
0x08 DOSR0 — Data Output Set Register
  [31:0] DOS — set 1 to pull up output of corresponding GPIO[31:0]
0x0C DOCR0 — Data Output Clear Register
  [31:0] DOC — set 1 to pull down output of corresponding GPIO[31:0]
0x10 DOER0 — Data Output Enable Register
  [31:0] DOE — GPIO[31:0] output enable
0x14 DOESR0 — Data Output Enable Set Register
  [31:0] DOES — set 1 to enable output of corresponding GPIO[31:0]
0x18 DOECR0 — Data Output Enable Clear Register
  [31:0] DOEC — set 1 to disable output of corresponding GPIO[31:0]
0x1C IER0 — Interrupt Enable Register
  [31:0] IER — GPIO[31:0] interrupt enable
0x20 IESR0 — Interrupt Enable Set Register
  [31:0] IES — set 1 to enable interrupt of corresponding GPIO[31:0]
0x24 IECR0 — Interrupt Enable Clear Register
  [31:0] IEC — set 1 to disable interrupt of corresponding GPIO[31:0]
0x28 ITR0 — Interrupt Type Register
  [31:0] ITR — GPIO[31:0] interrupt type
0x2C ITSR0 — Interrupt Type Set Register
  [31:0] ITS — set 1 for edge-sensitive interrupt mode of corresponding GPIO[31:0]
0x30 ITCR0 — Interrupt Type Clear Register
  [31:0] ITC — set 1 for level-sensitive interrupt mode of corresponding GPIO[31:0]
0x34 IPHR0 — Interrupt Polarity High Register
  [31:0] IPH — rising edge in edge mode, or high level in level mode of corresponding GPIO[31:0]
0x38 IPHSR0 — Interrupt Polarity High Set Register
  [31:0] IPHS — set 1 for rising edge in edge mode, or high level in level mode of corresponding GPIO[31:0]
0x3C IPHCR0 — Interrupt Polarity High Clear Register
  [31:0] IPHC — set 1 for disable rising edge in edge mode, or high level in level mode of corresponding GPIO[31:0]
0x40 IPLR0 — Interrupt Polarity Low Register
  [31:0] IPL — falling edge in edge mode, or low level in level mode of corresponding GPIO[31:0]
0x44 IPLSR0 — Interrupt Polarity Low Set Register
  [31:0] IPLS — set 1 for falling edge in edge mode, or low level in level mode of corresponding GPIO[31:0]
0x48 IPLCR0 — Interrupt Polarity Low Clear Register
  [31:0] IPLC — set 1 for disable falling edge in edge mode, or low level in level mode of corresponding GPIO[31:0]
0x4C ISR0 — Interrupt Status Register
  [31:0] IS — Interrupt status. Write 1 will clear interrupt status of corresponding GPIO[31:0]
0x50 IER0_EXT — Extra Interrupt Enable Register
  [31:0] IER — GPIO[31:0] extra interrupt enable
0x54 IESR0_EXT — Extra Interrupt Enable Set Register
  [31:0] IES — set 1 to enable extra interrupt of corresponding GPIO[31:0]
0x58 IECR0_EXT — Extra Interrupt Enable Clear Register
  [31:0] IEC — set 1 to disable extra interrupt of corresponding GPIO[31:0]
0x5C ISR0_EXT — Extra Interrupt Status Register
  [31:0] IS — Interrupt status. Write 1 will clear extra interrupt status of corresponding GPIO[31:0]
0x60 OEMR0 — output mode Register
  [31:0] OEM — output mode of corresponding GPIO[31:0]
0x64 OEMSR0 — output mode Set Register
  [31:0] OEMS — output mode Set of corresponding GPIO[31:0]
0x68 OEMCR0 — output mode Clear Register
  [31:0] OEMC — output mode Clear of corresponding GPIO[31:0]
0x80 DIR1 — Data Input Register
  [27:0] IN — GPIO[59:32] input value
0x84 DOR1 — Data Output Register
  [27:0] OUT — GPIO[59:32] output value if output enabled
0x88 DOSR1 — Data Output Set Register
  [27:0] DOS — set 1 to pull up output of corresponding GPIO[59:32]
0x8C DOCR1 — Data Output Clear Register
  [27:0] DOC — set 1 to pull down output of corresponding GPIO[59:32]
0x90 DOER1 — Data Output Enable Register
  [27:0] DOE — GPIO[59:32] output enable
0x94 DOESR1 — Data Output Enable Set Register
  [27:0] DOES — set 1 to enable output of corresponding GPIO[59:32]
0x98 DOECR1 — Data Output Enable Clear Register
  [27:0] DOEC — set 1 to disable output of corresponding GPIO[59:32]
0x9C IER1 — Interrupt Enable Register
  [27:0] IER — GPIO[59:32] interrupt enable
0xA0 IESR1 — Interrupt Enable Set Register
  [27:0] IES — set 1 to enable interrupt of corresponding GPIO[59:32]
0xA4 IECR1 — Interrupt Enable Clear Register
  [27:0] IEC — set 1 to disable interrupt of corresponding GPIO[59:32]
0xA8 ITR1 — Interrupt Type Register
  [27:0] ITR — GPIO[59:32] interrupt type
0xAC ITSR1 — Interrupt Type Set Register
  [27:0] ITS — set 1 for edge-sensitive interrupt mode of corresponding GPIO[59:32]
0xB0 ITCR1 — Interrupt Type Clear Register
  [27:0] ITC — set 1 for level-sensitive interrupt mode of corresponding GPIO[59:32]
0xB4 IPHR1 — Interrupt Polarity High Register
  [27:0] IPH — rising edge in edge mode, or high level in level mode of corresponding GPIO[59:32]
0xB8 IPHSR1 — Interrupt Polarity High Set Register
  [27:0] IPHS — set 1 for rising edge in edge mode, or high level in level mode of corresponding GPIO[59:32]
0xBC IPHCR1 — Interrupt Polarity High Clear Register
  [27:0] IPHC — set 1 for disable rising edge in edge mode, or high level in level mode of corresponding GPIO[59:32]
0xC0 IPLR1 — Interrupt Polarity Low Register
  [27:0] IPL — falling edge in edge mode, or low level in level mode of corresponding GPIO[59:32]
0xC4 IPLSR1 — Interrupt Polarity Low Set Register
  [27:0] IPLS — set 1 for falling edge in edge mode, or low level in level mode of corresponding GPIO[59:32]
0xC8 IPLCR1 — Interrupt Polarity Low Clear Register
  [27:0] IPLC — set 1 for disable falling edge in edge mode, or low level in level mode of corresponding GPIO[59:32]
0xCC ISR1 — Interrupt Status Register
  [27:0] IS — Interrupt status. Write 1 will clear interrupt status of corresponding GPIO[59:32]
0xD0 IER1_EXT — Extra Interrupt Enable Register
  [27:0] IER — GPIO[59:32] extra interrupt enable
0xD4 IESR1_EXT — Extra Interrupt Enable Set Register
  [27:0] IES — set 1 to enable extra interrupt of corresponding GPIO[59:32]
0xD8 IECR1_EXT — Extra Interrupt Enable Clear Register
  [27:0] IEC — set 1 to disable extra interrupt of corresponding GPIO[59:32]
0xDC ISR1_EXT — extra Interrupt Status Register
  fields as ISR1
0xE0 OEMR1 — output mode Register
  [27:0] OEM — output mode of corresponding GPIO[59:32]
0xE4 OEMSR1 — output mode Set Register
  [27:0] OEMS — output mode Set of corresponding GPIO[59:32]
0xE8 OEMCR1 — output mode Clear Register
  [27:0] OEMC — output mode Clear of corresponding GPIO[59:32]
