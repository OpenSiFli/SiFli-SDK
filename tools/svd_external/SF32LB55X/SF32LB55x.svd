# SF32LB55x register map
File version: 1.0
CPU: CM33 r0p1, little endian, MPU, FPU, 3 interrupt priority bits
Registers are 32-bit, read-write, reset 0x0 unless marked. A register's access mark holds for its fields unless they carry their own. Offsets are from the block's base; [hi:lo] are bit positions.

## HPSYS_GPIO
Base 0x50000000
0x00 DIR0 — Data Input Register
  [31:0] IN — GPIO[31:0] input value
0x04 DOR0 — Data Output Register
  [31:0] OUT — GPIO[31:0] output value if output enabled
0x08 DOER0 — Data Output Enable Register
  [31:0] DOE — GPIO[31:0] output enable
0x0C OESR0 — Data Output Enable Set Register
  [31:0] OES — set 1 to enable output of corresponding GPIO[31:0]
0x10 OECR0 — Data Output Enable Clear Register
  [31:0] OEC — set 1 to disable output of corresponding GPIO[31:0]
0x14 IER0 — Interrupt Enable Register
  [31:0] IER — GPIO[31:0] interrupt enable
0x18 IESR0 — Interrupt Enable Set Register
  [31:0] IES — set 1 to enable interrupt of corresponding GPIO[31:0]
0x1C IECR0 — Interrupt Enable Clear Register
  [31:0] IEC — set 1 to disable interrupt of corresponding GPIO[31:0]
0x20 ITR0 — Interrupt Type Register
  [31:0] ITR — GPIO[31:0] interrupt type
0x24 ITSR0 — Interrupt Type Set Register
  [31:0] ITS — set 1 for edge-sensitive interrupt mode of corresponding GPIO[31:0]
0x28 ITCR0 — Interrupt Type Clear Register
  [31:0] ITC — set 1 for level-sensitive interrupt mode of corresponding GPIO[31:0]
0x2C IPSR0 — Interrupt Polarity Set Register
  [31:0] IPS — set 1 for rising edge in edge mode, or high level in level mode of corresponding GPIO[31:0]
0x30 IPCR0 — Interrupt Polarity Clear Register
  [31:0] IPC — set 1 for falling edge in edge mode, or low level in level mode of corresponding GPIO[31:0]
0x34 ISR0 — Interrupt Status Register
  [31:0] IS — Interrupt status. Write 1 will clear interrupt status of corresponding GPIO[31:0]
0x38 DIR1 — Data Input Register
  [31:0] IN — GPIO[63:32] input value
0x3C DOR1 — Data Output Register
  [31:0] OUT — GPIO[63:32] output value if output enabled
0x40 DOER1 — Data Direction Register
  [31:0] DOE — GPIO[63:32] output enable
0x44 OESR1 — Data Output Enable Set Register
  [31:0] OES — set 1 to enable output of corresponding GPIO[63:32]
0x48 OECR1 — Data Output Enable Clear Register
  [31:0] OEC — set 1 to disable output of corresponding GPIO[63:32]
0x4C IER1 — Interrupt Enable Register
  [31:0] IER — GPIO[63:32] interrupt enable
0x50 IESR1 — Interrupt Enable Set Register
  [31:0] IES — set 1 to enable interrupt of corresponding GPIO[63:32]
0x54 IECR1 — Interrupt Enable Clear Register
  [31:0] IEC — set 1 to disable interrupt of corresponding GPIO[63:32]
0x58 ITR1 — Interrupt Type Register
  [31:0] ITR — GPIO[63:32] interrupt type
0x5C ITSR1 — Interrupt Type Set Register
  [31:0] ITS — set 1 for edge-sensitive interrupt mode of corresponding GPIO[63:32]
0x60 ITCR1 — Interrupt Type Clear Register
  [31:0] ITC — set 1 for level-sensitive interrupt mode of corresponding GPIO[63:32]
0x64 IPSR1 — Interrupt Polarity Set Register
  [31:0] IPS — set 1 for rising edge in edge mode, or high level in level mode of corresponding GPIO[63:32]
0x68 IPCR1 — Interrupt Polarity Clear Register
  [31:0] IPC — set 1 for falling edge in edge mode, or low level in level mode of corresponding GPIO[63:32]
0x6C ISR1 — Interrupt Status Register
  [31:0] IS — Interrupt status. Write 1 will clear interrupt status of corresponding GPIO[63:32]
0x70 DIR2 — Data Input Register
  [16:0] IN — GPIO[80:64] input value
0x74 DOR2 — Data Output Register
  [16:0] OUT — GPIO[80:64] output value if output enabled
0x78 DOER2 — Data Output Enable Register
  [16:0] DOE — GPIO[80:64] output enable
0x7C OESR2 — Data Output Enable Set Register
  [16:0] OES — set 1 to enable output of corresponding GPIO[80:64]
0x80 OECR2 — Data Output Enable Clear Register
  [16:0] OEC — set 1 to disable output of corresponding GPIO[80:64]
0x84 IER2 — Interrupt Enable Register
  [16:0] IER — GPIO[80:64] interrupt enable
0x88 IESR2 — Interrupt Enable Set Register
  [16:0] IES — set 1 to enable interrupt of corresponding GPIO[80:64]
0x8C IECR2 — Interrupt Enable Clear Register
  [16:0] IEC — set 1 to disable interrupt of corresponding GPIO[80:64]
0x90 ITR2 — Interrupt Type Register
  [16:0] ITR — GPIO[80:64] interrupt type
0x94 ITSR2 — Interrupt Type Set Register
  [16:0] ITS — set 1 for edge-sensitive interrupt mode of corresponding GPIO[80:64]
0x98 ITCR2 — Interrupt Type Clear Register
  [16:0] ITC — set 1 for level-sensitive interrupt mode of corresponding GPIO[80:64]
0x9C IPSR2 — Interrupt Polarity Set Register
  [16:0] IPS — set 1 for rising edge in edge mode, or high level in level mode of corresponding GPIO[80:64]
0xA0 IPCR2 — Interrupt Polarity Clear Register
  [16:0] IPC — set 1 for falling edge in edge mode, or low level in level mode of corresponding GPIO[80:64]
0xA4 ISR2 — Interrupt Status Register
  [16:0] IS — Interrupt status. Write 1 will clear interrupt status of corresponding GPIO[80:64]
