## middleware/nvm_storage/Kconfig
```kconfig
config BSP_USING_NVM_STORAGE
    bool "NVM TLV schema storage"
    depends on RT_USING_DFS
    default n
    help
        Provide TLV/schema based serialization for structured NVM data.

config BSP_USING_NVM_STORAGE_DFS_BACKEND
    bool "NVM DFS file backend"
    depends on BSP_USING_NVM_STORAGE
    default n
    help
        Provide a DFS file backend for app_nvm_read/app_nvm_write.
```

## middleware/rt_bt_app_core/Kconfig
```kconfig
menuconfig BT_USING_RT_BT_APP_CORE
    bool "RT-Thread BT Application Core Framework"
    depends on BSP_BLE_SIBLES && BT_FINSH
    default n
    help
      Enable the RT-Thread BT application core framework, which provides
      a plugin-based architecture for BT profile services with automatic
      event routing, service registration, and unified shell commands.

if BT_USING_RT_BT_APP_CORE

config BT_APP_ENABLE_SHELL_CMD
    bool "Enable shell command interface (bt <service> <cmd>)"
    default y
    help
      Enable the unified "bt" shell command for controlling BT services.
      Disable this if you want to use the core framework without shell
      command support (e.g., in embedded systems without console).

endif
```

## middleware/test_fwk/Kconfig
```kconfig
menuconfig USING_TEST_FWK
    bool "On-device unit test framework (Unity) glue"
    default n
    help
        Enable the on-device glue around the vendored Unity 2.7.0 C unit
        test framework: the Unity output configuration (unity_config.h) and
        the suite registry/runner that exports the msh commands unity_run
        and unity_list.

        A test project also needs RT_USING_UNITY for the framework itself.
        Production firmware should leave both off; this is meant for the
        projects under example/test/.

config TEST_FWK_AUTORUN
    bool "Run every registered Unity case once at boot"
    default n
    depends on USING_TEST_FWK
    help
        Have a test project call sifli_unity_autorun() from main(), so a
        flashed board runs every suite before anyone could have sent a
        command, and the host only has to read.

        There is no reliable moment to send one instead: unity_run only works
        once the shell is up, and nothing announces that dependably. A command
        that lands early is simply lost, and the run then reports a missing
        Unity summary, which reads as a firmware fault.

        The shell is unaffected: main() still falls through to its loop, so
        unity_run keeps working for hands-on work. Set this to n in proj.conf
        to get a board that waits for a command instead.
```

## soc/sf32lb57x/Kconfig.sf32bprtyb3n6
```kconfig
if SOC_SF32BPRTYB3N6
configdefault BSP_ENABLE_MPI1
    default y

choice BSP_MPI1_MODE_CHOICE
    default BSP_MPI1_MODE_5
endchoice

configdefault BSP_QSPI1_MEM_SIZE
    default 4

configdefault BSP_ENABLE_MPI2
    default y

choice BSP_MPI2_MODE_CHOICE
    default BSP_MPI2_MODE_0
endchoice

configdefault BSP_QSPI2_MEM_SIZE
    default 1

configdefault BSP_PSRAM1_PKG_TYPE0_MPI_MODE
    default 5

configdefault BSP_PSRAM1_PKG_TYPE0_PINMAP_MODE
    default 1
endif
```

## soc/sf32lb57x/Kconfig.sf32lb573ub766
```kconfig
if SOC_SF32LB573UB766
configdefault BSP_ENABLE_MPI1
    default y

choice BSP_MPI1_MODE_CHOICE
    default BSP_MPI1_MODE_5
endchoice

configdefault BSP_QSPI1_MEM_SIZE
    default 4

configdefault BSP_ENABLE_MPI2
    default y

choice BSP_MPI2_MODE_CHOICE
    default BSP_MPI2_MODE_0
endchoice

configdefault BSP_QSPI2_MEM_SIZE
    default 16

configdefault BSP_ENABLE_MPI3
    default y

choice BSP_MPI3_MODE_CHOICE
    default BSP_MPI3_MODE_0
endchoice

configdefault BSP_QSPI3_MEM_SIZE
    default 8

configdefault BSP_PSRAM1_PKG_TYPE0_MPI_MODE
    default 5

configdefault BSP_PSRAM1_PKG_TYPE0_PINMAP_MODE
    default 1
endif
```

## soc/sf32lb57x/Kconfig.sf32lb575ucnn6
```kconfig
if SOC_SF32LB575UCNN6
configdefault BSP_ENABLE_MPI1
    default y

choice BSP_MPI1_MODE_CHOICE
    default BSP_MPI1_MODE_3
endchoice

configdefault BSP_QSPI1_MEM_SIZE
    default 8

configdefault BSP_PSRAM1_PKG_TYPE0_MPI_MODE
    default 3

configdefault BSP_PSRAM1_PKG_TYPE0_PINMAP_MODE
    default 2
endif
```

## soc/sf32lb57x/Kconfig.sf32lb577udnn6
```kconfig
if SOC_SF32LB577UDNN6
configdefault BSP_ENABLE_MPI1
    default y

choice BSP_MPI1_MODE_CHOICE
    default BSP_MPI1_MODE_3
endchoice

configdefault BSP_QSPI1_MEM_SIZE
    default 16

configdefault BSP_PSRAM1_PKG_TYPE0_MPI_MODE
    default 3

configdefault BSP_PSRAM1_PKG_TYPE0_PINMAP_MODE
    default 3

configdefault BSP_PSRAM1_PKG_TYPE1_MPI_MODE
    default 6

configdefault BSP_PSRAM1_PKG_TYPE1_PINMAP_MODE
    default 2
endif
```

## soc/sf32lb57x/Kconfig.sf32lb577vd776
```kconfig
if SOC_SF32LB577VD776
configdefault BSP_ENABLE_MPI1
    default y

choice BSP_MPI1_MODE_CHOICE
    default BSP_MPI1_MODE_3
endchoice

configdefault BSP_QSPI1_MEM_SIZE
    default 16

configdefault BSP_ENABLE_MPI2
    default y

choice BSP_MPI2_MODE_CHOICE
    default BSP_MPI2_MODE_0
endchoice

configdefault BSP_QSPI2_MEM_SIZE
    default 16

configdefault BSP_ENABLE_MPI3
    default y

choice BSP_MPI3_MODE_CHOICE
    default BSP_MPI3_MODE_0
endchoice

configdefault BSP_QSPI3_MEM_SIZE
    default 16

configdefault BSP_PSRAM1_PKG_TYPE0_MPI_MODE
    default 3

configdefault BSP_PSRAM1_PKG_TYPE0_PINMAP_MODE
    default 3
endif
```

## soc/sf32lb57x/Kconfig.sf32lb579v6en6
```kconfig
if SOC_SF32LB579V6EN6
configdefault BSP_ENABLE_MPI1
    default y

choice BSP_MPI1_MODE_CHOICE
    default BSP_MPI1_MODE_0
endchoice

configdefault BSP_QSPI1_MEM_SIZE
    default 8

configdefault BSP_ENABLE_MPI2
    default y

choice BSP_MPI2_MODE_CHOICE
    default BSP_MPI2_MODE_3
endchoice

configdefault BSP_QSPI2_MEM_SIZE
    default 32

configdefault BSP_PSRAM2_PKG_TYPE0_MPI_MODE
    default 3

configdefault BSP_PSRAM2_PKG_TYPE0_PINMAP_MODE
    default 3
endif
```

## soc/sf32lb57x/Kconfig.sf32lb57bun3n6
```kconfig
if SOC_SF32LB57BUN3N6
configdefault BSP_ENABLE_MPI2
    default y

choice BSP_MPI2_MODE_CHOICE
    default BSP_MPI2_MODE_0
endchoice

configdefault BSP_QSPI2_MEM_SIZE
    default 1
endif
```

## soc/sf32lb57x/Kconfig.sf32lb57zvn7n6
```kconfig
if SOC_SF32LB57ZVN7N6
configdefault BSP_ENABLE_MPI2
    default y

choice BSP_MPI2_MODE_CHOICE
    default BSP_MPI2_MODE_0
endchoice

configdefault BSP_QSPI2_MEM_SIZE
    default 16
endif
```

## tools/sdk_py_actions/new_board/templates/57/acpu/Kconfig.board.jinja2
```kconfig
config {{ board_symbol }}
    bool
    select {{ soc_symbol }}
{% if part_symbol %}    select {{ part_symbol }}
{% endif %}    select {{ core_select }}
{% if extra_select %}    select {{ extra_select }}
{% endif %}
    default y

rsource "../Kconfig.board"
```
