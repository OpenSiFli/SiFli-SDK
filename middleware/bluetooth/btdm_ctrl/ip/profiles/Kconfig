## middleware/bluetooth/btdm_ctrl/ip/profiles/Kconfig
```kconfig
menu "BLE Profiles"

config CFG_PRF
    bool "BLE profiles"
	depends on CFG_BLE
    default y
config CFG_NB_PRF
    int "Number of BLE profiles"
	depends on CFG_PRF
    default 2

config CFG_PRF_PXPM
    bool "Proximity Profile Monitor Role"
	depends on CFG_BLE
    default n	
config CFG_PRF_PXPR
    bool "Proximity Profile Reporter Role"
	depends on CFG_BLE
    default n	

config CFG_PRF_FMPL
    bool "Find Me Profile Locator role"
	depends on CFG_BLE
    default n	
config CFG_PRF_FMPT
    bool "Find Me Profile Target role"
	depends on CFG_BLE
    default n	

config CFG_PRF_HTPC
    bool "Health Thermometer Profile Collector Role"
	depends on CFG_BLE
    default n	
config CFG_PRF_HTPT
    bool "Health Thermometer Profile Thermometer Role"
	depends on CFG_BLE
    default n

config CFG_PRF_DISC
    bool "Device Information Service Client Role"
	depends on CFG_BLE
    default n	
config CFG_PRF_DISS
    bool "Device Information Service Server Role"
	depends on CFG_BLE
    default n

config CFG_PRF_BLPC
    bool "Blood Pressure Profile Collector Role"
	depends on CFG_BLE
    default n	
config CFG_PRF_BLPS
    bool "Blood Pressure Profile Sensor Role"
	depends on CFG_BLE
    default n

config CFG_PRF_TIPC
    bool "Time Profile Client Role"
	depends on CFG_BLE
    default n	
config CFG_PRF_TIPS
    bool "Time Profile Server Role"
	depends on CFG_BLE
    default n

config CFG_PRF_HRPC
    bool "Heart Rate Profile Collector Role"
	depends on CFG_BLE
    default n	
config CFG_PRF_HRPS
    bool "Heart Rate Profile Sensor Role"
	depends on CFG_BLE
    default n

config CFG_PRF_SCPPC
    bool "Scan Parameter Profile Client Role"
	depends on CFG_BLE
    default n	
config CFG_PRF_SCPPS
    bool "Scan Parameter Profile Server Role"
	depends on CFG_BLE
    default n

config CFG_PRF_BASC
    bool "Battery Service Client Role"
	depends on CFG_BLE
    default n	
config CFG_PRF_BASS
    bool "Battery Service Server Role"
	depends on CFG_BLE
    default n

config CFG_PRF_HOGPD
    bool "HID Device Role"
	depends on CFG_BLE
    default n	
config CFG_PRF_HOGPBH
    bool "HID Boot Host Role"
	depends on CFG_BLE
    default n
config CFG_PRF_HOGPRH
    bool "HID Report Host Role"
	depends on CFG_BLE
    default n

config CFG_PRF_GLPC
    bool "Glucose Profile Collector Role"
	depends on CFG_BLE
    default n	
config CFG_PRF_GLPS
    bool "Glucose Profile Sensor Role"
	depends on CFG_BLE
    default n

config CFG_PRF_RSCPC
    bool "Running Speed and Cadence Profile Collector Role"
	depends on CFG_BLE
    default n	
config CFG_PRF_RSCPS
    bool "Running Speed and Cadence Profile Server Role"
	depends on CFG_BLE
    default n

config CFG_PRF_CSCPC
    bool "Cycling Speed and Cadence Profile Collector Role"
	depends on CFG_BLE
    default n	
config CFG_PRF_CSCPS
    bool "Cycling Speed and Cadence Profile Server Role"
	depends on CFG_BLE
    default n
	
config CFG_PRF_CPPC
    bool "Cycling Power Profile Collector Role"
	depends on CFG_BLE
    default n	
config CFG_PRF_CPPS
    bool "Cycling Power Profile Server Role"
	depends on CFG_BLE
    default n	

config CFG_PRF_LANC
    bool "Location and Navigation Profile Collector Role"
	depends on CFG_BLE
    default n	
config CFG_PRF_LANS
    bool "Location and Navigation Profile Server Role"
	depends on CFG_BLE
    default n

config CFG_PRF_ANPC
    bool "Alert Notification Profile Client Role"
	depends on CFG_BLE
    default n	
config CFG_PRF_ANPS
    bool "Alert Notification Profile Server Role"
	depends on CFG_BLE
    default n

config CFG_PRF_PASPC
    bool "Phone Alert Status Profile Client Role"
	depends on CFG_BLE
    default n	
config CFG_PRF_PASPS
    bool "Phone Alert Status Profile Server Role"
	depends on CFG_BLE
    default n

config CFG_PRF_IPSC
    bool "Internet Protocol Support Profile Client Role"
	depends on CFG_BLE
    default n
config CFG_PRF_IPSS
    bool "Internet Protocol Support Profile Server Role"
	depends on CFG_BLE
    default n	

config CFG_PRF_ENVC
    bool "Environmental Sensing Profile Client Role"
	depends on CFG_BLE
    default n
config CFG_PRF_ENVS
    bool "Environmental Sensing Profile Server Role"
	depends on CFG_BLE
    default n

config CFG_PRF_WSCC
    bool "Weight Scale Profile Client Role"
	depends on CFG_BLE
    default n
config CFG_PRF_WSCS
    bool "Weight Scale Profile Server Role"
	depends on CFG_BLE
    default n

config CFG_PRF_BCSC
    bool "Body Composition Client Role"
	depends on CFG_BLE
    default n
config CFG_PRF_BCSS
    bool "Body Composition Server Role"
	depends on CFG_BLE
    default n

config CFG_PRF_UDSC
    bool "User Data Service Client Role"
	depends on CFG_BLE
    default n
config CFG_PRF_UDSS
    bool "User Data Service Server Role"
	depends on CFG_BLE
    default n

config CFG_PRF_WPTC
    bool "Wireless Power Transfer Profile Client Role"
	depends on CFG_BLE
    default n
config CFG_PRF_WPTS
    bool "Wireless Power Transfer Profile Server Role"
	depends on CFG_BLE
    default n

config CFG_PRF_PLXC
    bool "Pulse Oximete Profile Client Role"
	depends on CFG_BLE
    default n
config CFG_PRF_PLXS
    bool "Pulse Oximeter Profile Server Role"
	depends on CFG_BLE
    default n

config CFG_PRF_CGMC
    bool "Continuous Glucose Monitoring Profile Client Role"
	depends on CFG_BLE
    default n
config CFG_PRF_CGMS
    bool "Continuous Glucose Monitoring Profile Server Role"
	depends on CFG_BLE
    default n

config CFG_PRF_THPP
    bool "Throughput tester profile for debug usage"
	depends on CFG_BLE
    default n


config CFG_PRF_SIBLES
    bool "SiFli BLE server"
	depends on CFG_BLE
    default n

config CFG_PRF_SIBLE_FORWARD
    bool "SiFli BLE forward interface"
	depends on CFG_PRF_SIBLES
    default n

config CFG_PRF_SIBLEC
    bool "SiFli BLE client"
	depends on CFG_BLE
    default n


endmenu
```

## middleware/bluetooth/stack/zephyr_bt/Kconfig.zbt
```kconfig
    
config SEGGER_RTT_MAX_NUM_UP_BUFFERS
    int
    default 8

config UTF8
    bool
    default y    

config LIBLC3
	bool "liblc3 Support"
    default y if ZBT
    default n if !ZBT
	help
	  This option enables the Android liblc3 library for Bluetooth LE Audio            
```

## middleware/bluetooth/stack/zephyr_bt/audio/Kconfig.tmap
```kconfig
# Bluetooth Audio - Telephony and Media Audio Profile (TMAP) options
#
# Copyright 2023 NXP
#
# SPDX-License-Identifier: Apache-2.0
#

config BT_TMAP
	bool "Telephony and Media Audio Profile"
	depends on BT_CAP_ACCEPTOR || BT_CAP_INITIATOR
	help
	  Enabling this will enable TMAP.
```

## middleware/coredump/Kconfig
```kconfig
menuconfig USING_COREDUMP
    bool "Core Dump for Offline Debugging"
    default n
    help
         Enable Core Dump for offline debugging.

if USING_COREDUMP
    choice COREDUMP_BACKEND
        prompt "Core Dump Backend"
        default COREDUMP_BACKEND_PARTITION
        help
            Select the backend type for core dump data storage except minidump. 
        config COREDUMP_BACKEND_PARTITION
            bool "Partition Backend"
            help 
                The partition backend stores core dump data in a dedicated flash partition. 
                It requires FAL module to provide flash partition table.
        config COREDUMP_BACKEND_FILE
            bool "File Backend"
            help
                The file backend stores core dump data in a file on the filesystem.
    endchoice

    menu "Core Dump Storage Location"
    config COREDUMP_PARTITION_NAME
        string "Core Dump Partition Name"
        default "coredump"
        depends on COREDUMP_BACKEND_PARTITION
    config COREDUMP_FILE_PATH
        string "Core Dump File Path"
        default "/coredump"
        depends on COREDUMP_BACKEND_FILE
    config COREDUMP_FILE_NAME
        string "Core Dump File Name"
        default "coredump.bin"
        depends on COREDUMP_BACKEND_FILE
    endmenu

    menu "Core Dump Data to Save"
    config COREDUMP_HCPU_STATIC_DATA_ENABLED
        bool "HCPU Static Data"
        default y
        help
            Include HCPU Static Data in Core Dump
    config COREDUMP_HCPU_HEAP_DATA_ENABLED
        bool "HCPU Heap Data"
        default y
        help
            Include HCPU Heap Data in Core Dump
    config COREDUMP_HCPU_STACK_DATA_ENABLED
        bool "HCPU Stack Data"
        default y
        help
            Include HCPU Stack Data in Core Dump
    config COREDUMP_REG_DATA_ENABLED
        bool "Register Data"
        default y
        help
            Include Register Data in Core Dump
    config COREDUMP_LCPU_SRAM_DATA_ENABLED
        bool "LCPU SRAM Data"
        default y
        help
            Include LCPU SRAM Data in Core Dump
    config COREDUMP_LCPU_TCM_DATA_ENABLED
        bool "LCPU ITCM and DTCM Data"
        default y
        help
            Include LCPU ITCM and DTCM Data in Core Dump
    endmenu
    
    menuconfig COREDUMP_MINIDUMP_ENABLED
        bool "Enable minidump"
        default n
        help
            Minidump saves minimal coredump data in separate location.
            It's saved before full coredump and can be used to do quick analysis when full coredump is not available.
            Minidump always use partition backend and requires a separate partition from full coredump.
    if COREDUMP_MINIDUMP_ENABLED
        config COREDUMP_MINIDUMP_PART_NAME
            string "Minidump Partition Name"
            default "coredump_min"
    endif

    config USING_COREDUMP_EXT
        bool "Enable extended Core Dump function"
        help
            Extended Core Dump function coredump_ext() that can be implemented by user

        default n
endif # USING_COREDUMP
```

## middleware/metrics_collector/Kconfig
```kconfig
menuconfig USING_METRICS_COLLECTOR
    bool "Use Metrics Collector"
    default n   
    if USING_METRICS_COLLECTOR
        config MC_PERIOD_SPEEDUP_FACTOR
        int "Collector Period Speedup Factor for test purpose, e.g. 2: 2x faster, 3: 3x faster"
        default 1
        
        config MC_CLIENT_ENABLED
        bool "Client without direct storage access"
        default n
        
        config MC_SERVICE_ENABLED
        bool "Enable Metrics Save Service which can be used by client"
        default n

        if !MC_CLIENT_ENABLED
            config MC_DEFAULT_DB_SIZE
                int "Default DB Size in byte"
                default 2048
            
            config MC_AUTO_INIT_DISABLED
                bool "Disable auto init"
                default n

            choice
                prompt "Select Backend"
                default MC_BACKEND_USING_TSDB

                config MC_BACKEND_USING_TSDB
                    bool "Use TSDB"

                config MC_BACKEND_USING_FILE
                    bool "Use File"
                    select USING_FILE_LOGGER

                config MC_BACKEND_USING_CONSOLE
                    bool "Use Console Device"
            endchoice  
        endif    
    endif
```

## middleware/profiler/Kconfig
```kconfig
menuconfig USING_PROFILER
	bool "System profiler"
    select PKG_USING_SEGGER_RTT
	default n

if USING_PROFILER

config CONFIG_MAX_NUMBER_OF_CUSTOM_EVENTS
	int "Maximum number of stored custom event types"
	default 32
	range 0 32

config CONFIG_PROFILER_CUSTOM_EVENT_BUF_LEN
	int "Length of data buffer for custom event data (in bytes)"
	default 64

config CONFIG_MAX_LENGTH_OF_CUSTOM_EVENTS_DESCRIPTIONS
	int "Maximum number of characters used to describe single event type"
	default 128

menu "Profiler advanced"

config CONFIG_PROFILER_START_LOGGING_ON_SYSTEM_START
	bool "Start logging on system start"
	default n

config CONFIG_PROFILER_COMMAND_BUFFER_SIZE
	int "Command buffer size"
	default 16

config CONFIG_PROFILER_DATA_BUFFER_SIZE
	int "Data buffer size"
	default 2048

config CONFIG_PROFILER_INFO_BUFFER_SIZE
	int "Info buffer size"
	default 1024

config CONFIG_PROFILER_RTT_CHANNEL_DATA
	int "Data up channel index"
	default 1

config CONFIG_PROFILER_RTT_CHANNEL_INFO
	int "Info up channel index"
	default 2

config CONFIG_PROFILER_RTT_CHANNEL_COMMANDS
	int "Command down channel index"
	default 1

config CONFIG_PROFILER_STACK_SIZE
	int "Stack size for thread handling host input"
	default 512

config CONFIG_PROFILER_THREAD_PRIORITY
	int "Priority of thread handling host input"
	default 10

endmenu # Advanced

endif # USING_PROFILER
```

## rtos/Kconfig
```kconfig
menu "RTOS"
    choice
        prompt "Select RTOS"
        default BSP_USING_RTTHREAD
        config BSP_USING_NO_OS
            bool "No RTOS"           
        config BSP_USING_RTTHREAD
            bool "RT Thread"
        config BSP_USING_FREERTOS
            bool "FreeRTOS"
    endchoice  
    if BSP_USING_RTTHREAD
        source "$SIFLI_SDK/rtos/rtthread/Kconfig"
    endif
	source "$SIFLI_SDK/rtos/env/packages/Kconfig"
endmenu
```

## rtos/env/packages/packages/Kconfig
```kconfig
menu "RT-Thread online packages"

source "$SIFLI_SDK/rtos/env//packages/packages/iot/Kconfig"
#source "$SIFLI_SDK/rtos/env/packages/packages/security/Kconfig"
#source "$SIFLI_SDK/rtos/env/packages/packages/language/Kconfig"
#source "$SIFLI_SDK/rtos/env/packages/packages/multimedia/Kconfig"
#source "$SIFLI_SDK/rtos/env/packages/packages/tools/Kconfig"
#source "$SIFLI_SDK/rtos/env/packages/packages/system/Kconfig"
#source "$SIFLI_SDK/rtos/env/packages/packages/peripherals/Kconfig"
source "$SIFLI_SDK/rtos/env/packages/packages/misc/Kconfig"

endmenu
```

## rtos/env/packages/packages/iot/Kconfig
```kconfig
menu "IoT - internet of things"

#source "$SIFLI_SDK/rtos/env/packages/packages/iot/pahomqtt/Kconfig"
#source "$SIFLI_SDK/rtos/env/packages/packages/iot/webclient/Kconfig"
#source "$SIFLI_SDK/rtos/env/packages/packages/iot/webnet/Kconfig"
#source "$SIFLI_SDK/rtos/env/packages/packages/iot/mongoose/Kconfig"
#source "$SIFLI_SDK/rtos/env/packages/packages/iot/WebTerminal/Kconfig"
#source "$SIFLI_SDK/rtos/env/packages/packages/iot/cJSON/Kconfig"
#source "$SIFLI_SDK/rtos/env/packages/packages/iot/jsmn/Kconfig"
#source "$SIFLI_SDK/rtos/env/packages/packages/iot/libmodbus/Kconfig"
#source "$SIFLI_SDK/rtos/env/packages/packages/iot/ljson/Kconfig"
#source "$SIFLI_SDK/rtos/env/packages/packages/iot/ezXML/Kconfig"
#source "$SIFLI_SDK/rtos/env/packages/packages/iot/nanopb/Kconfig"
#source "$SIFLI_SDK/rtos/env/packages/packages/iot/WiFi/Kconfig"
#source "$SIFLI_SDK/rtos/env/packages/packages/iot/coap/Kconfig"
#source "$SIFLI_SDK/rtos/env/packages/packages/iot/nopoll/Kconfig"
source "$SIFLI_SDK/rtos/env/packages/packages/iot/netutils/Kconfig"
#source "$SIFLI_SDK/rtos/env/packages/packages/iot/at_device/Kconfig"
#source "$SIFLI_SDK/rtos/env/packages/packages/iot/wiznet/Kconfig"

#source "$SIFLI_SDK/rtos/env/packages/packages/iot/iot_cloud/Kconfig"
#source "$SIFLI_SDK/rtos/env/packages/packages/iot/NimBLE/Kconfig"
#source "$SIFLI_SDK/rtos/env/packages/packages/iot/ota_downloader/Kconfig"

endmenu
```

## rtos/env/packages/packages/misc/Kconfig
```kconfig
menu "miscellaneous packages"

#source "$SIFLI_SDK/rtos/env/packages/packages/misc/libcsv/Kconfig"
#source "$SIFLI_SDK/rtos/env/packages/packages/misc/optparse/Kconfig"
#source "$SIFLI_SDK/rtos/env/packages/packages/misc/fastlz/Kconfig"
#source "$SIFLI_SDK/rtos/env/packages/packages/misc/miniLZO/Kconfig"
#source "$SIFLI_SDK/rtos/env/packages/packages/misc/quicklz/Kconfig"
#source "$SIFLI_SDK/rtos/env/packages/packages/misc/MultiButton/Kconfig"
#source "$SIFLI_SDK/rtos/env/packages/packages/misc/CanFestival/Kconfig"
#source "$SIFLI_SDK/rtos/env/packages/packages/misc/zlib/Kconfig"
#source "$SIFLI_SDK/rtos/env/packages/packages/misc/dstr/Kconfig"
#source "$SIFLI_SDK/rtos/env/packages/packages/misc/TinyFrame/Kconfig"
#source "$SIFLI_SDK/rtos/env/packages/packages/misc/kendryte-demo/Kconfig"

source "$SIFLI_SDK/rtos/env/packages/packages/misc/samples/Kconfig"
#source "$SIFLI_SDK/rtos/env/packages/packages/misc/hello/Kconfig"
#source "$SIFLI_SDK/rtos/env/packages/packages/misc/vi/Kconfig"

endmenu
```
