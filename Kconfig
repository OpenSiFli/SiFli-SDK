## customer/boards/ec-lb583/hcpu/Kconfig.board
```kconfig
config BSP_USING_BOARD_EC_LB583XXX
    bool
    select SOC_SF32LB58X
    select BF0_HCPU
    default y

rsource "../Kconfig.board"
```

## customer/boards/ec-lb585/Kconfig.board
```kconfig
config ASIC
    bool
    default y
   
config TOUCH_IRQ_PIN
    int
    default 69
    
config BSP_SUPPORT_DSI
    bool
    default y
    depends on BF0_HCPU

config BSP_SUPPORT_DSI_VIDEO
    bool
    default y
    depends on BF0_HCPU

select BSP_LCDC1_USE_LCDC2_TE if BF0_HCPU

config LCD_USE_GPIO_TE
    int
    depends on LCD_USING_ILI8688E_DSI
    default 98
```

## customer/boards/ec-lb585/lcpu/Kconfig.board
```kconfig
config BSP_USING_BOARD_EC_LB585XXX
    bool
    select SOC_SF32LB58X
    select BF0_LCPU
    default y

rsource "../Kconfig.board"
```

## customer/boards/ec-lb587/acpu/Kconfig.board
```kconfig
config BSP_USING_BOARD_EC_LB587XXX
    bool
    select SOC_SF32LB58X
    select BF0_ACPU
    select BF0_HCPU
    default y

rsource "../Kconfig.board"
```

## customer/boards/eh-lb520/hcpu/Kconfig.board
```kconfig
config BSP_USING_BOARD_EH_LB520XXX
    bool
    select SOC_SF32LB52X
    select BF0_HCPU
    default y

rsource "../Kconfig.board"
```

## customer/boards/eh-lb520S/hcpu/Kconfig.board
```kconfig
config BSP_USING_BOARD_EH_LB520S
    bool
    select SOC_SF32LB52X
    select BF0_HCPU
    default y

rsource "../Kconfig.board"
```

## customer/boards/eh-lb525/lcpu/Kconfig.board
```kconfig
config BSP_USING_BOARD_EH_LB525XXX
    bool
    select SOC_SF32LB52X
    select BF0_LCPU
    default y

rsource "../Kconfig.board"
```

## customer/boards/eh-lb52d/lcpu/Kconfig.board
```kconfig
config BSP_USING_BOARD_EH_LB52D_NAND
    bool
    select SOC_SF32LB52X
    select BF0_LCPU
    default y

rsource "../Kconfig.board"
```

## customer/boards/eh-lb52d_4kb/hcpu/Kconfig.board
```kconfig
config BSP_USING_BOARD_EH_LB52D_4KB
    bool
    select SOC_SF32LB52X
    select BF0_HCPU
    default y
config FLASH_CONFIG_PAGE_SIZE
    int
    default 4096
config FLASH_CONFIG_BLOCK_SIZE
    int
    default 262144
rsource "../Kconfig.board"
```

## customer/boards/eh-lb52x_sd/hcpu/Kconfig.board
```kconfig
config BSP_USING_BOARD_EH_LB525_SD
    bool
    select SOC_SF32LB52X
    select BF0_HCPU
    default y

rsource "../Kconfig.board"
```

## customer/boards/eh-lb551/Kconfig.board
```kconfig
config ASIC
    bool
    default y

choice HDK_551_PACKAGE
    prompt "Select package"
    default HDK_U4O5
    config HDK_U8N5
        bool "8M Dual Flash1 (6600  or 551 U8N5)"
    config HDK_U4O5
        bool "U4O5 - 4M Flash1, 4M OPI PSRAM, for 551 only"
endchoice

config TOUCH_IRQ_PIN
    int
    default 79
config TOUCH_RESET_PIN
    int
    default 47

config LCD_PWM_BACKLIGHT_INTERFACE_NAME
    string
    default "pwm2"

config LCD_PWM_BACKLIGHT_CHANEL_NUM
    int
    default 4

config LCD_BACKLIGHT_CONTROL_PIN
    int
    default 70
    
```

## customer/boards/eh-lb551/lcpu/Kconfig.board
```kconfig
config BSP_USING_BOARD_EH_LB551
    bool
    select SOC_SF32LB55X
    select BF0_LCPU
    default y

rsource "../Kconfig.board"
```
