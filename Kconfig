## Kconfig
```kconfig
menu "Chipset config"
choice
    prompt "Select chipset"
    default SOC_SF32LB55X
    config SOC_SF32LB55X
        bool "SF32LB55X"
    config SOC_SF32LB58X
        bool "SF32LB58X"
    config SOC_SF32LB56X
        bool "SF32LB56X"
    config SOC_SF32LB52X
        bool "SF32LB52X"
    config SOC_SIMULATOR
        bool "SIMULATOR"
endchoice

config BSP_CHIP_ID_COMPATIBLE
    depends on SOC_SF32LB55X
    bool "Support working with different LB55X chip ID"
    default n

config BSP_LB55X_CHIP_ID
    depends on SOC_SF32LB55X
    int "LB55x CHIP ID"
    default 3

choice SF32LB52X_REV_VALUE
    depends on SOC_SF32LB52X
    prompt "Select chip revision compatiable"
    default SF32LB52X_REV_AUTO
    config SF32LB52X_REV_AUTO
        bool "Compatiable for all chip revision"
    config SF32LB52X_REV_A
        bool "Only for revision A"
    config SF32LB52X_REV_B
        bool "Only for revision B"
endchoice

config CFG_SUPPORT_NON_OTP
    depends on SOC_SF32LB52X
    bool "Factory data can be stored on platforms without OTP"
    default n	

config MEMCPY_NON_DMA
    bool 
    depends on !SOC_SIMULATOR
    default n
config PSRAM_CACHE_WB
    bool "Enable PSRAM Cache write back"
    select MEMCPY_NON_DMA if PSRAM_CACHE_WB
    depends on !SOC_SIMULATOR
    default n       
    
endmenu

config HAL_USE_LIB
    bool
    default n

if BF0_HCPU
    config CORE
    string
    default "HCPU"
    config CPU
    string
    default "Cortex-M33"
endif

if BF0_LCPU
    config CORE
    string
    default "LCPU"
    config CPU
    string
    default "Cortex-M33"
    config CPU_HAS_NO_DSP_FP
        bool 
        default y if SOC_SF32LB52X    
endif

source "$SIFLI_SDK/customer/boards/Kconfig"
source "$SIFLI_SDK/rtos/Kconfig"
source "$SIFLI_SDK/middleware/Kconfig"
source "$SIFLI_SDK/external/Kconfig"


comment "------------End of SDK configuration-------------"
```

## Kconfig.v2
```kconfig
mainmenu "Sifli Configuration"

config SIFLI_SDK
    string 
    option env="SIFLI_SDK"
    default "."

config KCONFIG_V2
    bool 
    default y

#SDK configuration	
source "$SIFLI_SDK/rtos/Kconfig"
source "$SIFLI_SDK/middleware/Kconfig"
source "$SIFLI_SDK/external/Kconfig"

menu "Build Options"
    config USING_MICROLIB
        bool "Use microlib"
        default n
    menu "Optimization Level"
        choice OPT_LEVEL
            prompt ""
            default OPT_LEVEL_SIZE
            config OPT_LEVEL_0
                bool "-O0"
            config OPT_LEVEL_1
                bool "-O1"
            config OPT_LEVEL_2
                bool "-O2"
            config OPT_LEVEL_3
                bool "-O3"
            config OPT_LEVEL_FAST
                bool "-Ofast"                
            config OPT_LEVEL_BALANCED
                bool "-Os balanced"                                
            config OPT_LEVEL_SIZE
                bool "-Oz size"
        endchoice
        config OPT_LEVEL
            string
            default "-O0" if OPT_LEVEL_0
            default "-O1" if OPT_LEVEL_1
            default "-O2" if OPT_LEVEL_2
            default "-O3" if OPT_LEVEL_3
            default "-Ofast" if OPT_LEVEL_FAST
            default "-Os" if OPT_LEVEL_BALANCED
            default "-Oz" if OPT_LEVEL_SIZE
    endmenu    
endmenu
```

## customer/boards/Kconfig
```kconfig
menu "Board Config"

choice
    prompt "Select board"
    default BSP_USING_BOARD_EC_LB555XXX
    config BSP_USING_BOARD_EH_SS6500XXX
        depends on SOC_SF32LB52X
        bool "SS6500XXX HDK"    
    config BSP_USING_BOARD_EH_LB520XXX
        depends on SOC_SF32LB52X
        bool "SF32LB520XXX HDK"            
    config BSP_USING_BOARD_EH_LB523XXX
        depends on SOC_SF32LB52X
        bool "SF32LB523XXX HDK"    
    config BSP_USING_BOARD_EH_LB525XXX
        depends on SOC_SF32LB52X
        bool "SF32LB525XXX HDK"    
    config BSP_USING_BOARD_EH_SS6600XXX
        depends on SOC_SF32LB55X
        bool "SS6600XXX HDK"
    config BSP_USING_BOARD_EC_LB551XXX
        depends on SOC_SF32LB55X
        bool "SF32LB551XXX EVB"
    config BSP_USING_BOARD_EC_LB555XXX
        depends on SOC_SF32LB55X
        bool "SF32LB555XXX EVB"
    config BSP_USING_BOARD_EH_LB551
        depends on SOC_SF32LB55X
        bool "SF32LB551 HDK"
    config BSP_USING_BOARD_EH_LB555
        depends on SOC_SF32LB55X
        bool "SF32LB555 HDK"
    config BSP_USING_BOARD_EC_LB557XXX
        depends on SOC_SF32LB55X
        bool "SF32LB557XXX EVB"
    config BSP_USING_BOARD_EC_LB561XXX
        depends on SOC_SF32LB56X
        bool "SF32LB561XXX EVB"
    config BSP_USING_BOARD_EH_LB561XXX
        depends on SOC_SF32LB56X
        bool "SF32LB561XXX HDK"    
    config BSP_USING_BOARD_EC_LB563XXX
        depends on SOC_SF32LB56X
        bool "SF32LB563XXX EVB"
    config BSP_USING_BOARD_EH_LB563XXX
        depends on SOC_SF32LB56X
        bool "SF32LB563XXX HDK" 
    config BSP_USING_BOARD_EC_LB567XXX
        depends on SOC_SF32LB56X
        bool "SF32LB567XXX EVB"
    config BSP_USING_BOARD_EM_LB567XXX
        depends on SOC_SF32LB56X
        bool "SF32LB567XXX MOD"
    config BSP_USING_BOARD_EM_LB566XXX
        depends on SOC_SF32LB56X
        bool "SF32LB566XXX MOD"
    config BSP_USING_BOARD_EC_SS6700XXX
        select BPS_V33
        depends on SOC_SF32LB56X
        bool "SS6700XXX EVB"
    config BSP_USING_BOARD_EH_SS6700XXX
        select BPS_V33
        depends on SOC_SF32LB56X
        bool "SS6700XXX HDK" 
    config BSP_USING_BOARD_EC_LB583XXX
        depends on SOC_SF32LB58X
        bool "SF32LB583XXX EVB"
    config BSP_USING_BOARD_EC_LB585XXX
        depends on SOC_SF32LB58X
        bool "SF32LB585XXX EVB"
    config BSP_USING_BOARD_EC_LB587XXX
        depends on SOC_SF32LB58X
        bool "SF32LB587XXX EVB"
    config BSP_USING_PC_SIMULATOR
        depends on SOC_SIMULATOR
        bool "PC Simulator"
    config BSP_USING_BOARD_CUSTOMER
        bool "Sifli Solution customer board"
    config BSP_USING_NON_SIFLI_BOARD
        bool "non-SiFli board"
endchoice

if !BSP_USING_PC_SIMULATOR
    config LXT_DISABLE
    bool "Low power crystal disabled"
    default n

    if !LXT_DISABLE
        config LXT_FREQ
        int "Low power crystal frequency"
        default 32768
    endif

    config BPS_V33
        bool "Board with Power Supply 3.3 V for VDD1"
        depends on !SOC_SF32LB52X
        default n

    config LXT_LP_CYCLE
    int
    default 200

    menuconfig BT_TX_POWER_VAL
        bool "Select BT RF TX power. Range: 0dbm to 13dbm"
        default y
        depends on (BF0_HCPU && (SOC_SF32LB52X || SOC_SF32LB56X || SOC_SF32LB58X))
        config BT_TX_POWER_VAL_MAX
            int "Select MAXIMUM TX power."
            depends on (BT_TX_POWER_VAL && (SOC_SF32LB56X || SOC_SF32LB58X))
            default 10
        config BT_TX_POWER_VAL_MAX
            int "Select BLE MAX TX power."
            depends on (BT_TX_POWER_VAL && (SOC_SF32LB52X))
            default 10
        config BT_TX_POWER_VAL_MIN
            int "Select MINIMUM TX power."
            depends on BT_TX_POWER_VAL
            default 0
        config BT_TX_POWER_VAL_INIT
            int "Select INIT TX power."
            depends on (BT_TX_POWER_VAL && (SOC_SF32LB56X || SOC_SF32LB58X))
            default 0
        config BT_TX_POWER_VAL_INIT
            int "Select classic BT MAX TX power.IF this value less than BLE MAX TX power,than classic BT max power is equal to BLE MAX TX power"
            depends on (BT_TX_POWER_VAL && (SOC_SF32LB52X))
            default 0
    config BLE_TX_POWER_VAL
        int "Select BLE TX power. Range: -10dbm to 10dbm"
        depends on !(SOC_SF32LB52X || SOC_SF32LB56X || SOC_SF32LB58X)
        default 0            
endif

if BSP_USING_BOARD_EH_SS6500XXX
    source "$SIFLI_SDK/customer/boards/eh-ss6500/Kconfig.board"
endif

if BSP_USING_BOARD_EH_LB520XXX
    source "$SIFLI_SDK/customer/boards/eh-lb520/Kconfig.board"
endif

if BSP_USING_BOARD_EH_LB523XXX
    source "$SIFLI_SDK/customer/boards/eh-lb523/Kconfig.board"
endif

if BSP_USING_BOARD_EH_LB525XXX
    source "$SIFLI_SDK/customer/boards/eh-lb525/Kconfig.board"
endif

if BSP_USING_BOARD_EH_SS6600XXX
    source "$SIFLI_SDK/customer/boards/eh-ss6600xxx/Kconfig"
endif
if BSP_USING_BOARD_EC_LB551XXX || SIFLI_LB551
    source "$SIFLI_SDK/customer/boards/ec-lb551xxx/Kconfig"
endif
if BSP_USING_BOARD_EC_LB555XXX 
    source "$SIFLI_SDK/customer/boards/ec-lb555XXX/Kconfig"
endif
if BSP_USING_BOARD_EH_LB551
    source "$SIFLI_SDK/customer/boards/eh-lb551/Kconfig.board"
endif
if BSP_USING_BOARD_EH_LB555 
    source "$SIFLI_SDK/customer/boards/eh-lb555/Kconfig.board"
endif
if BSP_USING_BOARD_EC_LB557XXX || SIFLI_LB557
    source "$SIFLI_SDK/customer/boards/ec-lb557XXX/Kconfig"
endif

if BSP_USING_BOARD_EC_LB561XXX || SIFLI_LB561
    source "$SIFLI_SDK/customer/boards/ec-lb561XXX/Kconfig"
endif
if BSP_USING_BOARD_EC_LB563XXX || SIFLI_LB563 || BSP_USING_BOARD_EC_SS6700XXX
    source "$SIFLI_SDK/customer/boards/ec-lb563XXX/Kconfig"
endif

if BSP_USING_BOARD_EH_SS6700XXX
    source "$SIFLI_SDK/customer/boards/eh-ss6700/Kconfig.board"
endif

if BSP_USING_BOARD_EH_LB561XXX
    source "$SIFLI_SDK/customer/boards/eh-lb561/Kconfig.board"
endif

if BSP_USING_BOARD_EH_LB563XXX
    source "$SIFLI_SDK/customer/boards/eh-lb563/Kconfig.board"
endif

if BSP_USING_BOARD_EC_LB567XXX || SIFLI_LB567
    source "$SIFLI_SDK/customer/boards/ec-lb567/Kconfig.board"
endif

if BSP_USING_BOARD_EM_LB567XXX
    source "$SIFLI_SDK/customer/boards/em-lb567/Kconfig.board"
endif

if BSP_USING_BOARD_EM_LB566XXX
    source "$SIFLI_SDK/customer/boards/em-lb566/Kconfig.board"
endif

if BSP_USING_BOARD_EC_LB583XXX || SIFLI_LB583
    source "$SIFLI_SDK/customer/boards/ec-lb583/Kconfig.board"
endif
if BSP_USING_BOARD_EC_LB585XXX || SIFLI_LB585
    source "$SIFLI_SDK/customer/boards/ec-lb585/Kconfig.board"
endif
if BSP_USING_BOARD_EC_LB587XXX || SIFLI_LB587
    source "$SIFLI_SDK/customer/boards/ec-lb587/Kconfig.board"
endif


if BSP_USING_PC_SIMULATOR
    source "$SIFLI_SDK/customer/boards/pc/Kconfig"
endif
if !BSP_USING_PC_SIMULATOR     
    menu "Display config"
    config BSP_USING_LCD
        bool "Enable LCD on the board"
            select BSP_USING_EPIC
            select BSP_USING_LCDC
            default n
    if !FPGA
        source "$SIFLI_SDK/customer/boards/Kconfig_lcd"
    endif
    endmenu
    source "$SIFLI_SDK/customer/boards/Kconfig_drv"
    menu "Select board peripherals"
        source "$SIFLI_SDK/customer/peripherals/Kconfig"
    endmenu
endif

endmenu

comment "------------End of Board configuration-----------"
```

## customer/boards/Kconfig.common
```kconfig
source "$SIFLI_SDK/rtos/rtthread/components/drivers/Kconfig"
source "$SIFLI_SDK/middleware/bluetooth/Kconfig.hw"
```

## customer/boards/Kconfig.v2
```kconfig
config KCONFIG_BOARD_V2
    bool 
    default y
source "$SIFLI_SDK/customer/boards/Kconfig_soc"
source "$SIFLI_SDK/customer/boards/Kconfig_drv"
menu "Config LCD on board"
    config BSP_USING_LCD
        bool "Enable LCD on the board"
        select BSP_USING_LCDC
        default n
    source "$SIFLI_SDK/customer/boards/Kconfig_lcd"
endmenu
menu "Select board peripherals"
source "$SIFLI_SDK/customer/peripherals/Kconfig"
endmenu
comment "------------End of Board configuration-----------"
choice
    prompt "the uart port for console"
    default CONSOLE_UART1
    config CONSOLE_UART1
        bool "uart1"
    config CONSOLE_UART2
        bool "uart2"
    config CONSOLE_UART3
        bool "uart3"
    config CONSOLE_UART4
        bool "uart4"
    config CONSOLE_UART5
        bool "uart5"
    config CONSOLE_UART6
        bool "uart6"
endchoice
config RT_CONSOLE_DEVICE_NAME
    string 
    default "uart1" if CONSOLE_UART1
    default "uart2" if CONSOLE_UART2
    default "uart3" if CONSOLE_UART3
    default "uart4" if CONSOLE_UART4    
    default "uart5" if CONSOLE_UART5    
    default "uart6" if CONSOLE_UART6
    
menuconfig BSP_USING_KEY1
    bool "Use KEY1"
    default n
    if BSP_USING_KEY1  
        config BSP_KEY1_PIN
            int "KEY1 pin number"
            default 99
        config BSP_KEY1_ACTIVE_HIGH
            bool "Level is high if key is pressed"
            default n
    endif 
menuconfig BSP_USING_LED1
    bool "Use LED1"
    default n
    if BSP_USING_LED1  
        config BSP_LED1_PIN
            int "LED1 pin number"
            default 99
        config BSP_LED1_ACTIVE_HIGH
            bool "Level is high if LED is on"
            default n
    endif 

    config INSERT_DETE_USB_PIN
        int "USB plug-in detection"
        depends on BSP_USING_USBD
        default -1

menuconfig BSP_USING_VBAT
    bool "Use ADC detect VBAT"
    default n
    if BSP_USING_VBAT  
        config BSP_VBAT_ADC_PIN
            int "VBAT PIN number"
            default 123
        config BSP_VBAT_ADC_CHN
            int "ADC channel for VBAT"
            default 5
        config VBAT2ADC_KOHM
            int "Impedance between VBAT to ADC PIN"
            default 470
        config GND2ADC_KOHM
            int "Impedance between GND to ADC PIN"
            default 1000
    endif 
```

## customer/boards/dummy/hcpu/Kconfig.board
```kconfig
config BSP_USING_BOARD_DUMMY
    bool
    select SOC_SF32LB55X
    select BF0_HCPU
    default y

rsource "../Kconfig.board"
```

## customer/boards/ec-lb551xxx/Kconfig
```kconfig
config ASIC
    bool
    default y
    
config HRS3300_POW_PIN
    int
    default 78

choice
    prompt "Select package"
    default LB551_U4O5
    config LB551_U8N5
        bool "U8N5 - 8M Dual Flash1"
    config LB551_U4O5
        bool "U4O5 - 4M Flash1, 4M OPI PSRAM"
endchoice

config LB551_VERSION
int "Board version"
default 3

if LB551_VERSION=1
    config TOUCH_IRQ_PIN
        int
        default 125
    config TOUCH_RESET_PIN
        int
        default 1
endif

if LB551_VERSION=2
    config TOUCH_IRQ_PIN
        int 
        default 45
    config TOUCH_RESET_PIN
        int
        default 44
endif

config LCD_BACKLIGHT_CONTROL_PIN
    int
    default 70
```

## customer/boards/ec-lb555xxx/Kconfig
```kconfig
config ASIC
    bool
    default y

config TOUCH_IRQ_PIN
    default 140

config BSP_SUPPORT_DSI
    bool
    default y


config LCD_USE_GPIO_TE
    int
    depends on LCD_USING_ILI8688E_DSI
    default 114
```

## customer/boards/ec-lb557xxx/Kconfig
```kconfig
config ASIC
    bool
    default y

config HRS3300_POW_PIN
    int
    default 105

config TOUCH_IRQ_PIN
    default 79

config BSP_SUPPORT_DSI
    bool
    default y

config BSP_SUPPORT_DPI
    bool
    default y


config LCD_PWM_BACKLIGHT_INTERFACE_NAME
    string
    default "pwm4"

config LCD_PWM_BACKLIGHT_CHANEL_NUM
    int
    default 4

config LCD_BACKLIGHT_CONTROL_PIN
    int
    default 134



choice
    prompt "Select package"
    default LB557_VD3A6
    config LB557_VD3A6
        bool "VD3A6 - 1MB Flash1, 16MB OPI PSRAM, and 2MB QSPI PSRAM at LPSYS"
    config LB557_VC536
        bool "VC536 - 4MB Flash1,  8MB OPI PSRAM, and 1MB QSPI NOR flash at LPSYS"
endchoice
```

## customer/boards/ec-lb561xxx/Kconfig
```kconfig
config ASIC
    bool
    default y
   
config TOUCH_IRQ_PIN
    default 50

config LCD_PWM_BACKLIGHT_INTERFACE_NAME
    string
    default "pwm2"

config LCD_PWM_BACKLIGHT_CHANEL_NUM
    int
    default 4

config LCD_BACKLIGHT_CONTROL_PIN
    int
    default 31
```

## customer/boards/ec-lb567/Kconfig.board
```kconfig
config ASIC
    bool
    default y
   
config TOUCH_IRQ_PIN
    int
    default 50

config BSP_SUPPORT_DPI
    bool
    default y

config LCD_PWM_BACKLIGHT_INTERFACE_NAME
    string
    default "pwm2"

config LCD_PWM_BACKLIGHT_CHANEL_NUM
    int
    default 4

config LCD_BACKLIGHT_CONTROL_PIN
    int
    default 35
```

## customer/boards/ec-lb567/lcpu/Kconfig.board
```kconfig
config BSP_USING_BOARD_EC_LB567XXX
    bool
    select SOC_SF32LB56X
    select BF0_LCPU
    default y

rsource "../Kconfig.board"
```
