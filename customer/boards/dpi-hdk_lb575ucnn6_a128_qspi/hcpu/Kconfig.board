## customer/boards/dpi-hdk_lb575ucnn6_a128_qspi/hcpu/Kconfig.board
```kconfig
config BSP_USING_BOARD_DPI_HDK_LB575UCNN6_A128_QSPI
    bool
    select SOC_SF32LB57X
    select SOC_SF32LB575UCNN6
    select BF0_HCPU
    default y

rsource "../Kconfig.board"
```

## customer/boards/dpi-hdk_lb575ucnn6_e8_qspi/lcpu/Kconfig.board
```kconfig
config BSP_USING_BOARD_DPI_HDK_LB575UCNN6_E8_QSPI
    bool
    select SOC_SF32LB57X
    select SOC_SF32LB575UCNN6
    select BF0_LCPU
    default y

rsource "../Kconfig.board"
```

## customer/boards/dpi-hdk_lb575ybbn6_n16_dbi/hcpu/Kconfig.board
```kconfig
config BSP_USING_BOARD_DPI_HDK_LB575YBBN6_N16_DBI
    bool
    select SOC_SF32LB57X
    select SOC_SF32LB575YBBN6
    select BF0_HCPU
    default y

rsource "../Kconfig.board"
```

## customer/boards/dpi-hdk_lb575ybbn6_s8_qspi/acpu/Kconfig.board
```kconfig
config BSP_USING_BOARD_DPI_HDK_LB575YBBN6_S8_QSPI
    bool
    select SOC_SF32LB57X
    select SOC_SF32LB575YBBN6
    select BF0_ACPU
    select BF0_HCPU
    default y

rsource "../Kconfig.board"
```

## customer/boards/dpi-hdk_lb57eybbn6_e8_qspi/acpu/Kconfig.board
```kconfig
config BSP_USING_BOARD_DPI_HDK_LB57EYBBN6_E8_QSPI
    bool
    select SOC_SF32LB57X
    select SOC_SF32LB57EYBBN6
    select BF0_ACPU
    select BF0_HCPU
    default y

rsource "../Kconfig.board"
```

## customer/boards/dpi-hdk_lb57eybbn6_n16_qspi/hcpu/Kconfig.board
```kconfig
config BSP_USING_BOARD_DPI_HDK_LB57EYBBN6_N16_QSPI
    bool
    select SOC_SF32LB57X
    select SOC_SF32LB57EYBBN6
    select BF0_HCPU
    default y

rsource "../Kconfig.board"
```

## customer/boards/dpi-hdk_lb57eybbn6_s8_qspi/lcpu/Kconfig.board
```kconfig
config BSP_USING_BOARD_DPI_HDK_LB57EYBBN6_S8_QSPI
    bool
    select SOC_SF32LB57X
    select SOC_SF32LB57EYBBN6
    select BF0_LCPU
    default y

rsource "../Kconfig.board"
```

## customer/boards/dpi-hdk_lb57gyd7n6_epd/lcpu/Kconfig.board
```kconfig
config BSP_USING_BOARD_DPI_HDK_LB57GYD7N6_EPD
    bool
    select SOC_SF32LB57X
    select SOC_SF32LB57GYD7N6
    select BF0_LCPU
    default y

rsource "../Kconfig.board"
```

## customer/boards/fpga-57x_base/Kconfig.board
```kconfig
config FPGA
    bool
    default y

config TOUCH_IRQ_PIN
    int
    default 33

config LCD_BACKLIGHT_CONTROL_PIN
    int
    default 70
    
config CAMERA_I2C_DEVICE_NAME
    string
    default "i2c2"

config EPD_TPS_I2C_DEVICE_NAME
    string
    default "i2c1"
    
menu "SF32LB57-SPI-HDK Configuration"

config BSP_USING_CAMERA1
    bool "Camera 1"
    select BSP_USING_GC032A
    default n

endmenu    
```

## customer/boards/sf32lb52-ramrun/hcpu/Kconfig.board
```kconfig
config BSP_USING_BOARD_SF32LB52_RAMRUN
    bool
    select SOC_SF32LB52X
    select BF0_HCPU
    default y

rsource "../Kconfig.board"
```

## customer/boards/sf32lb56-ramrun/lcpu/Kconfig.board
```kconfig
config BSP_USING_BOARD_SF32LB56_RAMRUN
    bool
    select SOC_SF32LB56X
    select BF0_LCPU
    default y

rsource "../Kconfig.board"
```

## customer/boards/sf32lb57-dpi-hdk_base/Kconfig.board
```kconfig
config ASIC
    bool
    default y

config BSP_SUPPORT_DPI
    bool
    default y

config TOUCH_IRQ_PIN
    int
    default 6

config LCD_PWM_BACKLIGHT_INTERFACE_NAME
    string
    default "pwmt1"

config LCD_PWM_BACKLIGHT_CHANEL_NUM
    int
    default 4

config LCD_BACKLIGHT_CONTROL_PIN
    int
    default 11 if BSP_LCDC_USING_DPI
    default 11 if BSP_LCDC_USING_DIRECT_EPD
    default 45 if BSP_LCDC_USING_QADSPI
    default 20
    
config CAMERA_I2C_DEVICE_NAME
    string
    default "i2c1"

config EPD_TPS_I2C_DEVICE_NAME
    string
    default "i2c1"

config EPD_TPS_WAKEUP_PIN
    int
    default 20

config EPD_TPS_PWRCOM_PIN
    int
    default 24

config EPD_TPS_PWRUP_PIN
    int
    default 26




menu "SF32LB57-SPI-HDK Configuration"

choice 
    prompt "TP&CAMERA I2C Pinmap"
    default BOARD_TP_CAMERA_I2C_PINMAP_0
    config BOARD_TP_CAMERA_I2C_PINMAP_0
        bool "TP&CAMERA I2C on PA22/PA23"
    config BOARD_TP_CAMERA_I2C_PINMAP_1
        bool "TP&CAMERA I2C on PA51/PA57"
endchoice

choice 
    prompt "DVP Pinmap"
    default BOARD_DVP_PINMAP_0
    config BOARD_DVP_PINMAP_0
        bool "DVP_VSYNC on PA00"
    config BOARD_DVP_PINMAP_1
        bool "TDVP_VSYNC on PA26"
endchoice

config BSP_USING_CAMERA1
    bool "Camera 1"
    select BSP_USING_GC032A
    default n

config USE_PTM_DVP_8WIRE
     bool "Use PTM simulated DVP 8wire interface"
     default n

endmenu
```

## customer/boards/sf32lb57-dpi-hdk_e8r8_v2_qspi/hcpu/Kconfig.board
```kconfig
config BSP_USING_BOARD_SF32LB57_DPI_HDK_E8R8_V2_QSPI
    bool
    select SOC_SF32LB57X
    select SOC_SF32LB575UCNN6
    select BF0_HCPU
    default y

rsource "../Kconfig.board"
```

## customer/boards/sf32lb57-dpi-hdk_n16r16_epd/hcpu/Kconfig.board
```kconfig
config BSP_USING_BOARD_SF32LB57_DPI_HDK_N16R16_EPD
    bool
    select SOC_SF32LB57X
    select SOC_SF32LB57GYD7N6
    select BF0_HCPU
    default y

rsource "../Kconfig.board"
```

## customer/boards/sf32lb57-epd_n16r16/Kconfig.board
```kconfig
config ASIC
    bool
    default y

config BSP_SUPPORT_DPI
    bool
    default y

config TOUCH_IRQ_PIN
    int
    default 3

configdefault LCD_HOR_RES_MAX
    default 684 if LCD_USING_EPD_E0470A03

configdefault LCD_VER_RES_MAX
    default 1216 if LCD_USING_EPD_E0470A03

config EPD_TPS_I2C_DEVICE_NAME
    string
    default "i2c1"

config EPD_TPS_WAKEUP_PIN
    int
    default 42

config EPD_TPS_PWRCOM_PIN
    int
    default 43

config EPD_TPS_PWRUP_PIN
    int
    default 44

config EPD_TPS_GOOD_PIN
    int
    default 52

config EPD_WAVEFORM_USE_BIN
    bool
    default y if LCD_USING_EPD_E0470A03
```

## customer/boards/sf32lb57-epd_n16r16/hcpu/Kconfig.board
```kconfig
config BSP_USING_BOARD_SF32LB57_EPD_N16R16
    bool
    select SOC_SF32LB57X
    select SOC_SF32LB57GYD7N6
    select BF0_HCPU
    select TSC_USING_FT5446U if BSP_USING_TOUCHD
    default y

rsource "../Kconfig.board"
```

## customer/boards/sf32lb57-lcd_base/Kconfig.board
```kconfig
config ASIC
    bool
    select BSP_USING_AW9523 if BF0_HCPU && !BF0_ACPU
    default y

config BSP_SUPPORT_DPI
    bool
    default y

config TOUCH_IRQ_PIN
    int
    default 20

config LCD_PWM_BACKLIGHT_INTERFACE_NAME
    string
    default "pwmt2"

config LCD_PWM_BACKLIGHT_CHANEL_NUM
    int
    default 2

config LCD_BACKLIGHT_CONTROL_PIN
    int
    default 11 if BSP_LCDC_USING_DPI
    default 11 if BSP_LCDC_USING_DIRECT_EPD
    default 45 if BSP_LCDC_USING_QADSPI
config CAMERA_I2C_DEVICE_NAME
    string
    default "i2c1"

config EPD_TPS_I2C_DEVICE_NAME
    string
    default "i2c1"

config EPD_TPS_WAKEUP_PIN
    int
    default 20

config EPD_TPS_PWRCOM_PIN
    int
    default 24

config EPD_TPS_PWRUP_PIN
    int
    default 26

menu "SF32LB57-LCD Configuration"

config BSP_USING_CAMERA1
    bool "Camera 1"
    select BSP_USING_GC032A
    default n

config BOARD_USING_WIFI
    bool "WiFi"
    default n

endmenu

configdefault SDMMC1_BUS_WIDTH_1_ONLY
    default y

configdefault LXT_DISABLE
    default y

# KEY1 used as a single key without ADC button function
configdefault BSP_USING_KEY1
    default y

configdefault BSP_KEY1_PIN
    default 34

configdefault BSP_KEY1_ACTIVE_HIGH
    default y

# ADC button configuration
configdefault USING_ADC_BUTTON
    default y

configdefault ADC_BUTTON_GROUP_NUM
    default 1

configdefault ADC_BUTTON_ADC_DEV_NAME
    default "bat1"

configdefault ADC_BUTTON_GROUP1_MAX_NUM
    default 3

configdefault ADC_BUTTON_GROUP1_ADC_DEV_CHANNEL
    default 6

# KEY1
configdefault ADC_BUTTON_GROUP1_BUTTON1_VOLT
    default 2973

configdefault ADC_BUTTON_GROUP1_BUTTON1_RANGE
    default 190

# KEY2
configdefault ADC_BUTTON_GROUP1_BUTTON2_VOLT
    default 2578

configdefault ADC_BUTTON_GROUP1_BUTTON2_RANGE
    default 190

# KEY3
configdefault ADC_BUTTON_GROUP1_BUTTON3_VOLT
    default 2185

configdefault ADC_BUTTON_GROUP1_BUTTON3_RANGE
    default 190

# WiFi configuration
if BOARD_USING_WIFI
configdefault AIC_WLAN_AIC8800D40N
    default y
endif # BOARD_USING_WIFI
```

## customer/boards/sf32lb57-lcd_n16r8/acpu/Kconfig.board
```kconfig
config BSP_USING_BOARD_SF32LB57_LCD_N16R8
    bool
    select SOC_SF32LB57X
    select SOC_SF32LB57EYBBN6
    select BF0_ACPU
    select BF0_HCPU
    default y

rsource "../Kconfig.board"
```

## customer/boards/sf32lb57-spi-hdk_n1/lcpu/Kconfig.board
```kconfig
config BSP_USING_BOARD_SF32LB57_SPI_HDK_N1
    bool
    select SOC_SF32LB57X
    select SOC_SF32LB57BUN3N6
    select BF0_LCPU
    default y

rsource "../Kconfig.board"
```

## customer/boards/spi-hdk_lb573ub776/acpu/Kconfig.board
```kconfig
config BSP_USING_BOARD_SPI_HDK_LB573UB776
    bool
    select SOC_SF32LB57X
    select SOC_SF32LB573UB7N6
    select BF0_ACPU
    select BF0_HCPU
    default y

rsource "../Kconfig.board"
```

## customer/boards/spi-hdk_lb573ub776/hcpu/Kconfig.board
```kconfig
config BSP_USING_BOARD_SPI_HDK_LB573UB776
    bool
    select SOC_SF32LB57X
    select SOC_SF32LB573UB776
    select BF0_HCPU
    default y

rsource "../Kconfig.board"
```
