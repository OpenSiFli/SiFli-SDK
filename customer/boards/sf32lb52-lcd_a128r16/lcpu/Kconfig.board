## customer/boards/sf32lb52-lcd_a128r16/lcpu/Kconfig.board
```kconfig
config BSP_USING_BOARD_SF32LB52_LCD_A128R16
    bool
    select SOC_SF32LB52X
    select BF0_LCPU
    default y

rsource "../Kconfig.board"
```

## customer/boards/sf32lb52-lchspi-ulp/lcpu/Kconfig
```kconfig
source "Kconfig.board"
source "$SIFLI_SDK/customer/boards/Kconfig.v2"
source "$SIFLI_SDK/customer/boards/Kconfig.common"
```

## customer/boards/sf32lb52-lchspi-ulp/lcpu/Kconfig.board
```kconfig
config BSP_USING_BOARD_SF32LB52_LCHSPI_ULP 
    bool
    select SOC_SF32LB52X
    select BF0_LCPU
    default y

rsource "../Kconfig.board"
```

## customer/boards/sf32lb52-lchspi-ulp_base/Kconfig.board
```kconfig
config ASIC
    bool 
    default y 
   
config TOUCH_IRQ_PIN
    int
    default 41

config LCD_PWM_BACKLIGHT_INTERFACE_NAME
    string
    default "pwm2"

config LCD_PWM_BACKLIGHT_CHANEL_NUM
    int
    default 4

config LCD_BACKLIGHT_CONTROL_PIN
    int
    default 1
    
config RGBLED_CONTROL_PIN
    int
    default 32  
```

## customer/boards/sf32lb52-wlan-core_base/Kconfig.board
```kconfig
config ASIC
    bool 
    default y 
   
config TOUCH_IRQ_PIN
    int
    default 9

config LCD_PWM_BACKLIGHT_INTERFACE_NAME
    string
    default "pwm3"

config LCD_PWM_BACKLIGHT_CHANEL_NUM
    int
    default 4

config LCD_BACKLIGHT_CONTROL_PIN
    int
    default 1
    
```

## customer/boards/sf32lb52-wlan-core_n16r16/lcpu/Kconfig.board
```kconfig
config BSP_USING_BOARD_SF32LB52_WLAN_CORE_N16R16
    bool
    select SOC_SF32LB52X
    select BF0_LCPU
    default y

rsource "../Kconfig.board"
```

## customer/boards/sf32lb55-lcd_n16r4n4/hcpu/Kconfig.board
```kconfig
config BSP_USING_BOARD_SF32LB55_LCD_N16R4N4
    bool
    select SOC_SF32LB55X
    select BF0_HCPU
    default y

rsource "../Kconfig.board"
```

## customer/boards/sf32lb57-dpi-hdk_n16r8_dbi/lcpu/Kconfig.board
```kconfig
config BSP_USING_BOARD_SF32LB57_DPI_HDK_N16R8_DBI
    bool
    select SOC_SF32LB57X
    select SOC_SF32LB575YBBN6
    select BF0_LCPU
    default y

rsource "../Kconfig.board"
```

## customer/boards/sf32lb57-ramrun/acpu/Kconfig.board
```kconfig
config BSP_USING_BOARD_SF32LB57_RAMRUN
    bool
    select SOC_SF32LB57X
    select BF0_ACPU
    select BF0_HCPU
    default y

rsource "../Kconfig.board"
```

## customer/boards/sf32lb57-ramrun/lcpu/Kconfig.board
```kconfig
config BSP_USING_BOARD_SF32LB57_RAMRUN
    bool
    select SOC_SF32LB57X
    select BF0_LCPU
    default y

rsource "../Kconfig.board"
```

## customer/boards/sf32lb57-spi-hdk_base/Kconfig.board
```kconfig
config ASIC
    bool
    default y

config TOUCH_IRQ_PIN
    int
    default 9

config LCD_PWM_BACKLIGHT_INTERFACE_NAME
    string
    default "pwmt1"

config LCD_PWM_BACKLIGHT_CHANEL_NUM
    int
    default 4
    
config LCD_BACKLIGHT_CONTROL_PIN
    int
    default 1
    
config CAMERA_I2C_DEVICE_NAME
    string
    default "i2c2"

menu "SF32LB57-SPI-HDK Configuration"

if SOC_PACKAGE_QFN68
choice 
    prompt "PDM Pinmap"
    default BOARD_PDM_PINMAP_0
    config BOARD_PDM_PINMAP_0
        bool "PDM1 on PA41/PA42, PDM2 on PA43/PA44"
    config BOARD_PDM_PINMAP_1
        bool "PDM1 on PA05/PA06, PDM2 on PA07/PA08"
endchoice
endif # SOC_PACKAGE_QFN68

endmenu
```

## customer/boards/sf32lb57-spi-hdk_n16r4/acpu/Kconfig.board
```kconfig
config BSP_USING_BOARD_SF32LB57_SPI_HDK_N16R4
    bool
    select SOC_SF32LB57X
    select SOC_SF32LB573UB7N6
    select BF0_ACPU
    select BF0_HCPU
    default y

rsource "../Kconfig.board"
```

## customer/boards/sf32lb57-spi-hdk_n16r8/lcpu/Kconfig.board
```kconfig
config BSP_USING_BOARD_SF32LB57_SPI_HDK_N16R8
    bool
    select SOC_SF32LB57X
    select SOC_SF32LB575YBBN6
    select BF0_LCPU
    default y

rsource "../Kconfig.board"
```

## customer/boards/sf32lb57-spi-hdk_n32r4/hcpu/Kconfig.board
```kconfig
config BSP_USING_BOARD_SF32LB57_SPI_HDK_N32R4
    bool
    select SOC_SF32LB57X
    select SOC_SF32LB573UB776
    select BF0_HCPU
    default y

rsource "../Kconfig.board"
```

## customer/boards/sf32lb57-spi-hdk_n32r4/lcpu/Kconfig.board
```kconfig
config BSP_USING_BOARD_SF32LB57_SPI_HDK_N32R4
    bool
    select SOC_SF32LB57X
    select SOC_SF32LB573UB7N6
    select BF0_LCPU
    default y

rsource "../Kconfig.board"
```

## customer/boards/sf32lb58-core_n16r32n1/hcpu/Kconfig.board
```kconfig
config BSP_USING_BOARD_SF32LB58_CORE_N16R32N1
    bool
    select SOC_SF32LB58X
    select BF0_HCPU
    default y

rsource "../Kconfig.board"
```

## customer/boards/sf32lb58-lcd_a128r32n1_qspi/acpu/Kconfig.board
```kconfig
config BSP_USING_BOARD_SF32LB58_LCD_A128R32N1_QSPI
    bool
    select SOC_SF32LB58X
    select BF0_ACPU
    select BF0_HCPU
    default y

rsource "../Kconfig.board"
```

## customer/boards/sf32lb58-lcd_n16r32n1_dsi/acpu/Kconfig.board
```kconfig
config BSP_USING_BOARD_SF32LB58_LCD_N16R32N1_DSI
    bool
    select SOC_SF32LB58X
    select BF0_ACPU
    select BF0_HCPU
    default y

rsource "../Kconfig.board"
```

## customer/boards/sf32lb58-lcd_n16r32n1_qspi/lcpu/Kconfig.board
```kconfig
config BSP_USING_BOARD_SF32LB58_LCD_N16R32N1_QSPI
    bool
    select SOC_SF32LB58X
    select BF0_LCPU
    default y

rsource "../Kconfig.board"
```
