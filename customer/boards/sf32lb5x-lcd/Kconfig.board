## customer/boards/sf32lb5x-lcd/Kconfig.board
```kconfig
config ASIC
    bool
    default y
   
config TOUCH_IRQ_PIN
    int
    default 51

config BSP_SUPPORT_DPI
    bool
    default y

config LCD_PWM_BACKLIGHT_INTERFACE_NAME
    string
    default "pwm4"

config LCD_PWM_BACKLIGHT_CHANEL_NUM
    int
    default 4

config LCD_BACKLIGHT_CONTROL_PIN
    int
    default 119

config LCD_EXTRA_SPI_CS_PIN
        int
        default 04
config LCD_EXTRA_SPI_CLK_PIN
        int
        default 17
config LCD_EXTRA_SPI_MOSI_PIN
        int
        default 18
```

## customer/peripherals/Kconfig
```kconfig
config TSC_USING_ADS7846
    bool
    default n
    
config LCD_USING_GC9A01A
	bool
	default n
config TSC_USING_IT7257
    bool
    default n

config TSC_USING_IT7259E
    bool
    default n
    
config TSC_USING_FT6336
    bool
    default n

config TSC_USING_FT3168
    bool
    default n
config TSC_USING_FT3169
    bool
    default n
config TSC_USING_FT5206
    bool
    default n
config TSC_USING_FT5446U
    bool
    default n

config TSC_USING_TMA525B
    bool
    default n

config TSC_USING_ZTW622
    bool
    default n

config TSC_USING_SPD2012
    bool
    default n

config TSC_USING_CST918
    bool
    default n

config TSC_USING_CST918_0x15
    bool
    default n

config TSC_USING_BL7163      
    bool
    default n
    
config TSC_USING_CST816
    bool
    default n

config TSC_USING_BL6133
    bool
    default n

config TSC_USING_CHSC5816
    bool
    default n

config TSC_USING_GT9271
    bool
    default n

config TSC_USING_GT911
    bool
    default n


config LCD_USING_ST7735
    bool 
    default n

config LCD_USING_ILI9341
    bool 
    default n

config LCD_USING_ILI9327
    bool
    default n
    
config LCD_USING_ST7789V
    bool
    default n
    
config LCD_USING_ST7789H2
    bool
    default n
    
config LCD_USING_RM69330
    bool
    default n
    
config LCD_USING_RM69090
    bool
    default n
    
config LCD_USING_RM690C0
    bool
    default n  
    
config LCD_USING_JDI387A
    bool
    default n
    
config LCD_USING_GC9C01
    bool
    default n

config LCD_USING_SPD2012
    bool
    default n

config LCD_USING_ST7797
    bool
    default n

config LCD_USING_ILI8688E
    bool
    default n

config LCD_USING_ST77903
    bool
    default n

config LCD_USING_SH8601
    bool
    default n

config LCD_USING_SH8601A
    bool
    default n

config LCD_USING_ATK7016
    bool
    default n
    
config LCD_USING_XM80240
    bool
    default n

config LCD_USING_GC9B71
    bool
    default n

config LCD_USING_GC9307
    bool
    default n

config LCD_USING_RM6D010
    bool
    default n

config LCD_USING_ICN3311
    bool
    default n

config LCD_USING_ST7701S
    bool
    default n
    
config LCD_USING_FT2308
    bool
    default n
config LCD_USING_LS013B7DD02
    bool
    default n

config LCD_USING_ST7789_GTM024_08_SPI8P
    bool
    default n

config LCD_USING_QX_4300J40R38
    bool
    default n

config LCD_USING_EK79202
    bool
    default n
	
config LCD_USING_EK79001
    bool
    default n

config LCD_USING_NV3051F1
    bool
    default n

config LCD_USING_NV3041A
    bool
    default n

config LCD_USING_JD9165A
    bool
    default n

config LCD_USING_HTM_H070A20
    bool
    default n

config LCD_USING_JD9365DA
    bool
    default n

config LCD_USING_NV3052C
    bool
    default n
	
config BSP_LCDC_USING_SPI_NODCX_1DATA
    def_bool n 
config BSP_LCDC_USING_SPI_NODCX_2DATA
    def_bool n 
config BSP_LCDC_USING_SPI_DCX_1DATA
    def_bool n 
config BSP_LCDC_USING_SPI_DCX_2DATA
    def_bool n 
config BSP_LCDC_USING_QADSPI
    def_bool n 
config BSP_LCDC_USING_DDR_QADSPI
    def_bool n 
config BSP_LCDC_USING_DBI
    def_bool n 
config BSP_LCDC_USING_DSI
    def_bool n
config BSP_LCDC_USING_DSI_VIDEO
	select BSP_USING_RAMLESS_LCD
    def_bool n
config BSP_LCDC_USING_DPI
    select BSP_USING_RAMLESS_LCD
    def_bool n
config BSP_USING_RAMLESS_LCD
    def_bool n
config BSP_LCDC_USING_JDI_PARALLEL
    def_bool n

config LCD_USING_PWM_AS_BACKLIGHT
    def_bool n

config BSP_LCDC1_USE_LCDC2_TE
    def_bool n

config BSP_USE_LCDC2_ON_HPSYS
    def_bool n

config BSP_USING_ROUND_TYPE_LCD
    def_bool n

config BSP_USING_RECT_TYPE_LCD
    def_bool n

menu "Key Config"
    menuconfig BSP_USING_KEY1
        bool "Use key1"
        default n
    if BSP_USING_KEY1  
        config BSP_KEY1_PIN
            int "KEY1 pin number"
            default 99
        config BSP_KEY1_ACTIVE_HIGH
            bool "Level is high if key is pressed"
            default n
    endif 
    menuconfig BSP_USING_KEY2
        bool "Use key2"
        default n
    if BSP_USING_KEY2 
        config BSP_KEY2_PIN
            int "KEY2 pin number"
            default 96
        config BSP_KEY2_ACTIVE_HIGH
            bool "Level is high if key is pressed"
            default n            
    endif    
endmenu

menuconfig TOUCH_WAKEUP_SUPPORT
    bool "Enable wakeup by Pressing Touch Pannel"
    default n

menuconfig BSP_USING_SPI_CAMERA
    bool "Enable SPI Camera"
    default n

menu "Backlight"
    menuconfig BL_USING_AW9364
        bool "BackLight AW9364"
        default n
        if BL_USING_AW9364
            config AW9364_LIN_IO
            int "AW9364 PIN Number"
            default 70
        endif
endmenu

rsource "*/Kconfig"
```

## customer/peripherals/audio/Kconfig
```kconfig
menu "Audio Device"

menuconfig AUDIO_USING_DA7212
    bool "DA7212"
    default n
    if AUDIO_USING_DA7212
        config DA7212_POWER_PIN
        int "DA7212 POWER PIN"
        default 37

        config DA7212_INTERFACE_NAME
        string "DA7212 interface name"
        default "i2c4"
    endif

endmenu
```

## customer/peripherals/buzzer/Kconfig
```kconfig
menuconfig BUZZER_ENABLED
    bool "Buzzer"
    default n
    if BUZZER_ENABLED
        config BUZZER_INTERFACE_NAME
        string "BUZZER interface name"
        default "pwm2"

        config BUZZER_CHANEL_NUM
        int "BUZZER channel in PWM"
        default 1

        config BUZZER_FREQ
        int "BUZZER PWM freq"
        default 2730

    endif
```

## customer/peripherals/charger/Kconfig
```kconfig
menuconfig BSP_USING_CHARGER
    depends on RT_USING_PIN
    bool "Charger"
    default n
    if BSP_USING_CHARGER  
        choice
            prompt "charge device select"
            default CHARGE_USING_SIFLI if SOC_SF32LB52X
            default CHARGE_USING_SGM40561 if !SOC_SF32LB52X
            config CHARGE_USING_SIFLI
                depends on SOC_SF32LB52X
                bool "using SIFLI charge"
            config CHARGE_USING_SGM40561
                bool "using charge sgm40561"
            config CHARGE_USING_AW32001
                bool "using charge aw32001"
            config CHARGE_USING_SIMPLE_CHARGE
                bool "using charge simple charge"              
        endchoice
        choice
            prompt "chargeing measure vbat adc mode"
            default CHARGER_MEASURE_MODE_SUSPEND
            config CHARGER_MEASURE_MODE_SUSPEND    
            bool "chargeing measure vbat adc mode suspend"
            config CHARGER_MEASURE_MODE_CURVE    
            bool "chargeing measure vbat adc mode CURVE"
        endchoice          
        menuconfig CHARGE_PIN_CONFIG
            bool "chagre pin number config -1:invalid >=0:valid"
            default y
            if CHARGE_PIN_CONFIG
                config BSP_CHARGER_INT_PIN
                    int "charge detect pin number"
                    default 143
                config BSP_CHARGER_INT_PIN_ACTIVE_HIGH
                    bool "Detect pin level is high if charge plug in"
                    default n  
                config BSP_CHARGER_EN_PIN  
                    int "charge Enable pin number"
                    default -1
                config BSP_CHARGING_PIN  
                    int "charging status pin number"
                    default -1
                config BSP_CHARGING_PIN_ACTIVE_HIGH
                    bool "Charging pin level is high if charge plug in"
                    default n   
                config BSP_CHARGE_FULL_PIN  
                    int "charge full status pin number"
                    default -1
                config BSP_CHARGE_FULL_PIN_ACTIVE_HIGH
                    bool "Charge full pin level is high if charge plug in"
                    default n
            endif
        menuconfig CHARGE_I2C_CONFIG
            bool "charge i2c config"
            default n
            
            if CHARGE_I2C_CONFIG
                config BSP_BATTERY_USE_I2C_BUS
                    string "chagre I2C bus config"
                    default "i2c2"
            endif   
        menuconfig CHARGE_ADC_CONFIG
            bool "charge adc config"
            default y
            
            if CHARGE_ADC_CONFIG    
                config BSP_BATTERY_DETECT_ADC
                    string "battery detect used adc"
                    default "bat1"
                    
                config BSP_BATTERY_DETECT_ADC_CHANNEL
                    int "battery detect used adc channel"
                    default 1
            endif
        menuconfig CHARGE_MONITOR_TEMP_CONFIG
            bool "NTC temp config"
            default n
            
            if CHARGE_MONITOR_TEMP_CONFIG
                config BSP_NTC_TEMP_ADC
                    string  "ntc used  adc"
                    default "bat1"
                    
                config BSP_NTC_TEMP_ADC_CHANNEL
                    int "ntc used adc channel"
                    default 4
                    
                choice
                    prompt "ntc value computing method"
                    default BSP_NTC_TEMP_METHOD_FORMULA_COMPUTE
                    
                    config BSP_NTC_TEMP_METHOD_FORMULA_COMPUTE
                    bool "formula compute"
                    
                    config BSP_NTC_TEMP_METHOD_LOOKUP_TABLE
                    bool "lookup table"          
                endchoice
            endif
        config BSP_USING_CHARGER_DETECT
            bool "Use charger detect"
            default n
            
        config CHARGE_NO_BATTERY
            bool "charge no battery"
            default n
    endif
```

## customer/peripherals/encoder/Kconfig
```kconfig
menu "Encoder(Wheel)"

config ENCODER_USING_DK05E01TF412
    bool "DK05E01T"
    default n
    if ENCODER_USING_DK05E01TF412
        config ENCODE_INPUT_PIN_A
            int "Encode Input Pin A"
            default 45
        config ENCODE_INPUT_PIN_B
            int "Encode Input Pin B"
            default 41
    endif

endmenu
```

## customer/peripherals/gps/Kconfig
```kconfig
menu "GPS Device"

menuconfig SENSOR_USING_GPS
    bool "Enable GPS Sensor"
    default n
    if SENSOR_USING_GPS
        menuconfig GPS_USING_UC6226
            bool "Enable GPS module UC6226"
            select RT_USING_SENSOR
            default n
            if GPS_USING_UC6226
                config GPS_UART_NAME
                string "GPS Uart"
                default "uart3"

                config GPS_GPIO_BIT
                int "GPS RESET PIN"
                default 69

                config GPS_POWER_BIT
                int "GPS POWER BIT"
                default 72
            endif
    endif

menuconfig RT_USING_GPS
    bool "Enable GPS device"
    select RT_USING_AT
    select AT_USING_CLIENT
    select GPS_USING_NMEALIB
    default n
    if RT_USING_GPS
        config GPS_USING_AG3335M
            bool "gps device switch"
            default y
			
		menuconfig GPS_PIN_CONFIG
			bool "gps pin number config -1:invalid >=0:valid"
			default y
			if GPS_PIN_CONFIG		
				config MCU_WAKEUP_GPS_PIN
					int "mcu wakeup gps pin number"
					default -1
					
				config MCU_RESET_GPS_PIN
					int "mcu reset gps pin number"
					default -1
					
				config GPS_LEVEL_SHIFT_PIN
					int "gps level shift pin number"
					default -1
					
				config GPS_POWER_PIN
					int "gps power pin number"
					default -1
					
				config GPS_WAKEUP_MCU_PIN
					int "gps wakeup mcu pin number"
					default -1
		endif
		
        config GPS_DEVICE_NAME
            string "gps device name"
            default "gps_device"
            
        config GPS_UART_NAME
            string "gps uart name"
            default "uart4"
            
        config GPS_UART_BAUD
            int "gps uart baud"
            default 115200
            
        config GPS_RECV_BUFF_LEN
            int "gps recv buff size"
            default 256
            
        config RT_US_GPS_DEBUG
        bool "open gps debug switch"
        default n
    endif

endmenu
```

## customer/peripherals/motor/Kconfig
```kconfig
menuconfig MOTOR_ENABLED
    bool "Motor"
    default n
    if MOTOR_ENABLED
       menuconfig MOTOR_USE_PWM
       bool "Enable MOTOR USE PWM"
       select RT_USING_MOTOR
       default n
       if MOTOR_USE_PWM
           config MOTOR_INTERFACE_NAME
           string "motor interface name"
           default "pwm2"

           config MOTOR_CHANEL_NUM
           int "motor channel in PWM"
           default 2

           config MOTOR_PERIOD
           int "motor period ms"
           default 200

           config MOTOR_POWER_IO
           int "motor power pin"
           default 44
       endif

       menuconfig MOTOR_SW_CONTRL
       bool "Enable MOTOR USE SW"
       select RT_USING_MOTOR
       default y
       if MOTOR_SW_CONTRL
           config MOTOR_POWER_IO
           int "motor power pin"
           default 44

           config MOTOR_CTRL_IO
           int "motor contrl pin"
           default 45
		   
		   config MOTOR_PERIOD
           int "motor period ms"
           default 200
       endif
    endif
```

## customer/peripherals/nand/Kconfig
```kconfig
menuconfig CUSTOM_NAND_ENABLED
    bool "Customized NAND configuration"
    default n
    if CUSTOM_NAND_ENABLED
        config NAND_HYF4GQ4UTACAE_ENABLED
            bool "HYF4GQ4UTACAE"
            default n
    endif
```

## customer/peripherals/nor/Kconfig
```kconfig
menuconfig CUSTOM_NOR_ENABLED
    bool "Customized NOR configuration"
    default n
    if CUSTOM_NOR_ENABLED
        config NOR_EN25QX128A_ENABLED
            bool "EN25QX128A"
            default n
    endif
```

## customer/peripherals/pa/Kconfig
```kconfig
menu "Power Amplifier"

config PA_USING_AW882XX
    bool  "digital PA AW882XX enable"
    default n
config PA_USING_AW87390
    bool  "analog PA AW87390 enable"
    default n
config PA_USING_AW8155
    bool  "analog PA AW8155 enable"
    default n

endmenu
```

## customer/peripherals/pmic_controller/Kconfig
```kconfig
menuconfig PMIC_CTRL_ENABLE
    bool "PMIC Controller"
    default n
    if PMIC_CTRL_ENABLE
        config PMICC_SCL_PIN
        int "PMIC Controller SCL PIN"
        default 55

        config PMICC_SDA_PIN
        int "PMIC Controller SDA PIN"
        default 44
    endif
```

## customer/peripherals/sd/Kconfig
```kconfig
menu "SD Card"

config SD_INSERT_DETECT_PIN
    int  "SD Card Insert Detect Pin"
    default -1

endmenu
```
