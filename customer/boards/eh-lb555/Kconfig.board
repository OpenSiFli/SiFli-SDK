## customer/boards/eh-lb555/Kconfig.board
```kconfig
config ASIC
    bool
    default y

config TOUCH_IRQ_PIN
    int
    default 79

config LCD_BACKLIGHT_CONTROL_PIN
    int
    default 70
    
config BSP_SUPPORT_DSI
    bool
    default y
    
```

## customer/boards/eh-lb555/hcpu/Kconfig.board
```kconfig
config BSP_USING_BOARD_EH_LB555
    bool
    select SOC_SF32LB55X
    select BF0_HCPU
    default y

rsource "../Kconfig.board"
```

## customer/boards/eh-lb555/lcpu/Kconfig.board
```kconfig
config BSP_USING_BOARD_EH_LB555
    bool
    select SOC_SF32LB55X
    select BF0_LCPU
    default y

rsource "../Kconfig.board"
```

## customer/boards/eh-lb561/hcpu/Kconfig.board
```kconfig
config BSP_USING_BOARD_EH_LB561XXX
    bool
    select SOC_SF32LB56X
    select BF0_HCPU
    default y

rsource "../Kconfig.board"
```

## customer/boards/eh-lb561/lcpu/Kconfig.board
```kconfig
config BSP_USING_BOARD_EH_LB561XXX
    bool
    select SOC_SF32LB56X
    select BF0_LCPU
    default y

rsource "../Kconfig.board"
```

## customer/boards/eh-lb563/hcpu/Kconfig.board
```kconfig
config BSP_USING_BOARD_EH_LB563XXX
    bool
    select SOC_SF32LB56X
    select BF0_HCPU
    default y

rsource "../Kconfig.board"
```

## customer/boards/eh-lb563/lcpu/Kconfig.board
```kconfig
config BSP_USING_BOARD_EH_LB563XXX
    bool
    select SOC_SF32LB56X
    select BF0_LCPU
    default y

rsource "../Kconfig.board"
```

## customer/boards/eh-lb56xu/Kconfig.board
```kconfig
config ASIC
    bool 
    default y 
   
config TOUCH_IRQ_PIN
    int
    default 50

config LCD_PWM_BACKLIGHT_INTERFACE_NAME
    string
    default "pwm4"

config LCD_PWM_BACKLIGHT_CHANEL_NUM
    int
    default 4

config LCD_BACKLIGHT_CONTROL_PIN
    int
    default 122    
    
```

## customer/boards/eh-ss6500/hcpu/Kconfig.board
```kconfig
config BSP_USING_BOARD_EH_SS6500XXX
    bool
    select SOC_SF32LB52X
    select BF0_HCPU
    default y

rsource "../Kconfig.board"
```

## customer/boards/eh-ss6700/hcpu/Kconfig.board
```kconfig
config BSP_USING_BOARD_EH_SS6700XXX
    bool
    select SOC_SF32LB56X
    select BF0_HCPU
    default y

rsource "../Kconfig.board"
```

## customer/boards/eh-ss6700/lcpu/Kconfig.board
```kconfig
config BSP_USING_BOARD_EH_SS6700XXX
    bool
    select SOC_SF32LB56X
    select BF0_LCPU
    default y

rsource "../Kconfig.board"
```

## customer/boards/em-lb525/hcpu/Kconfig.board
```kconfig
config BSP_USING_BOARD_EM_LB525XXX
    bool
    select SOC_SF32LB52X
    select BF0_HCPU
    default y

rsource "../Kconfig.board"
```

## customer/boards/em-lb52d/hcpu/Kconfig.board
```kconfig
config BSP_USING_BOARD_EM_LB52D
    bool
    select SOC_SF32LB52X
    select BF0_HCPU
    default y

rsource "../Kconfig.board"
```

## customer/boards/em-lb566/lcpu/Kconfig.board
```kconfig
config BSP_USING_BOARD_EM_LB566XXX
    bool
    select SOC_SF32LB56X
    select BF0_LCPU
    default y

rsource "../Kconfig.board"
```

## customer/boards/em-lb567/hcpu/Kconfig.board
```kconfig
config BSP_USING_BOARD_EM_LB567XXX
    bool
    select SOC_SF32LB56X
    select BF0_HCPU
    default y

rsource "../Kconfig.board"
```

## customer/boards/em-lb587/lcpu/Kconfig.board
```kconfig
config BSP_USING_BOARD_EM_LB587XXX
    bool
    select SOC_SF32LB58X
    select BF0_LCPU
    default y

rsource "../Kconfig.board"
```

## customer/boards/pc/Kconfig
```kconfig
menu "PC RTT drivers"

config CONSOLE_UART_DMA
    bool "Console DMA support"
    default n

config PCRTT_UART
    string "Uart port 1"
    default "COM1"

config PCRTT_UART2
    string "Uart port 2"
    default "COM2"
    
config LCD_SDL2
    bool "Enable PC SDL2 LCD simulator"
    default n

config LCD_WINDOWS
    bool "Enable PC Windows simulator"
    default n
    
config BSP_USING_PSRAM
    bool "Enable PSRAM simulation"
    default n    

config WIN32_DIRDISK_ROOT
    string "Disk root path"
    default "./disk"

menuconfig PERI_USING_BT
    bool "Enable bt peripherals device"
    select RT_USING_BT
    default n  
  
    if PERI_USING_BT
        config BT_USING_SIFLI_SIMU
            bool 
            default y
        menuconfig EXT_BT_DEVICE
            depends on SOC_SF32LB55X
            bool "external BT config"
            default n
                
            if EXT_BT_DEVICE    
                menuconfig EXT_BT_UART  
                    bool "bt uart device config"
                    default y
                    
                    if EXT_BT_DEVICE 
                        config BT_UART_NAME
                            string "bt uart name"
                            default "uart1"
                            
                        config BT_UART_BAUD
                            int "bt uart baud"
                            default 921600
                            
                        config BT_RECV_BUFF_LEN
                            int "bt recv buff size"
                            default 512
                    endif
                
                menuconfig BT_PIN_CONFIG
                    bool "bt pin number config -1:invalid >=0:valid"
                    default y
                    if BT_PIN_CONFIG
                        config MCU_WAKEUP_BT_PIN
                            int "mcu wakeup bt pin number"
                            default 121
                            
                        config MCU_RESET_BT_PIN
                            int "mcu reset bt pin number"
                            default -1
                            
                        config BT_LEVEL_SHIFT_PIN
                            int "bt level shift pin number"
                            default -1
                            
                        config BT_POWER_PIN
                            int "bt power pin number"
                            default 104
                            
                        config BT_WAKEUP_MCU_PIN
                            int "bt wakeup mcu pin number"
                            default -1
                            
                        config BT_SPK_PA_EN_PIN
                            int "bt spk pa en pin number"
                            default -1
                    endif
            endif
        
        menuconfig BT_FUNC_CONFIG
            bool "bt function configuration"
            default y
            
             if BT_FUNC_CONFIG
                config BT_USING_DTMF
                    bool "bt using dtmf"
                    default n
                    
                    
                config BT_USING_MIC_MUTE
                    bool "bt using mic mute"
                    default n
                    
                config BT_USING_LOCAL_MEDIA_EX
					depends on !BT_USING_SIFLI
                    bool "bt using local media ex function"
                    default n
                    
                config BT_USING_SIRI
                    bool "bt using siri function"
                    default n
                    
                config BT_USING_AVRCP
                    bool "bt using avrcp"
                    default n
                    
                config BT_USING_HID
                    bool "bt using hid"
                    default n
					
                config BT_USING_3WAY
                    bool "bt using three way calling"
                    default n
                    
                config BT_USING_USB
					depends on !BT_USING_SIFLI
                    bool "bt using usb function"
                    default n
                
                config BT_USING_LINK_BACK
                    bool "bt using service control link back to BT"
                    default n

                config BT_SHARING_LOG_UART
					depends on !BT_USING_SIFLI
                    bool "bt client sharing log uart"
                    default n

                config BT_USING_DEVICE_TYPE
					depends on !BT_USING_SIFLI
                    bool "bt connect device type"
                    default n
					
				config BT_USING_CUSTOMIZE_MAC
					depends on BT_USING_SIFLI
                    bool "BT use a different address than BLE"
                    default n
					
	            config BT_USING_INFINITE_RECONNECTION
					depends on BT_USING_SIFLI
                    bool "use infinite reconnection"
                    default n
        endif
            
        config RT_US_BT_DEBUG
            bool "open bt debug switch"
            default y
		
	config BT_USING_INDEPENDENT_THREAD
            bool "use a separate thread to handle BT control"
            default n
    endif
    menuconfig RT_USING_BT
        bool "Enable bt device"
        default n
        config BT_USING_SIFLI_PC
            bool 
            default y
        config BT_DEVICE_NAME
            string "bt device name"
            default "bt_device"
        if BT_USING_SIFLI_PC
            config BT_USING_AVRCP
                bool "bt using avrcp"
                default n

            config BT_USING_HID
                bool "bt using hid"
                default n
                
            config BT_USING_AG
                bool "bt using HFP AG"
                default n                    
        endif            
endmenu
```

## customer/boards/sf32-oed-epd/Kconfig.board
```kconfig
config ASIC
    bool 
    default y 
   
config TOUCH_IRQ_PIN
    int
    default 30

config TOUCH_RESET_PIN
    int
    default 31


    config TPS_SDA
    int
    default    11
    config TPS_SCL
    int
    default   10
    config TPS_WAKEUP
    int
    default  20
    config TPS_PWRCOM
    int
    default  44
    config TPS_PWRUP
    int
    default  38
    config EPD_LE
    int
    default  9
    config EPD_OE
    int
    default  5
    config EPD_SPH
    int
    default  6
    config EPD_STV
    int
    default  0
    config EPD_CPV
    int
    default  1
    config EPD_GMODE
    int
    default  2
    config EPD_KEY3
    int
    default  32
    config EPD_KEY2
    int
    default  33
    config EPD_KEY1
    int
    default  34
    config EPD_CLK
    int
    default  4
    config EPD_D0
    int
    default   7
    config EPD_D1
    int
    default   8
    config EPD_D2
    int
    default   37
    config EPD_D3
    int
    default   39
    config EPD_D4
    int
    default   40
    config EPD_D5
    int
    default   41
    config EPD_D6
    int
    default   42
    config EPD_D7
    int
    default   43
```

## customer/boards/sf32lb52-core_n4/hcpu/Kconfig.board
```kconfig
config BSP_USING_BOARD_SF32LB52_CORE_N4
    bool
    select SOC_SF32LB52X
    select BF0_HCPU
    default y

rsource "../Kconfig.board"
```

## customer/boards/sf32lb52-devkit-lcd/Kconfig.board
```kconfig
config ASIC
    bool 
    default y 
   
config TOUCH_IRQ_PIN
    int
    default 26

config LCD_PWM_BACKLIGHT_INTERFACE_NAME
    string
    default "pwm3"

config LCD_PWM_BACKLIGHT_CHANEL_NUM
    int
    default 4

config LCD_BACKLIGHT_CONTROL_PIN
    int
    default 1
    
config RGBLED_CONTROL_PIN
    int
    default 32  
```
