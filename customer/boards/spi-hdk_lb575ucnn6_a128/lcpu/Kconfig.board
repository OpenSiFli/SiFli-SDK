## customer/boards/spi-hdk_lb575ucnn6_a128/lcpu/Kconfig.board
```kconfig
config BSP_USING_BOARD_SPI_HDK_LB575UCNN6_A128
    bool
    select SOC_SF32LB57X
    select SOC_SF32LB575UCNN6
    select BF0_LCPU
    default y

rsource "../Kconfig.board"
```

## customer/boards/spi-hdk_lb575ybbn6_n16/lcpu/Kconfig.board
```kconfig
config BSP_USING_BOARD_SPI_HDK_LB575YBBN6_N16
    bool
    select SOC_SF32LB57X
    select SOC_SF32LB575YBBN6
    select BF0_LCPU
    default y

rsource "../Kconfig.board"
```

## customer/boards/spi-hdk_lb57bun3n6/acpu/Kconfig.board
```kconfig
config BSP_USING_BOARD_SPI_HDK_LB57BUN3N6
    bool
    select SOC_SF32LB57X
    select SOC_SF32LB57BUN3N6
    select BF0_ACPU
    select BF0_HCPU
    default y

rsource "../Kconfig.board"
```

## customer/boards/spi-hdk_lb57eybbn6_n16/acpu/Kconfig.board
```kconfig
config BSP_USING_BOARD_SPI_HDK_LB57EYBBN6_N16
    bool
    select SOC_SF32LB57X
    select SOC_SF32LB57EYBBN6
    select BF0_ACPU
    select BF0_HCPU
    default y

rsource "../Kconfig.board"
```

## customer/peripherals/bluetooth/Kconfig
```kconfig
menuconfig RT_USING_BT
    bool "BT Device"
    default n
    if RT_USING_BT
        choice
            prompt "Bluetooth Device"
            default BT_USING_SIFLI

            config BT_USING_SIFLI
                bool "SiFli Bluetooth"

            config BT_USING_FR508X
                bool "FR508X"
                select RT_USING_AT
                select AT_USING_CLIENT

            config BT_USING_BT_5376A2
                bool "5376A2"
                select RT_USING_AT
                select AT_USING_CLIENT
        endchoice
        config BT_DEVICE_NAME
            string "bt device name"
            default "bt_device"
        if !BT_USING_SIFLI
            config BT_UART_NAME
                string "bt uart name"
                default "uart1"
                
            config BT_UART_BAUD
                int "bt uart baud"
                default 921600
            
                
            config BT_RECV_BUFF_LEN
                int "bt recv buff size"
                default 512
                
            menuconfig BT_PIN_CONFIG
                bool "bt pin number config -1:invalid >=0:valid"
                default y
                if BT_PIN_CONFIG
                    config MCU_WAKEUP_BT_PIN
                        int "mcu wakeup bt pin number"
                        default 121
                        
                    config MCU_RESET_BT_PIN
                        int "mcu reset bt pin number"
                        default -1
                        
                    config BT_LEVEL_SHIFT_PIN
                        int "bt level shift pin number"
                        default -1
                        
                    config BT_POWER_PIN
                        int "bt power pin number"
                        default 104
                        
                    config BT_WAKEUP_MCU_PIN
                        int "bt wakeup mcu pin number"
                        default -1
                        
                    config BT_SPK_PA_EN_PIN
                        int "bt spk pa en pin number"
                        default -1
                endif
            
            config BT_USING_DTMF
                bool "bt using dtmf"
                default n
                
            config BT_USING_MIC_MUTE
                bool "bt using mic mute"
                default n
                
            config BT_USING_LOCAL_MEDIA_EX
                bool "bt using local media ex function"
                default n
                
            config BT_USING_SIRI
                bool "bt using siri function"
                default n
                                    
            config BT_USING_USB
                bool "bt using usb function"
                default n
                
            config BT_USING_FLASH_DB
                bool "bt using flash db storage related settings"
                default n
                
            config BT_USING_LINK_BACK
                bool "bt using service control link back to BT"
                default n
                
            config RT_US_BT_DEBUG
                bool "open bt debug switch"
                select AT_PRINT_RAW_CMD
                default y

            config BT_SHARING_LOG_UART
                bool "bt client sharing log uart"
                default n

            config BT_USING_DEVICE_TYPE
                bool "bt connect device type"
                default n
        endif
        if BT_USING_SIFLI
            config BT_USING_HF
                bool "bt using hf"
                default y
                
            config BT_USING_A2DP
                bool "bt using a2dp"
                default y
                
            config BT_USING_SPP
                bool "bt using spp"
                default n
                
            config BT_USING_DTMF
                bool "bt using dtmf"
                default n
                
            config BT_USING_MIC_MUTE
                bool "bt using mic mute"
                default n

            config BT_USING_SIRI
                depends on BT_USING_HF
                bool "bt using siri function"
                default n
                
            config BT_USING_AVRCP
                bool "bt using avrcp"
                default n

            config BT_USING_HID
                bool "bt using hid"
                default n
                
            config BT_USING_AG
                bool "bt using HFP AG"
                default n
                
            config BT_USING_GATT
                bool "bt using gatt"
                default n
                
            config BT_USING_PBAP
                depends on BT_USING_HF
                bool "bt using pbap"
                default n
        endif
    endif
```

## customer/peripherals/camera/Kconfig
```kconfig
menu "Camera"

config BSP_USING_OV2640
    bool "OV2640"
    select BSP_USING_DCMI
    select BSP_USING_I2C
    default n
    
config BSP_USING_GC032A
    bool "GC032A"
    select BSP_USING_DCMI
    select BSP_USING_I2C
    select BSP_USING_PWM
    select BSP_USING_PWMT2
    default n

config BSP_USING_SPI_CAMERA
    bool "SPI Camera"
    default n    
endmenu    
```

## customer/peripherals/console/Kconfig
```kconfig
menu "Console"

choice
    prompt "UART Port for Console"
    default CONSOLE_UART1
    config CONSOLE_UART1
        bool "UART1"
    config CONSOLE_UART2
        bool "UART2"
    config CONSOLE_UART3
        bool "UART3"
    config CONSOLE_UART4
        bool "UART4"
    config CONSOLE_UART5
        bool "UART5"
    config CONSOLE_UART6
        bool "UART6"
    config CONSOLE_PC
        bool "PC Simulator"
    config CONSOLE_QEMU
        bool "QEMU Simulator"
endchoice
config RT_CONSOLE_DEVICE_NAME
    string
    default "uart1" if CONSOLE_UART1
    default "uart2" if CONSOLE_UART2
    default "uart3" if CONSOLE_UART3
    default "uart4" if CONSOLE_UART4
    default "uart5" if CONSOLE_UART5
    default "uart6" if CONSOLE_UART6
    default "console" if CONSOLE_PC
    default "console" if CONSOLE_QEMU


endmenu
```

## customer/peripherals/ioexpander/aw9523/Kconfig
```kconfig
menu "AW9523 I2C GPIO Expander"

config BSP_USING_AW9523
    bool "AW9523B I2C GPIO expander"
    default n

endmenu
```

## customer/peripherals/wifi/aic8800d40-n/Kconfig
```kconfig
#-----------------------------
# AIC8800D40-N driver local parameter
#
# This file is sourced only when the master switch AIC_WLAN_AIC8800D40N
# in customer/peripherals/wifi/Kconfig is enabled, so every option below
# implicitly depends on AIC_WLAN_AIC8800D40N.
#-----------------------------

menu "AIC8800D40-N Parameter"

    config CHIP_SELECT_AIC8800D40N
        bool "select AIC8800D40N (D80N chip)"
        default y
        help
          AIC8800D40N modules (SDIO PID 0x9084; siblings D40LN 0x9085 and
          D40WN 0x9086) all use the AIC8800D80N chip internally.
          SConscript uses this to inject CONFIG_AIC8800D80N (+ U02C firmware
          set) as required by the prebuilt host library, so upper layers only
          need to use the D40-N naming.

    config AIC8800_USE_RT_WLAN
        bool "connect to RT-Thread Wi-Fi framework (rt_wlan + SDK netif)"
        default n
        select RT_USING_WIFI
        select RT_USING_NETDEV
        select LWIP_USING_DHCPD
        help
          Off (default): route 1 - the driver creates its own lwIP netif
                         and does not depend on rt_wlan.
          On:            route 2 - netif is created by the rt_wlan framework
                         and the driver only provides rt_wlan_dev_ops; the
                         wifi command and rt_wlan_* APIs are available, the
                         framework starts the DHCP client for STA and the
                         DHCP server for SoftAP.

    choice
        prompt "AIC8800 RX mode"
        default AIC8800_RX_MODE_IRQ_IN_ISR
        config AIC8800_RX_MODE_IRQ_IN_ISR
            bool "SDIO IRQ, RX in interrupt context"
            help
              Receive packets synchronously inside the SDIO interrupt
              handler, clearing the chip interrupt source before returning,
              so the DAT1 level interrupt does not retrigger while the
              source is still pending (interrupt storm).
        config AIC8800_RX_MODE_IRQ_TASK
            bool "SDIO IRQ, RX in dedicated task"
            help
              After registering the SDIO interrupt, an internal rx task
              receives packets, keeping the interrupt context shorter.
    endchoice

    choice
        prompt "AIC8800 firmware load mode"
        default AIC8800_FW_LOAD_INNER
        help
          Source of the WiFi firmware image. This SDK integration only uses
          the embedded array (inner) mode; file mode requires a file system
          and flash mode requires firmware partitions defined in ptab.

        config AIC8800_FW_LOAD_INNER
            bool "embedded firmware array (innermode, CONFIG_LOAD_FW=2)"

        config AIC8800_FW_LOAD_FLASH
            bool "load from flash (flashmode, CONFIG_LOAD_FW=1)"

        config AIC8800_FW_LOAD_FILE
            bool "load from file system (filemode, CONFIG_LOAD_FW=0)"
    endchoice

    config AIC8800_IRQ_SUS
        bool "re-enable SDIO interrupt after each RX round (CONFIG_IRQ_SUS_DEFAULT=1)"
        default n
        help
          Re-enable the SDIO interrupt after RX processing. Keep disabled for
          the default RX flow.

    config AIC8800_RX_POLLING
        bool "poll for RX instead of using the SDIO interrupt (CONFIG_RX_POLLING_DEFAULT=1)"
        depends on AIC8800_RX_MODE_IRQ_TASK
        default n
        help
          Keep the SDIO interrupt masked and let the library RX task poll
          every 10 ms. Use as a fallback when the DAT1 level interrupt
          storms. Requires the "RX in dedicated task" mode above.

    choice
        prompt "aic8800 wlan power-on control"
        default AIC8800_RTOS_WIRELESS_PWR_DIRECT_GPIO
        help
          Control method for the WiFi chip power enable pin (WL_REG_ON).

        config AIC8800_RTOS_WIRELESS_PWR_DIRECT_GPIO
            bool "direct MCU GPIO"
            help
              PWRON is connected directly to an MCU GPIO and the driver
              controls power up/down through rt_pin.

        config AIC8800_RTOS_WIRELESS_PWR_VIA_IOEXP
            bool "via IO expander (e.g. AW9523 on I2C)"
            help
              PWRON is connected to an I2C IO expander and power up/down is
              controlled through the expander (the board must provide
              aw9523.h/aw9523.c). Because the I2C bus must be ready, the
              power-on hook is registered at INIT_PREV_EXPORT.
    endchoice

    config AIC8800_RTOS_WIRELESS_PWR_GPIO
        int "aic8800 wlan power-on gpio (WL_REG_ON, -1 = not used)"
        depends on AIC8800_RTOS_WIRELESS_PWR_DIRECT_GPIO
        default -1
        help
          WiFi chip power enable pin. At driver start-up the pin is driven
          low -> delayed -> driven high to power on the chip (configure -1 to
          skip all GPIO operations and let the hardware ensure power-up).

    config AIC8800_RTOS_WIRELESS_PWR_IOEXP_PIN
        hex "aic8800 wlan power-on pin on IO expander (AW9523 0x15 = P1_5)"
        depends on AIC8800_RTOS_WIRELESS_PWR_VIA_IOEXP
        default 0x15
        help
          Power enable pin number on the IO expander, encoded as in
          aw9523.h: 0xPp (P = port 0/1, p = bit 0~7).
          AW9523_PIN_WF_PWREN = 0x15 (P1_5).

    config AIC8800_RTOS_WIRELESS_PWR_IOEXP_PIN_KEY
        hex "aic8800 wlan power-on sequence pin on IO expander (AW9523 0x14 = P1_4)"
        depends on AIC8800_RTOS_WIRELESS_PWR_VIA_IOEXP
        default 0x14
        help
          Power-on sequence pin number on the IO expander (driven after the
          supply is stable to complete the power-on sequence).
          Encoded as in aw9523.h: 0xPp (P = port 0/1, p = bit 0~7).
          AW9523_PIN_WF_PWRKEY = 0x14 (P1_4).

endmenu
```

## customer/peripherals/wifi/aic8800d40/Kconfig
```kconfig
#-----------------------------
# aic8800 wlan devices local parameter
#-----------------------------

# wlan0 parameter

menu "Wlan0 Parameter"

    choice
        prompt "Select AIC8800 MODEL"
        default CHIP_SELECT_AIC8800D40L
        config CHIP_SELECT_AIC8800D40L
            bool "select AIC8800D40L"
        config CHIP_SELECT_AIC8800DW
            bool "select AIC8800DW"
    endchoice

    choice
        prompt "Select AIC8800 power converter"
        default CONFIG_AIC8800_VRF_DCDC_MODE
        config CONFIG_AIC8800_VRF_DCDC_MODE
            bool "select DCDC mode"
        config CONFIG_AIC8800_VRF_LDO_MODE
            bool "select LDO mode"
    endchoice

    choice
        prompt "Select AIC8800 work mode"
        default CONFIG_AIC8800_NORMAL_MODE
        config CONFIG_AIC8800_NORMAL_MODE
            bool "select normal mode"
        config CONFIG_AIC8800_RFTEST_MODE
            bool "select rftest mode"
    endchoice

    config CONFIG_AIC8800_BT_SUPPORT
        bool "enable aic8800 BT support"
        default n

    config AIC_DEV_AIC8800_BT_RST_GPIO
        int "aic8800 bt reset gpio"
        default -1

    config AIC_WIRELESS_PWR_GPIO
        int "aic8800 wlan0 power on gpio"
        default -1

    config AIC_DEV_AIC8800_WLAN0_RST_GPIO
        int "aic8800 wlan0 reset gpio"
        default -1
        
    config AIC_DEV_AIC8800_DEBUG_LOG
        bool "enable aic8800 debug messages"
        default y

endmenu
```

## example/cherryusb/host/usb_bt_bridge_l2/project/Kconfig.proj
```kconfig
menu "USB-BT Bridge Configuration"

config CUSTOM_MEM_MAP
    bool
    select custom_mem_map
    default y

config USB_BT_BRIDGE_BT_NAME
    string "Bluetooth device name"
    default "SiFli_USB_Bridge"
    help
        Bluetooth device name visible to other devices

endmenu
```

## example/cherryusb/host/usb_bt_bridge_nat/project/Kconfig.proj
```kconfig
config CUSTOM_MEM_MAP
    bool
    select custom_mem_map
    default y

menu "USB-BT Bridge Configuration"

config USB_BT_BRIDGE_BT_NAME
    string "Bluetooth device name"
    default "SiFli_USB_Bridge"
    help
        Bluetooth device name visible to other devices

endmenu
```

## example/dfu_v2/ble/loader/project/Kconfig
```kconfig
#Kconfig root for DFU-BLE V2 subprogram.
source "$SIFLI_SDK/Kconfig.v2"
rsource "Kconfig.proj"
```

## example/dfu_v2/cdc/app/project/Kconfig
```kconfig
mainmenu "CDC DFU V2 Example Configuration"

config ENABLE_DFU
    bool "Enable DFU subprogram"
    default y
    help
      Build and include the DFU subprogram alongside this application.

source "$SIFLI_SDK/Kconfig"
```
