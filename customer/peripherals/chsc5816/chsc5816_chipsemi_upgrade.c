#define _ENABLE_DEBUG_
#define _FILE_TAG_ "driver"


#include "string.h"

#include <rtthread.h>


#include "chsc5816_chipsemi_default_upd.h"

#include "chsc5816.h"

extern void semi_touch_reset(void);
extern int32_t semi_touch_read_bytes(uint32_t reg, uint8_t* buffer, uint16_t len);
extern int32_t semi_touch_write_bytes(uint32_t reg, uint8_t* buffer, uint16_t len);


static const uint8_t fw_5816_burn[] = {
0x37,0x02,0x00,0x20,0x13,0x02,0x02,0x02,0x37,0x77,0x00,0x40,0x37,0x45,0x04,0x12,
0x05,0x05,0x08,0xC3,0x02,0x82,0x01,0x00,0x00,0x00,0x00,0x00,0x00,0x00,0x00,0x00,
0x01,0x00,0x01,0x00,0x01,0x00,0x73,0x70,0x04,0x30,0x17,0x11,0x00,0x00,0x13,0x01,
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0x64,0x01,0x00,0x20,0x00,0x70,0x00,0x40,0x00,0x10,0x00,0x40
};

/*
    delay or sleep some time (the unit is milliseconds)
*/

struct sm_touch_dev upd_st_dev;

static uint16_t caculate_checksum_u16(uint16_t *buf, uint32_t length)
{
    uint16_t sum;
    uint32_t len, i;

    sum = 0;
    len = length >> 1;

    for(i = 0; i < len; i++){
        sum += buf[i];
    }

    return sum;
}

static uint32_t caculate_checksum_ex(uint8_t * buf, uint32_t length)
{
    uint32_t k, combchk;
    uint16_t check = 0;
    uint16_t checkex = 0;

    for(k = 0; k < length; k++){
        check   += buf[k];
        checkex += (uint16_t)(k * buf[k]);
    }

    combchk = (checkex<<16) | check;

    return combchk;
}









static int32_t semi_touch_write_core_and_check(uint32_t addr, const uint8_t* buffer, uint16_t len)
{
    int32_t ret = 0, once = 0, index = 0, retry = 0;
    uint8_t core_cmp_buffer[MAX_IO_BUFFER_LEN-4];
    const int32_t max_try = 3;

    while(len > 0){
        retry = 0;
        do{
            ret = SEMI_DRV_ERR_OK;
            once = (len<(MAX_IO_BUFFER_LEN-4))?len:(MAX_IO_BUFFER_LEN-4);
            ret = semi_touch_write_bytes(addr, (uint8_t*)buffer, once);
            ret = semi_touch_read_bytes(addr, core_cmp_buffer, once);
            for(index = 0; index < once; index++){
                if(core_cmp_buffer[index] != buffer[index]){
                    ret = -SEMI_DRV_ERR_CHECKSUM;
                    break;
                }
            }
            if(SEMI_DRV_ERR_OK == ret){
                break;
            }         
        }while(++retry < max_try);

        if(SEMI_DRV_ERR_OK != ret){
            break;
        }   
        
        addr   += once;
        buffer += once;
        len    -= once;
    }

    return ret;
}



int32_t cmd_send_to_tp(struct m_ctp_cmd_std_t *ptr_cmd, struct m_ctp_rsp_std_t *ptr_rsp, int32_t once_delay, 
                             int32_t poolgap)
{
    int32_t ret = -SEMI_DRV_ERR_HAL_IO;
    uint32_t retry = 0;
    uint32_t cmd_rsp_ok = 0;

    ptr_cmd->tag = 0xE9;
    ptr_cmd->chk = 1 + ~(caculate_checksum_u16((uint16_t*)&ptr_cmd->d0, sizeof(struct m_ctp_cmd_std_t) - 2));
    ret = semi_touch_write_bytes(0x20000000, (uint8_t*)ptr_cmd, sizeof(struct m_ctp_cmd_std_t));
    if(ret != 0){   // TODO: need confirm!!!
        return -1;
    }

    platform_delay_ms(once_delay);
    while(retry++ < 20){
	//wdg_feed();	//Feed watch dog.LYQ20220310
 	////("%s %d",__FUNCTION__,__LINE__);
        platform_delay_ms(poolgap);
        ret = semi_touch_read_bytes(0x20000000, (uint8_t*)ptr_rsp, sizeof(struct m_ctp_rsp_std_t));
        if(ret != 0){   // TODO: need confirm!!!
            return -1;
        }

        if(ptr_cmd->id != ptr_rsp->id){
            continue;
        }

        if(!caculate_checksum_u16((uint16_t*)ptr_rsp, sizeof(struct m_ctp_rsp_std_t))){
            if(0 == ptr_rsp->cc){      //success
                cmd_rsp_ok = 1;
            }
            break;
        }
    }

    if(!cmd_rsp_ok) ret = -SEMI_DRV_ERR_TIMEOUT;

    return ret;
}

/*
通过命令交互方式读取数据，一个命令单次最多1KB，超过1KB
的操作会被拆分为多次命令交互

返回值：
     0: 成功
其它值：失败
*/
int32_t semi_touch_nvm_read(uint8_t *pdes, uint32_t adr, uint32_t len)
{
    int32_t ret = -1;
    uint32_t left = len;
    uint32_t local_check, retry;
    struct m_ctp_cmd_std_t cmd_send_tp;
    struct m_ctp_rsp_std_t ack_from_tp;

    cmd_send_tp.id = CMD_MEM_RD;

    while (left) {
        len = (left > 1024) ? 1024 : left;

        cmd_send_tp.d0 = adr & 0xffff;
        cmd_send_tp.d1 = len;
        cmd_send_tp.d2 = 0;
        cmd_send_tp.d3 = NVM_R;
        cmd_send_tp.d5 = (adr >> 16) & 0xffff;

        retry = 0;
        while (retry++ < 3) {
            ack_from_tp.id = CMD_NA;
            ret = cmd_send_to_tp(&cmd_send_tp, &ack_from_tp, 20, 10);
            if(SEMI_DRV_ERR_OK != ret){
                continue;
            }

            semi_touch_read_bytes(TP_RD_BUFF_ADDR, pdes, len);

            local_check = caculate_checksum_ex(pdes, len);
            if ((ack_from_tp.d0 != (uint16_t)local_check) || 
                (ack_from_tp.d1 != (uint16_t)(local_check >> 16))){
                ret = -SEMI_DRV_ERR_CHECKSUM;
                continue;
            }
            break;
        }

        adr  += len;
        left -= len;
        pdes += len;
        if(ret != SEMI_DRV_ERR_OK){
            break;
        }
    }

    return (ret!=SEMI_DRV_ERR_OK)?-1:SEMI_DRV_ERR_OK;
}

int32_t semi_touch_nvm_write(uint8_t *psrc, uint32_t adr, uint32_t len)
{
    int32_t ret = -1;
    uint32_t left = len;
    uint32_t retry, combChk;
    struct m_ctp_cmd_std_t cmd_send_tp;
    struct m_ctp_rsp_std_t ack_from_tp;
	////("%s %d setup_ok:%d",__FUNCTION__,__LINE__,upd_st_dev.setup_ok);

    cmd_send_tp.id = CMD_MEM_WR;

    while (left) {
		//wdg_feed(); //Feed watch dog.LYQ20220310
		////("%s %d",__FUNCTION__,__LINE__);
        len = (left > 256) ? 256 : left;

        combChk = caculate_checksum_ex(psrc, len);

        cmd_send_tp.d0 = adr & 0xffff;    /* addrss space[0,64K)  */    
        cmd_send_tp.d1 = len;
        cmd_send_tp.d3 = NVM_W;
        cmd_send_tp.d2 = (uint16_t) combChk;
        cmd_send_tp.d4 = (uint16_t) (combChk >> 16);
        cmd_send_tp.d5 = (adr >> 16) & 0xffff;

        retry = 0;
        while (++retry <= 3) {
            ret = semi_touch_write_bytes(TP_WR_BUFF_ADDR, psrc, len);
            if(SEMI_DRV_ERR_OK != ret) continue;

            ack_from_tp.id = CMD_NA;
            ret = cmd_send_to_tp(&cmd_send_tp, &ack_from_tp, 200, 20);
            if(SEMI_DRV_ERR_OK != ret) continue;
            //check_break_if_fail(ret, NULL);

            break;
        }
        
        left -= len;
        adr  += len;
        psrc += len;
        if(SEMI_DRV_ERR_OK != ret){
            ret = -1;
            break;
        }
    }

    return ret;
}

int32_t semi_touch_burn_erase(void)
{
    int32_t ret = SEMI_DRV_ERR_OK;

    struct m_ctp_cmd_std_t cmd_send_tp;
    struct m_ctp_rsp_std_t ack_from_tp;

    cmd_send_tp.id = CMD_FLASH_ERASE;
    cmd_send_tp.d0 = 0x01;
 	////("%s %d",__FUNCTION__,__LINE__);

    return cmd_send_to_tp(&cmd_send_tp, &ack_from_tp, 1000, 20);
}

int32_t semi_touch_run_ram_code(const uint8_t* bin_code, uint16_t len)
{
    int32_t retry;
    int32_t ret = 0, reg_value = 0;

    for(retry = 0; retry < 5; retry++){
        //reset mcu
        semi_touch_reset();
        
 	   ////("%s %d",__FUNCTION__,__LINE__);
        //hold mcu
        reg_value = 0x12044000;
        ret = semi_touch_write_bytes(0x40007000, (uint8_t*)&reg_value, 4);
        if(ret < 0){
            continue;
        }

        //open auto feed
        reg_value = 0x0000925a;
        ret = semi_touch_write_bytes(0x40007010, (uint8_t*)&reg_value, 4);
        if(ret < 0){
            continue;
        }

        //run ramcode
        ret = semi_touch_write_core_and_check(0x20000000, bin_code, len);
        if(ret < 0){
            continue;
        }

        break;
    }
    if(ret < 0){
        return -1;
    }

    //remap
    reg_value = 0x12044002;
    ret = semi_touch_write_bytes(0x40007000, (uint8_t*)&reg_value, 4);
    if(ret < 0){
        return -1;
    }

    //release mcu
    reg_value = 0x12044003;
    ret = semi_touch_write_bytes(0x40007000, (uint8_t*)&reg_value, 4);
    if(ret < 0){
        return -1;
    }

    platform_delay_ms(30);

    return 0;
}

/*
    This function will put IC into NVM mode, call it carefully and must reset 
    the chip before entering normal mode.
*/
int32_t semi_touch_enter_burn_mode(void)
{
    struct m_ctp_cmd_std_t cmd_send_tp;
    struct m_ctp_rsp_std_t ack_from_tp;
 	////("%s %d",__FUNCTION__,__LINE__);
    ack_from_tp.d0 = 0;
    cmd_send_tp.id = CMD_IDENTITY;
    cmd_send_to_tp(&cmd_send_tp, &ack_from_tp, 20, 10);

    if((ack_from_tp.d0 == 0xE9A2) && (ack_from_tp.d1 == 0x165d)){
        upd_st_dev.ctp_run_status = CTP_UPGRAD_RUNING;
        return SEMI_DRV_ERR_OK;
    }

    if(semi_touch_run_ram_code(fw_5816_burn, sizeof(fw_5816_burn)) != 0){
        return -1;
    }

    cmd_send_tp.id = CMD_IDENTITY;
    if(cmd_send_to_tp(&cmd_send_tp, &ack_from_tp, 20, 10) != 0){
        return -1;
    }

    if((ack_from_tp.d0 == 0xE9A2) && (ack_from_tp.d1 == 0x165d)){
        upd_st_dev.ctp_run_status = CTP_UPGRAD_RUNING;
        return SEMI_DRV_ERR_OK;
    }

    upd_st_dev.ctp_run_status = CTP_POINTING_WORK;

    return -SEMI_DRV_ERR_HAL_IO;
}


int32_t semi_get_backup_pid(uint32_t *id)
{
    if(semi_touch_enter_burn_mode() != 0){
        return -1;
    }

    return semi_touch_nvm_read((uint8_t *)id, VID_PID_BACKUP_ADDR, 4);
}

int32_t semi_touch_check_boot_update(uint32_t boot_offset, uint32_t len, uint32_t match_offset, 
                                           uint32_t n_match, uint32_t force_update)
{
    uint32_t idlist;
    int32_t ret = SEMI_DRV_ERR_OK;
    int32_t k, idx_active;
    uint16_t upd_boot_ver = 0;
    const uint8_t *ptBoot;
    const uint8_t *ptMatch;

    ptBoot  = chsc_upd_data + boot_offset;
    ptMatch = chsc_upd_data + match_offset;
    if((ptBoot[0x30] != 0x16) || (ptBoot[0x31] != 0x58)){
        //("chsc::no chsc5816 found\n");
        return -1;
    }

    /*
        If we need to compare versions, only update the newer version
    */
    idx_active = -1;
    upd_boot_ver = (ptBoot[0x3f] << 8) + ptBoot[0x3e];
    for (k = 0; k < n_match; k++) {
        idlist = (uint32_t)ptMatch[3];
        idlist = (idlist<<8) + (uint32_t)ptMatch[2];
        idlist = (idlist<<8) + (uint32_t)ptMatch[1];
        idlist = (idlist<<8) + (uint32_t)ptMatch[0];
        ptMatch= ptMatch+4;
        //("chsc::pid_vid in list=0x%x\n", idlist);
        if ((idlist & 0xffffff00) == (upd_st_dev.vid_pid & 0xffffff00)) {
            if((upd_st_dev.fw_ver < upd_boot_ver) || force_update){   //版本比较
                idx_active = k;
            }
            break;
        }
    }

    if(idx_active >= 0) {
		//("%s %d",__FUNCTION__,__LINE__);
        if(semi_touch_enter_burn_mode() != 0){
            return -1;
        }

		//("%s %d",__FUNCTION__,__LINE__);
        if(semi_touch_burn_erase() != 0){
            return -1;
        }
		//("%s %d",__FUNCTION__,__LINE__);

        if(semi_touch_nvm_write((uint8_t *)ptBoot, 0x00000000, len) != 0){
            return -1;
        }

        semi_touch_setup_check();
    }
    
    return 0;
}

/*
    Return Value:
        0x01: reject caller's request
        -1  : some error
        0x00: successfull
*/
int32_t semi_touch_update_updfile(uint32_t force_update)
{
    int32_t ret = SEMI_DRV_ERR_OK;
    uint32_t boot_offset;
    uint32_t match_offset;
    uint8_t *ptHead;
    struct chsc_updfile_header upd_header;

    ptHead = (uint8_t *)&upd_header;
    for(boot_offset=0; boot_offset<sizeof(upd_header); boot_offset++){
        ptHead[boot_offset] = chsc_upd_data[boot_offset];
    }

    //("chsc::upd_header.sig=0x%x ,upd_header.n_match:%d\n",upd_header.sig,upd_header.n_match);
    if ((upd_header.sig != 0x43534843) || (upd_header.n_match == 0)) {
        return -SEMI_DRV_ERR_NOT_MATCH;
    }
	//("%s %d setup_ok:%d",__FUNCTION__,__LINE__,upd_st_dev.setup_ok);

    if ((upd_header.len_boot <= 15*1024) || (upd_header.len_boot >= 40*1024)) {
        return -SEMI_DRV_ERR_NOT_MATCH;
    }

    match_offset = sizeof(upd_header);
    boot_offset  = sizeof(upd_header) + (upd_header.n_match*4) + upd_header.len_cfg;
	//("%s %d setup_ok:%d",__FUNCTION__,__LINE__,upd_st_dev.setup_ok);

    ret = semi_touch_check_boot_update(boot_offset, upd_header.len_boot, match_offset, upd_header.n_match, force_update);

    return ret;
}

/*
    检测Chipsemi开机情况，以及版本比对，根据需要做自动更新功能
*/
int32_t semi_check_and_update(sm_touch_dev *st_dev)
{
    int32_t ret = -1; 
    uint32_t backup_vid_pid = 0;
	memcpy(&upd_st_dev,st_dev,sizeof(sm_touch_dev));
	//("%s %d setup_ok:%d",__FUNCTION__,__LINE__,upd_st_dev.setup_ok);
    if(upd_st_dev.setup_ok == 0){
        if(semi_get_backup_pid(&backup_vid_pid) != 0){
            return -1;
        }
		//("%s %d setup_ok:%d",__FUNCTION__,__LINE__,upd_st_dev.setup_ok);
        upd_st_dev.vid_pid = backup_vid_pid;
    }
	//("%s %d vid_pid:%d",__FUNCTION__,__LINE__,upd_st_dev.vid_pid);

    if((0 != upd_st_dev.vid_pid) && (0xffffffff != upd_st_dev.vid_pid)){
		//("%s %d setup_ok:%d",__FUNCTION__,__LINE__,upd_st_dev.setup_ok);
        ret = semi_touch_update_updfile(upd_st_dev.setup_ok ? 0 : 1);
    }else{ //we don't know what kind if product it is
        ret = -SEMI_DRV_ERR_NOT_MATCH;
    }

    return ret;
}











