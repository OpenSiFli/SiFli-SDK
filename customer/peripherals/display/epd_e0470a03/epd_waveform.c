/*
 * SPDX-FileCopyrightText: 2026 SiFli Technologies(Nanjing) Co., Ltd
 *
 * SPDX-License-Identifier: Apache-2.0
 */

#include <rtthread.h>
#include <rthw.h>
#include "epd_waveform.h"

#include "string.h"
#include <stdlib.h>

#ifdef EPD_WAVEFORM_USE_BIN
    #include "mem_map.h"
    #include "epd_waveform_bin_reader.h"
    #ifndef CUSTOM_EPD_WAVE_TABLE_START_ADDR
        #error "CUSTOM_EPD_WAVE_TABLE_START_ADDR is not defined!!!"
    #endif
#endif

static int g_part_disp_times = 10;      // 每 g_part_disp_times 次刷新做一次全刷，其余局刷
static int reflesh_times = 0;
static int s_force_full = 0;            // 一次性强制全刷标志（epd_wave_request_full 置位）
static unsigned s_since_full;

/* One LCD framebuffer: a queued transfer and the next UI submission. */
#define EPD_FRAME_MODE_CAPACITY 2
static EpdDrawMode s_frame_modes[EPD_FRAME_MODE_CAPACITY];
static unsigned s_frame_head;
static unsigned s_frame_count;

/* 强制使用静态波形表（跳过 bin 文件） */
static int force_static_wave = 0;

/* 手动控制波形模式 (-1=auto, 0~9=指定模式) */
static int manual_wave_mode = -1;

/* 波形模式名称 */
static const char *wave_mode_names[] =
{
    "mode0", "mode1", "mode2", "mode3", "mode4",
    "mode5", "mode6", "mode7", "mode8", "mode9"
};
#define WAVE_MODE_COUNT 10

/* 手动控制温区 (-1=auto, 0~n=指定温区) */
static int manual_temp_zone = 10;  // 默认第11个温区 (27~30°C)

/* 温区边界和名称（与 bin 波形文件一致） */
static const int temp_zones[] =
{
    -128, 0, 3, 6, 9, 12, 15, 18, 21, 24, 27, 30, 33, 38, 128
    };
static const char *temp_zone_names[] =
{
    "-128~0", "0~3", "3~6", "6~9", "9~12", "12~15",
    "15~18", "18~21", "21~24", "24~27", "27~30", "30~33",
    "33~38", "38~128"
};
#define TEMP_ZONE_COUNT (sizeof(temp_zones) / sizeof(temp_zones[0]) - 1)

/* 设置全刷周期：每 val 次刷新做一次全刷；val<=0 等效 1（每次全刷） */
void epd_wave_set_part_times(int val)
{
    val = val > 0 ? val : 1;
    rt_base_t level = rt_hw_interrupt_disable();
    if (g_part_disp_times != val)
    {
        g_part_disp_times = val;
        s_since_full = 0;
    }
    rt_hw_interrupt_enable(level);
}

/* 获取当前全刷周期 */
int epd_wave_get_part_times(void)
{
    rt_base_t level = rt_hw_interrupt_disable();
    int times = g_part_disp_times;
    rt_hw_interrupt_enable(level);
    return times;
}

/* 请求下一次刷新强制全刷（一次性） */
void epd_wave_request_full(void)
{
    rt_base_t level = rt_hw_interrupt_disable();
    s_force_full = 1;
    rt_hw_interrupt_enable(level);
}

void epd_wave_submit_frame(EpdDrawMode mode)
{
    rt_base_t level = rt_hw_interrupt_disable();
    RT_ASSERT(s_frame_count < EPD_FRAME_MODE_CAPACITY);
    if (s_force_full)
    {
        mode = EPD_DRAW_MODE_FULL;
        s_force_full = 0;
    }
    s_frame_modes[(s_frame_head + s_frame_count) % EPD_FRAME_MODE_CAPACITY] = mode;
    ++s_frame_count;
    rt_hw_interrupt_enable(level);
}

/* 获取/设置波形模式 */
int epd_wave_get_mode(void)
{
    return manual_wave_mode;
}

void epd_wave_set_mode(int mode)
{
    manual_wave_mode = mode;   // -1=auto, 0=full, 1=partial
}

/* 获取/设置温区 */
int epd_wave_get_tempzone(void)
{
    return manual_temp_zone;
}

void epd_wave_set_tempzone(int zone)
{
    manual_temp_zone = zone;   // -1=auto, 0~n=指定温区
}

// 8bit lookup table for the current frame (high 4 bits: old data, low 4 bits: new data).
// The output is 2-bit data.

typedef struct
{
    int min_temp;
    int max_temp;
    uint32_t frame_count;
    const uint8_t (*wave_table)[256];
} WaveTableEntry;


static const uint8_t yzc085_wave_full_0_100[32][256] =
{
    {0, 0, 0, 0, 0, 0, 0, 0, 0, 0, 0, 0, 0,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 0, 0},
    {0, 0, 0, 0, 0, 0, 0, 0, 0, 0, 0, 0, 0,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 0, 0},
    {0, 0, 0, 0, 0, 0, 0, 0, 0, 0, 0, 0, 0,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 0, 0},
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    {0, 0, 0, 0, 0, 0, 0, 0, 0, 0, 0, 0, 0,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 0, 0},
};

static const uint8_t yzc085_wave_partial_0_100[12][256] =
{
    //0,1,2,3,4,5,6,7,8,9,a,b,c,d,e,f,0,1,2,3,4,5,6,7,8,9,a,b,c,d,e,f,0,1,2,3,4,5,6,7,8,9,a,b,c,d,e,f,0,1,2,3,4,5,6,7,8,9,a,b,c,d,e,f,0,1,2,3,4,5,6,7,8,9,a,b,c,d,e,f,0,1,2,3,4,5,6,7,8,9,a,b,c,d,e,f,0,1,2,3,4,5,6,7,8,9,a,b,c,d,e,f,0,1,2,3,4,5,6,7,8,9,a,b,c,d,e,f,0,1,2,3,4,5,6,7,8,9,a,b,c,d,e,f,0,1,2,3,4,5,6,7,8,9,a,b,c,d,e,f,0,1,2,3,4,5,6,7,8,9,a,b,c,d,e,f,0,1,2,3,4,5,6,7,8,9,a,b,c,d,e,f,0,1,2,3,4,5,6,7,8,9,a,b,c,d,e,f,0,1,2,3,4,5,6,7,8,9,a,b,c,d,e,f,0,1,2,3,4,5,6,7,8,9,a,b,c,d,e,f,0,1,2,3,4,5,6,7,8,9,a,b,c,d,e,f,
    {0, 2, 2, 2, 2, 2, 2, 2, 2, 2, 2, 2, 2,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 0,},
    {0, 2, 2, 2, 2, 2, 2, 2, 2, 2, 2, 2, 2,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 0,},
    {0, 2, 2, 2, 2, 2, 2, 2, 2, 2, 2, 2, 1,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 0,},
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    {0, 0, 0, 0, 0, 0, 0, 0, 0, 0, 0, 0, 0,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 0,},

};
static const WaveTableEntry full_wave_table =
{0, 100, 32, &yzc085_wave_full_0_100[0]};

static const WaveTableEntry partial_wave_table =
{0, 100, 12, &yzc085_wave_partial_0_100[0]};

static const uint8_t *p_current_wave_from = NULL;
static rt_bool_t s_skip_unchanged_pixels = RT_FALSE;
#ifdef EPD_WAVEFORM_USE_BIN
    static uint8_t epd_waveform_bin_inited_ret = 0;
#endif

void epd_wave_table(void)
{
#ifdef EPD_WAVEFORM_USE_BIN
    epd_waveform_bin_inited_ret = waveform_bin_reader_init(CUSTOM_EPD_WAVE_TABLE_SIZE);

    if (epd_waveform_bin_inited_ret != 0)
    {
        rt_kprintf("Failed to initialize custom EPD wave table reader! err=%d\n", epd_waveform_bin_inited_ret);
    }
#endif
}

uint32_t epd_wave_table_get_frames(int temperature, EpdDrawMode mode)
{
    rt_base_t level = rt_hw_interrupt_disable();
    if (s_frame_count)
    {
        /* Later UI requests cannot change the mode of this queued LCD frame. */
        mode = s_frame_modes[s_frame_head];
        s_frame_head = (s_frame_head + 1) % EPD_FRAME_MODE_CAPACITY;
        --s_frame_count;
    }
    else if (s_force_full)
    {
        /* Direct LCD draws outside LVGL still support manual full refresh. */
        mode = EPD_DRAW_MODE_FULL;
        s_force_full = 0;
    }
    reflesh_times++;

    /* The first frame always clears the panel; later frames use their queued mode. */
    if (reflesh_times == 1)
    {
        mode = EPD_DRAW_MODE_FULL;
    }
    // AUTO 模式：每 g_part_disp_times 次做一次全刷，其余局刷
    else if (EPD_DRAW_MODE_AUTO == mode)
    {
        mode = (++s_since_full >= (unsigned)g_part_disp_times)
               ? EPD_DRAW_MODE_FULL
               : EPD_DRAW_MODE_PARTIAL;
    }
    if (mode == EPD_DRAW_MODE_FULL) s_since_full = 0;
    rt_hw_interrupt_enable(level);

    /* Full refresh follows navigation, explicit requests or the partial-refresh limit. */
    rt_kprintf("EPD: refresh #%d -> %s\n", reflesh_times,
               (EPD_DRAW_MODE_PARTIAL == mode) ? "PARTIAL" : "FULL");

#ifdef EPD_WAVEFORM_USE_BIN
    if (epd_waveform_bin_inited_ret == 0 && force_static_wave == 0)
    {
        WAVE_TABLE_MODE_T wave_table_mode;

        // 手动波形模式覆盖 (0~9)
        if (manual_wave_mode >= 0 && manual_wave_mode < WAVE_MODE_COUNT)
        {
            // 直接使用用户选择的模式
            wave_table_mode = (WAVE_TABLE_MODE_T)manual_wave_mode;
        }
        else
        {
            // 自动根据 EpdDrawMode 映射
            wave_table_mode = (EPD_DRAW_MODE_PARTIAL == mode)
                              ? WAVE_MODE_PARTIAL
                              : WAVE_MODE_FULL;
        }

        /* Full and initialization waveforms must retain their clearing pulses. */
        s_skip_unchanged_pixels = (mode == EPD_DRAW_MODE_PARTIAL &&
                                   wave_table_mode == WAVE_MODE_PARTIAL);

        // 手动温区覆盖：根据温区索引设置温度值
        int actual_temperature = temperature;
        if (manual_temp_zone >= 0 && manual_temp_zone < TEMP_ZONE_COUNT)
        {
            // 使用温区中间值作为温度
            actual_temperature = (temp_zones[manual_temp_zone] + temp_zones[manual_temp_zone + 1]) / 2;
        }

        // 显示当前温区和模式信息
        rt_kprintf("EPD: temp=%d->%d, zone=%d, mode=%d(%s), static=%d\n",
                   temperature, actual_temperature, manual_temp_zone,
                   wave_table_mode,
                   wave_table_mode < WAVE_MODE_COUNT ?
                   wave_mode_names[wave_table_mode] : "unknown",
                   force_static_wave);

        return waveform_bin_reader_get_frames(actual_temperature, wave_table_mode);
    }
#endif

    const WaveTableEntry *wave_table = NULL;
    if (EPD_DRAW_MODE_PARTIAL == mode)
    {
        wave_table = &partial_wave_table;
    }
    else
    {
        wave_table = &full_wave_table;
    }

    if (temperature < wave_table->min_temp || temperature >= wave_table->max_temp)
    {
        wave_table = &full_wave_table;
    }
    p_current_wave_from = (const uint8_t *)&wave_table->wave_table[0][0];
    s_skip_unchanged_pixels = (wave_table == &partial_wave_table);

    return wave_table->frame_count;
}

void epd_wave_table_fill_lut(uint32_t *p_argb8888_lut, uint32_t frame_num)
{
#ifdef EPD_WAVEFORM_USE_BIN
    if (epd_waveform_bin_inited_ret == 0 && force_static_wave == 0)
    {
        waveform_bin_reader_fill_lut(p_argb8888_lut, frame_num);
        // BIN fill_lut puts values at bit[4:3] (for EPIC), but EPD_8BIT + F2_SWAP
        // hardware reads bit[1:0]. Shift and set alpha to match non-BIN format.
        for (uint16_t i = 0; i < 256; i++)
            p_argb8888_lut[i] = (p_argb8888_lut[i] >> 3) | 0xFF000000;
    }
    else
#endif
    {
        const uint8_t *p_frame_wave = p_current_wave_from + (frame_num * 256);

        //Convert the 8-bit waveforms to 32-bit epic LUT values
        for (uint16_t i = 0; i < 256; i++)
            p_argb8888_lut[i] = 0xFF000000 | p_frame_wave[i];
    }

    if (s_skip_unchanged_pixels)
    {
        /* Index = old gray << 4 | new gray. Keep alpha opaque and drive bits zero. */
        for (uint16_t gray = 0; gray < 16; gray++)
            p_argb8888_lut[(gray << 4) | gray] = 0xFF000000;
    }
}

/* finsh 命令: staticwave <0|1>
 *   0=使用 bin 波形（默认）, 1=强制使用静态波形表
 */
static int cmd_staticwave(int argc, char **argv)
{
    if (argc < 2)
    {
        rt_kprintf("Usage: staticwave <0|1>\n");
        rt_kprintf("  0=use bin waveform (default)\n");
        rt_kprintf("  1=force static waveform table (yzc085_wave_full_0_100)\n");
        rt_kprintf("  current: %s\n", force_static_wave ? "static" : "bin");
        return 0;
    }

    force_static_wave = atoi(argv[1]) ? 1 : 0;
    rt_kprintf("StaticWave: %s\n", force_static_wave ? "force static waveform" : "use bin waveform");
    return 0;
}
MSH_CMD_EXPORT(cmd_staticwave, force use static waveform table);

/* finsh 命令: wmode <auto|0|1|...|9>
 *   设置波形模式
 */
static int cmd_wmode(int argc, char **argv)
{
    if (argc < 2)
    {
        rt_kprintf("Usage: wmode <auto|0|1|...|9>\n");
        rt_kprintf("  auto = 自动切换（默认）\n");
        for (int i = 0; i < WAVE_MODE_COUNT; i++)
            rt_kprintf("  %d    = %s\n", i, wave_mode_names[i]);
        rt_kprintf("  current: %s\n",
                   manual_wave_mode == -1 ? "auto" :
                   (manual_wave_mode < WAVE_MODE_COUNT ?
                    wave_mode_names[manual_wave_mode] : "unknown"));
        return 0;
    }

    if (strcmp(argv[1], "auto") == 0)
    {
        manual_wave_mode = -1;
    }
    else
    {
        int mode = atoi(argv[1]);
        if (mode < 0 || mode >= WAVE_MODE_COUNT)
        {
            rt_kprintf("Invalid mode: %s (valid: 0~%d)\n", argv[1], WAVE_MODE_COUNT - 1);
            return -1;
        }
        manual_wave_mode = mode;
    }

    rt_kprintf("WaveMode: %s\n",
               manual_wave_mode == -1 ? "auto" :
               (manual_wave_mode < WAVE_MODE_COUNT ?
                wave_mode_names[manual_wave_mode] : "unknown"));
    return 0;
}
MSH_CMD_EXPORT(cmd_wmode, set EPD wave mode);

/* finsh 命令: parttime [n]
 *   查看/设置全刷周期（每 n 次刷新做一次全刷；0=每次全刷）
 */
static int cmd_parttime(int argc, char **argv)
{
    if (argc < 2)
    {
        rt_kprintf("full refresh period: every %d refresh(es)\n", epd_wave_get_part_times());
        rt_kprintf("usage: parttime <n>  (n>=1; 0 = every refresh is full)\n");
        return 0;
    }

    epd_wave_set_part_times(atoi(argv[1]));
    rt_kprintf("full refresh period set: every %d refresh(es)\n", epd_wave_get_part_times());
    return 0;
}
MSH_CMD_EXPORT(cmd_parttime, get / set EPD full refresh period);

/* finsh 命令: fullrefresh
 *   请求下一次刷新强制全刷（清残影）
 */
static int cmd_fullrefresh(int argc, char **argv)
{
    (void)argc;
    (void)argv;
    epd_wave_request_full();
    rt_kprintf("next refresh will be FULL\n");
    return 0;
}
MSH_CMD_EXPORT(cmd_fullrefresh, force next EPD refresh to full);

/* finsh 命令: tempzone <auto|0|1|...>
 *   设置温区
 */
static int cmd_tempzone(int argc, char **argv)
{
    if (argc < 2)
    {
        rt_kprintf("Usage: tempzone <auto|0|1|...>\n");
        rt_kprintf("  auto = 自动根据温度选择（默认）\n");
        for (int i = 0; i < TEMP_ZONE_COUNT; i++)
            rt_kprintf("  %2d   = %s°C\n", i, temp_zone_names[i]);
        rt_kprintf("  current: %s\n",
                   manual_temp_zone == -1 ? "auto" :
                   (manual_temp_zone < TEMP_ZONE_COUNT ?
                    temp_zone_names[manual_temp_zone] : "unknown"));
        return 0;
    }

    if (strcmp(argv[1], "auto") == 0)
    {
        manual_temp_zone = -1;
    }
    else
    {
        int zone = atoi(argv[1]);
        if (zone < 0 || zone >= TEMP_ZONE_COUNT)
        {
            rt_kprintf("Invalid zone: %s (valid: 0~%d)\n", argv[1], TEMP_ZONE_COUNT - 1);
            return -1;
        }
        manual_temp_zone = zone;
    }

    rt_kprintf("TempZone: %s\n",
               manual_temp_zone == -1 ? "auto" :
               (manual_temp_zone < TEMP_ZONE_COUNT ?
                temp_zone_names[manual_temp_zone] : "unknown"));
    return 0;
}
MSH_CMD_EXPORT(cmd_tempzone, set EPD temperature zone);

/* finsh 命令: halt
 *   暂停 EPD 刷新
 */
static int cmd_halt(int argc, char **argv)
{
    rt_kprintf("EPD halt - system halted\n");
    rt_enter_critical();
    while (1)
    {
        rt_thread_mdelay(1000);
    }
    return 0;
}
MSH_CMD_EXPORT(cmd_halt, halt EPD refresh);
