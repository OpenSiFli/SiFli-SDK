## example/hal/hash/testcase.yaml
```yaml
# SPDX-FileCopyrightText: 2026 SiFli Technologies(Nanjing) Co., Ltd
# SPDX-License-Identifier: Apache-2.0
# example/hal/hash runs SHA1, SHA224, SHA256 and SM3 over one fixed input string in polling mode,
# then SHA1 in interrupt mode and SHA1 again in 64-byte chunks with the previous result as IV.

tests:
  - id: hash.boot
    description: Hash one fixed buffer with SHA1, SHA224, SHA256 and SM3 and check every digest against its known-answer vector
    harness: console
    tags: [console, hal, hash, smoke]
    timeout: 120
    platform_allow:
      - sf32lb52-lcd_52d
      - sf32lb52-lcd_a128r16
      - sf32lb52-lcd_n16r8
      - sf32lb52-lcd_n16r8_jdi
      - sf32lb56-lcd_a128r12n1
      - sf32lb56-lcd_n16r12n1
    integration_platforms: [sf32lb52-lcd_n16r8, sf32lb56-lcd_n16r12n1]
    project_dir: project
    harness_config:
      record:
        - 'Input raw data:'
        - '0x54, 0x68, 0x69, 0x73, 0x20, 0x69, 0x73, 0x20,'
        - 'SHA1:'
        - 'HASH Result:'
        - '0x8a, 0x50, 0x60, 0xae, 0x38, 0xfd, 0x7c, 0x73,'
        - '0x5b, 0x85, 0x53, 0x41, 0x51, 0x99, 0x77, 0xb7,'
        - '0x8f, 0x91, 0xee, 0x70,'
        - 'SHA224:'
        - 'HASH Result:'
        - '0x08, 0xef, 0x97, 0x98, 0x25, 0x90, 0xc4, 0xa2,'
        - '0x01, 0xb7, 0xb1, 0x82, 0x4b, 0x6f, 0x24, 0xfc,'
        - '0x5d, 0x0a, 0xab, 0x8b, 0x96, 0xcc, 0xd2, 0x61,'
        - '0xeb, 0xb8, 0x10, 0x94,'
        - 'SHA256:'
        - 'HASH Result:'
        - '0xea, 0x72, 0x91, 0xbd, 0xbe, 0xb1, 0x6b, 0xe7,'
        - '0x9c, 0xe2, 0xbf, 0xf4, 0xfa, 0x40, 0x12, 0x35,'
        - '0xfc, 0xbd, 0x44, 0x24, 0xb9, 0x5c, 0x09, 0xb0,'
        - '0x10, 0x67, 0x62, 0x76, 0x8e, 0xdb, 0xc5, 0x41,'
        - 'SM3:'
        - 'HASH Result:'
        - '0xfc, 0xf6, 0x99, 0x0c, 0x78, 0xb2, 0x0c, 0x4f,'
        - '0xf2, 0x54, 0x5e, 0xf0, 0xdd, 0x64, 0xd3, 0x36,'
        - '0x2a, 0x98, 0xdb, 0x91, 0x74, 0x7d, 0x29, 0xaa,'
        - '0x33, 0x53, 0xa7, 0x9d, 0xae, 0xa6, 0x6b, 0x65,'
        - 'SHA1\(IT\):'
        - 'HASH Result\(IT\):'
        - '0x8a, 0x50, 0x60, 0xae, 0x38, 0xfd, 0x7c, 0x73,'
        - '0x5b, 0x85, 0x53, 0x41, 0x51, 0x99, 0x77, 0xb7,'
        - '0x8f, 0x91, 0xee, 0x70,'
        - 'SHA1\(multiple\):'
        - 'HASH Result\(multiple\):'
        - '0x8a, 0x50, 0x60, 0xae, 0x38, 0xfd, 0x7c, 0x73,'
        - '0x5b, 0x85, 0x53, 0x41, 0x51, 0x99, 0x77, 0xb7,'
        - '0x8f, 0x91, 0xee, 0x70,'
```

## example/hal/hwtimer/testcase.yaml
```yaml
# SPDX-FileCopyrightText: 2026 SiFli Technologies(Nanjing) Co., Ltd
# SPDX-License-Identifier: Apache-2.0
# example/hal/hwtimer exercises GPTIM1, ATIM1 and BTIM1 in single and repetitive mode, 3.5 s per
# period, all from main().

tests:
  - id: hwtimer.boot
    description: Run the GPTIM, ATIM and BTIM single and repetitive timers and check every interrupt count and END marker
    harness: console
    tags: [console, hal, hwtimer, smoke]
    timeout: 240
    platform_allow:
      - sf32lb52-lcd_52d
      - sf32lb52-lcd_a128r16
      - sf32lb52-lcd_n16r8
      - sf32lb52-lcd_n16r8_jdi
      - sf32lb56-lcd_a128r12n1
      - sf32lb56-lcd_n16r12n1
      - sf32lb58-lcd_a128r32n1_a1_dsi
      - sf32lb58-lcd_a128r32n1_dsi
      - sf32lb58-lcd_a128r32n1_qspi
      - sf32lb58-lcd_e4r32n1_dsi
      - sf32lb58-lcd_n16r16n1_qspi
      - sf32lb58-lcd_n16r32n1_a1_dpi
      - sf32lb58-lcd_n16r32n1_a1_dsi
      - sf32lb58-lcd_n16r32n1_dpi
      - sf32lb58-lcd_n16r32n1_dsi
      - sf32lb58-lcd_n16r32n1_qspi
      - sf32lb58-lcd_n16r64n4
    integration_platforms: [sf32lb52-lcd_n16r8, sf32lb56-lcd_n16r12n1, sf32lb58-lcd_n16r32n1_dpi]
    project_dir: project
    harness_config:
      record:
        - 'HWTIM Example:'
        - 'GPTIM1: SINGLE\. Timeout is 3\.5 seconds'
        - 'Prescaler:\d+ PCLK:\d+ period:35000'
        - 'Timer init ok'
        - 'GPTIM1 timeout \d+'
        - 'GPTIM1: SINGLE\. END\.'
        - 'GPTIM1: REPETITIVE\. Timeout is 3\.5 seconds \* 10 times\.'
        - 'Prescaler:\d+ PCLK:\d+ period:35000'
        - 'Timer init ok'
        - regex: 'GPTIM1 timeout \d+'
          repeat: 10
        - 'GPTIM1: REPETITIVE\. END\.'
        - 'ATIM1: SINGLE\. Timeout is 3\.5 seconds'
        - 'Prescaler:\d+ PCLK:\d+ period:35000'
        - 'Timer init ok'
        - 'ATIM1 timeout \d+'
        - 'ATIM1: SINGLE\. END\.'
        - 'ATIM1: REPETITIVE\. Timeout is \(3\.5 \* 10\) seconds\.'
        - 'Prescaler:\d+ PCLK:\d+ period:35000'
        - 'Timer init ok'
        - 'ATIM1 timeout \d{5,}'
        - 'ATIM1: END\.'
        - 'BTIM1: SINGLE\. Timeout is 3\.5 seconds'
        - 'Prescaler:\d+ PCLK:\d+ period:35000'
        - 'Timer init ok'
        - 'BTIM1 timeout \d+'
        - 'BTIM1: SINGLE\. END\.'
        - 'BTIM1: REPETITIVE\. Timeout is 3\.5 seconds \* 10 times\.'
        - 'Prescaler:\d+ PCLK:\d+ period:35000'
        - 'Timer init ok'
        - regex: 'BTIM1 timeout \d+'
          repeat: 10
        - 'BTIM1: REPETITIVE\. END\.'
```
