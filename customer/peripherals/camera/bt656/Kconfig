## customer/peripherals/camera/bt656/Kconfig
```kconfig
menuconfig BSP_USING_BT656
    bool "BT.656 Camera"
    depends on SOC_SF32LB57X
    depends on !BSP_USING_DCMI
    select BSP_USING_I2C
    select BSP_USING_I2C1
    default n
    help
      Enable the generic BT.656 capture layer (bt656.c): HAL_DCMI capture,
      multi-buffer borrow/return and a decoder chip adapter.

      A decoder chip must be selected below before an application can
      capture frames. The capture layer talks to HAL_DCMI directly and owns
      the DCMI interrupt vector, so it cannot be built together with the
      RT-Thread "dcmi" device driver (CONFIG_BSP_USING_DCMI).

if BSP_USING_BT656

choice
    prompt "Decoder chip"
    default BSP_USING_ARK7128
    help
      Select the BT.656 decoder mounted on the board.

config BSP_USING_ARK7128
    bool "ARK7128"

endchoice

if BSP_USING_ARK7128

config ARK7128_I2C_BUS_NAME
    string "I2C bus name"
    default "i2c1"
    help
      Name of the RT-Thread I2C bus device used to control the decoder, as
      registered by drv_i2c (for example "i2c1", "i2c2"). The selected bus
      must be enabled separately under Board Peripherals -> I2C. The default
      matches the dpi-hdk-lb57e wiring (I2C1, SCL PA23 / SDA PA22).

choice
    prompt "Video input format"
    default ARK7128_VIDEO_CVBS_NTSC
    help
      Select the format of the video source connected to the board.
      The driver picks the matching register table, geometry and DCMI
      synchronization codes from ark7128_cfg.c.

config ARK7128_VIDEO_CVBS_NTSC
    bool "CVBS NTSC (720x240)"

config ARK7128_VIDEO_CVBS_PAL
    bool "CVBS PAL (720x288)"

config ARK7128_VIDEO_AHD_720P_25
    bool "AHD 720P 25fps"

config ARK7128_VIDEO_AHD_720P_30
    bool "AHD 720P 30fps"

endchoice

endif

endif
```

## example/hal/adc/adc_battery/testcase.yaml
```yaml
# SPDX-FileCopyrightText: 2026 SiFli Technologies(Nanjing) Co., Ltd
# SPDX-License-Identifier: Apache-2.0
# adc_battery samples one ADC channel and prints the calibrated voltage once a second.
# res 1 means the factory calibration loaded; the voltage value itself is not checked.

tests:
  - id: adc_adc_battery.boot
    description: the example starts, calibrates the ADC and logs one battery voltage per second
    harness: console
    tags: [console, hal, adc_adc_battery, smoke]
    timeout: 120
    project_dir: project
    platform_allow:
      - sf32lb52-lcd_52d
      - sf32lb52-lcd_a128r16
      - sf32lb52-lcd_n16r8
      - sf32lb52-lcd_n16r8_jdi
      - sf32lb56-lcd_a128r12n1
      - sf32lb56-lcd_n16r12n1
      - sf32lb58-lcd_a128r32n1_a1_dsi
      - sf32lb58-lcd_a128r32n1_dsi
      - sf32lb58-lcd_a128r32n1_qspi
      - sf32lb58-lcd_e4r32n1_dsi
      - sf32lb58-lcd_n16r16n1_qspi
      - sf32lb58-lcd_n16r32n1_a1_dpi
      - sf32lb58-lcd_n16r32n1_a1_dsi
      - sf32lb58-lcd_n16r32n1_dpi
      - sf32lb58-lcd_n16r32n1_dsi
      - sf32lb58-lcd_n16r32n1_qspi
      - sf32lb58-lcd_n16r64n4
      - sf32lb57-lcd_n16r16_dpi
      - sf32lb57-lcd_n16r16_qspi
      - sf32lb57-lcd_n16r8_dpi
      - sf32lb57-epd_n16r16
    integration_platforms: [sf32lb52-lcd_n16r8]
    harness_config:
      record:
        - 'Start adc demo!'
        - 'ADC Get calibration res 1'
        - 'battery voltage [\d.]+ mv'
```

## example/hal/aes/testcase.yaml
```yaml
# SPDX-FileCopyrightText: 2026 SiFli Technologies(Nanjing) Co., Ltd
# SPDX-License-Identifier: Apache-2.0
# aes is a self-checking example: main() encrypts a fixed 16-byte plaintext in CBC, CTR, ECB and
# CBC-interrupt mode and dumps plaintext, ciphertext and the decrypted result with dump_hex().
# Negative check: change one byte of the plaintext in src/main.c and the ciphertext lines below no
# longer match, so aes.boot must go red.

tests:
  - id: aes.boot
    description: CBC, CTR, ECB and interrupt-mode AES produce the README's ciphertext vectors
    harness: console
    tags: [console, hal, aes, smoke]
    timeout: 120
    project_dir: project
    platform_allow:
      - sf32lb52-lcd_52d
      - sf32lb52-lcd_a128r16
      - sf32lb52-lcd_n16r8
      - sf32lb52-lcd_n16r8_jdi
      - sf32lb56-lcd_a128r12n1
      - sf32lb56-lcd_n16r12n1
      - sf32lb58-lcd_a128r32n1_a1_dsi
      - sf32lb58-lcd_a128r32n1_dsi
      - sf32lb58-lcd_a128r32n1_qspi
      - sf32lb58-lcd_e4r32n1_dsi
      - sf32lb58-lcd_n16r16n1_qspi
      - sf32lb58-lcd_n16r32n1_a1_dpi
      - sf32lb58-lcd_n16r32n1_a1_dsi
      - sf32lb58-lcd_n16r32n1_dpi
      - sf32lb58-lcd_n16r32n1_dsi
      - sf32lb58-lcd_n16r32n1_qspi
      - sf32lb58-lcd_n16r64n4
    integration_platforms: [sf32lb52-lcd_n16r8]
    harness_config:
      record:
        - 'AES CBC Mode:'
        - 'Raw data:'
        - '0x43, 0x4a, 0x4b, 0x2f, 0x31, 0x38, 0x32, 0x31,'
        - '0x39, 0x31, 0x31, 0x32, 0x31, 0x35, 0x36, 0x2e,'
        - 'Encry\. ciphertext:'
        - '0xd5, 0xb2, 0xe1, 0x75, 0x68, 0x6d, 0xb2, 0x03,'
        - '0x63, 0x96, 0xe1, 0x70, 0xc3, 0xf9, 0xf4, 0xf3,'
        - 'Decry\. plaintext:'
        - '0x43, 0x4a, 0x4b, 0x2f, 0x31, 0x38, 0x32, 0x31,'
        - '0x39, 0x31, 0x31, 0x32, 0x31, 0x35, 0x36, 0x2e,'
        - 'AES CTR Mode:'
        - 'Encry\. ciphertext:'
        - '0x86, 0xe9, 0x35, 0x58, 0xb9, 0xdd, 0x7d, 0x0b,'
        - '0x74, 0x85, 0x6c, 0x07, 0x1a, 0xe1, 0xbd, 0x9c,'
        - 'Decry\. plaintext:'
        - '0x43, 0x4a, 0x4b, 0x2f, 0x31, 0x38, 0x32, 0x31,'
        - '0x39, 0x31, 0x31, 0x32, 0x31, 0x35, 0x36, 0x2e,'
        - 'AES ECB Mode:'
        - 'Encry\. ciphertext:'
        - '0x6d, 0xf0, 0x28, 0xcd, 0x3c, 0xf5, 0x29, 0x79,'
        - '0x85, 0x06, 0xb9, 0xba, 0x35, 0x34, 0xf9, 0x46,'
        - 'Decry\. plaintext:'
        - '0x43, 0x4a, 0x4b, 0x2f, 0x31, 0x38, 0x32, 0x31,'
        - '0x39, 0x31, 0x31, 0x32, 0x31, 0x35, 0x36, 0x2e,'
        - 'AES encryption interrupt mode:'
        - 'Encry\. ciphertext:'
        - '0xd5, 0xb2, 0xe1, 0x75, 0x68, 0x6d, 0xb2, 0x03,'
        - '0x63, 0x96, 0xe1, 0x70, 0xc3, 0xf9, 0xf4, 0xf3,'
```

## example/hal/crc/testcase.yaml
```yaml
# SPDX-FileCopyrightText: 2026 SiFli Technologies(Nanjing) Co., Ltd
# SPDX-License-Identifier: Apache-2.0
# crc is a self-checking example: main() dumps a fixed input buffer and then walks every hardware
# CRC mode, printing the result of each.
# Negative check: change one byte of the input buffer in src/main.c and every result below
# changes, so crc.boot must go red.

tests:
  - id: crc.boot
    description: all 16 hardware CRC modes and the custom polynomial return the documented vectors
    harness: console
    tags: [console, hal, crc, smoke]
    timeout: 120
    project_dir: project
    platform_allow:
      - sf32lb52-lcd_52d
      - sf32lb52-lcd_a128r16
      - sf32lb52-lcd_n16r8
      - sf32lb52-lcd_n16r8_jdi
      - sf32lb56-lcd_a128r12n1
      - sf32lb56-lcd_n16r12n1
      - sf32lb58-lcd_a128r32n1_a1_dsi
      - sf32lb58-lcd_a128r32n1_dsi
      - sf32lb58-lcd_a128r32n1_qspi
      - sf32lb58-lcd_e4r32n1_dsi
      - sf32lb58-lcd_n16r16n1_qspi
      - sf32lb58-lcd_n16r32n1_a1_dpi
      - sf32lb58-lcd_n16r32n1_a1_dsi
      - sf32lb58-lcd_n16r32n1_dpi
      - sf32lb58-lcd_n16r32n1_dsi
      - sf32lb58-lcd_n16r32n1_qspi
      - sf32lb58-lcd_n16r64n4
    integration_platforms: [sf32lb52-lcd_n16r8]
    harness_config:
      record:
        - 'Input raw data:'
        - '0x54, 0x68, 0x69, 0x73, 0x20, 0x69, 0x73, 0x20,'
        - 'CRC Result\(mode:0\):\s*0x61\b'
        - 'CRC Result\(mode:1\):\s*0x62\b'
        - 'CRC Result\(mode:2\):\s*0x37\b'
        - 'CRC Result\(mode:3\):\s*0xCD\b'
        - 'CRC Result\(mode:4\):\s*0xBA\b'
        - 'CRC Result\(mode:5\):\s*0x5263\b'
        - 'CRC Result\(mode:6\):\s*0xAD9C\b'
        - 'CRC Result\(mode:7\):\s*0x72F2\b'
        - 'CRC Result\(mode:8\):\s*0x8D0D\b'
        - 'CRC Result\(mode:9\):\s*0xFC57\b'
        - 'CRC Result\(mode:10\):\s*0xBED\b'
        - 'CRC Result\(mode:11\):\s*0xA52A\b'
        - 'CRC Result\(mode:12\):\s*0x4A88\b'
        - 'CRC Result\(mode:13\):\s*0xD423\b'
        - 'CRC Result\(mode:14\):\s*0x15B6B604\b'
        - 'CRC Result\(mode:15\):\s*0x42F1290F\b'
        - 'CRC Result\(CRC_8 initial value:0xFF poly:0x1D\):\s*0x45\b'
```

## example/hal/ezip/testcase.yaml
```yaml
# SPDX-FileCopyrightText: 2026 SiFli Technologies(Nanjing) Co., Ltd
# SPDX-License-Identifier: Apache-2.0
# example/hal/ezip decompresses four embedded images from main() and compares each result with a
# reference buffer: EZIP AHB polling, EZIP AHB interrupt, LZ4 AHB polling, GZIP AHB polling.

tests:
  - id: ezip.boot
    description: Decompress the four embedded EZIP/LZ4/GZIP images and verify every output buffer
    harness: console
    tags: [console, hal, ezip, smoke]
    timeout: 120
    platform_allow:
      - sf32lb52-lcd_52d
      - sf32lb52-lcd_a128r16
      - sf32lb52-lcd_n16r8
      - sf32lb52-lcd_n16r8_jdi
      - sf32lb56-lcd_a128r12n1
      - sf32lb56-lcd_n16r12n1
      - sf32lb58-lcd_a128r32n1_a1_dsi
      - sf32lb58-lcd_a128r32n1_dsi
      - sf32lb58-lcd_a128r32n1_qspi
      - sf32lb58-lcd_e4r32n1_dsi
      - sf32lb58-lcd_n16r16n1_qspi
      - sf32lb58-lcd_n16r32n1_a1_dpi
      - sf32lb58-lcd_n16r32n1_a1_dsi
      - sf32lb58-lcd_n16r32n1_dpi
      - sf32lb58-lcd_n16r32n1_dsi
      - sf32lb58-lcd_n16r32n1_qspi
      - sf32lb58-lcd_n16r64n4
      - sf32lb57-lcd_n16r16_dpi
      - sf32lb57-lcd_n16r16_qspi
      - sf32lb57-lcd_n16r8_dpi
      - sf32lb57-epd_n16r16
    integration_platforms: [sf32lb52-lcd_n16r8, sf32lb56-lcd_n16r12n1, sf32lb58-lcd_n16r32n1_dpi, sf32lb57-lcd_n16r16_dpi]
    project_dir: project
    harness_config:
      record:
        - '\[EZIP\]EZIP Example:'
        - '\[EZIP\]EZIP initialization OK\.'
        - '\[EZIP\]EZIP AHB \(polling mode\)\.'
        - '\[EZIP\]Output is correct\.'
        - '\[EZIP\]EZIP AHB \(polling mode\) +--- end\.'
        - '\[EZIP\]EZIP AHB \(intrInterrupt mode\)\.'
        - '\[EZIP\]ezip_done\.'
        - '\[EZIP\]Output is correct\.'
        - '\[EZIP\]EZIP AHB \(intrInterrupt mode\) +--- end\.'
        - '\[EZIP\]LZ4 AHB \(polling mode\)\.'
        - '\[EZIP\]Output is correct\.'
        - '\[EZIP\]LZ4 AHB \(polling mode\) +--- end\.'
        - '\[EZIP\]GZIP AHB \(polling mode\)\.'
        - '\[EZIP\]Output is correct\.'
        - '\[EZIP\]GZIP AHB \(polling mode\) +--- end\.'
```

## example/hal/facc/testcase.yaml
```yaml
# SPDX-FileCopyrightText: 2026 SiFli Technologies(Nanjing) Co., Ltd
# SPDX-License-Identifier: Apache-2.0
# example/hal/facc runs one FIR pass through the FACC accelerator in main() and compares the
# 1024-byte output with a reference table.

tests:
  - id: facc.boot
    description: Run one FIR filter through FACC and check the result against the reference table
    harness: console
    tags: [console, hal, facc, smoke]
    timeout: 120
    platform_allow:
      - sf32lb56-lcd_a128r12n1
      - sf32lb56-lcd_n16r12n1
      - sf32lb58-lcd_a128r32n1_a1_dsi
      - sf32lb58-lcd_a128r32n1_dsi
      - sf32lb58-lcd_a128r32n1_qspi
      - sf32lb58-lcd_e4r32n1_dsi
      - sf32lb58-lcd_n16r16n1_qspi
      - sf32lb58-lcd_n16r32n1_a1_dpi
      - sf32lb58-lcd_n16r32n1_a1_dsi
      - sf32lb58-lcd_n16r32n1_dpi
      - sf32lb58-lcd_n16r32n1_dsi
      - sf32lb58-lcd_n16r32n1_qspi
      - sf32lb58-lcd_n16r64n4
    integration_platforms: [sf32lb56-lcd_n16r12n1, sf32lb58-lcd_n16r64n4]
    project_dir: project
    harness_config:
      record:
        - 'Start facc!'
        - 'FACC_OK'
```

## example/hal/fft/simple/testcase.yaml
```yaml
# SPDX-FileCopyrightText: 2026 SiFli Technologies(Nanjing) Co., Ltd
# SPDX-License-Identifier: Apache-2.0
# example/hal/fft/simple runs three transforms in main() - real FFT, complex FFT and the
# forward+inverse pair of test_inverse_fft() - and prints the first 128 result words in hex.

tests:
  - id: fft_simple.boot
    description: Run the real, complex and inverse FFT tests and check each transform completes with the documented head word
    harness: console
    tags: [console, hal, fft_simple, smoke]
    timeout: 120
    platform_allow: [sf32lb56-lcd_a128r12n1, sf32lb58-lcd_n16r32n1_dpi]
    integration_platforms: [sf32lb56-lcd_a128r12n1, sf32lb58-lcd_n16r32n1_dpi]
    project_dir: project
    harness_config:
      record:
        - 'FFT HAL Module Example'
        - 'FFT Example: Using FFT1 \(HCPU\)'
        - 'FFT initialization successful'
        - '=== Real FFT Test ==='
        - 'Real FFT completed successfully'
        - '\[0\] = 0x0B73'
        - '=== Complex FFT Test ==='
        - 'Complex FFT completed successfully'
        - '\[0\] = 0x0599'
        - '=== Inverse FFT Test ==='
        - 'Inverse FFT completed successfully'
        - '\[0\] = 0x0599'
        - 'FFT Example Complete'
```

## example/hal/gpio/testcase.yaml
```yaml
# SPDX-FileCopyrightText: 2026 SiFli Technologies(Nanjing) Co., Ltd
# SPDX-License-Identifier: Apache-2.0
# example/hal/gpio toggles one GPIO every second and expects the edge to arrive on a second GPIO
# configured as a rising/falling interrupt input. The jumper between the two pads is a bench
# precondition the framework cannot request: without it the interrupt never fires.

tests:
  - id: hal_gpio.boot
    description: Toggle an output GPIO and check the jumper loopback raises matching interrupt reports
    harness: console
    tags: [console, hal, gpio, smoke]
    timeout: 120
    platform_allow:
      - sf32lb52-nano_a128r16
      - sf32lb52-nano_n16r16
      - sf32lb52-lcd_52d
      - sf32lb52-lcd_a128r16
      - sf32lb52-lcd_n16r8
      - sf32lb52-lcd_n16r8_jdi
      - sf32lb58-lcd_a128r32n1_a1_dsi
      - sf32lb58-lcd_a128r32n1_dsi
      - sf32lb58-lcd_a128r32n1_qspi
      - sf32lb58-lcd_e4r32n1_dsi
      - sf32lb58-lcd_n16r16n1_qspi
      - sf32lb58-lcd_n16r32n1_a1_dpi
      - sf32lb58-lcd_n16r32n1_a1_dsi
      - sf32lb58-lcd_n16r32n1_dpi
      - sf32lb58-lcd_n16r32n1_dsi
      - sf32lb58-lcd_n16r32n1_qspi
      - sf32lb58-lcd_n16r64n4
      - sf32lb56-lcd_a128r12n1
      - sf32lb56-lcd_n16r12n1
      - sf32lb57-lcd_n16r16_dpi
      - sf32lb57-lcd_n16r16_qspi
      - sf32lb57-lcd_n16r8_dpi
      - sf32lb57-epd_n16r16
    integration_platforms: [sf32lb52-lcd_n16r8, sf32lb56-lcd_n16r12n1, sf32lb58-lcd_n16r64n4, sf32lb57-lcd_n16r16_dpi]
    project_dir: project
    harness_config:
      record:
        - 'Start gpio demo!'
        - 'Interrupt occurred!'
        - regex: 'Pin_Out \d+ has been toggle, value = 1\s+Pin_In \d+, value = 1'
          type: multi_line
          ordered: false
        - regex: 'Pin_Out \d+ has been toggle, value = 0\s+Pin_In \d+, value = 0'
          type: multi_line
          ordered: false
```
