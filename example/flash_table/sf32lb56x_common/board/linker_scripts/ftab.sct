#! armclang -E --target=arm-arm-none-eabi -mcpu=cortex-m33 -xc -I $SDK_ROOT/drivers/cmsis/sf32lb56x
#include "mem_map.h"

#ifdef QSPI2
#undef FLASH_TABLE_START_ADDR
#define FLASH_TABLE_START_ADDR 0x1C000000
#endif

; *************************************************************
; *** Scatter-Loading Description File generated by uVision ***
; *************************************************************

LR_IROM1 FLASH_TABLE_START_ADDR FLASH_TABLE_SIZE  {    ; load region size_region, 
  ER_IROM1 FLASH_TABLE_START_ADDR FLASH_TABLE_SIZE  {  ; load address = execution address
   	.ANY (+RO)
  }
}
