#! armclang -E --target=arm-arm-none-eabi -mcpu=cortex-m33 -xc -I $SDK_ROOT/drivers/cmsis/sf32lb52x 
#include "rtconfig.h"
#include "mem_map.h"



; *************************************************************
; *** Scatter-Loading Description File generated by uVision ***
; *************************************************************

LR_IROM1 CODE_START_ADDR CODE_SIZE  {    ; load region size_region
  ER_IROM1 CODE_START_ADDR CODE_SIZE  {  ; load address = execution address
   *.o (RESET, +First)
   *(InRoot$$Sections)
   .ANY (+RO)
   *(FSymTab)
   *.o (.rodata.*)
  }
  ER_IROM1_EX HCPU_RO_DATA_START_ADDR HCPU_RO_DATA_SIZE  {  ; load address = execution address
   *.o (.l1_non_ret_text_*)
   *.o (.l1_non_ret_rodata_*)
  } 


#ifdef BSP_USING_PSRAM
  RW_PSRAM1 PSRAM_DATA_START_ADDR UNINIT{  ; ZI data, retained
    *.o (.l2_ret_data_*)
    *.o (.l2_ret_bss_*)
    *.o (.l2_cache_ret_data_*)
    *.o (.l2_cache_ret_bss_*)    
  }
  RW_PSRAM_NON_RET +0  UNINIT{  ; ZI data, not retained and reused by SRAM retention
    *.o (.nand_cache)
    *.o (.l2_non_ret_data_*)
    *.o (.l2_non_ret_bss_*)
    *.o (.l2_cache_non_ret_data_*)
    *.o (.l2_cache_non_ret_bss_*)  
  }
  ScatterAssert((ImageLength(RW_PSRAM1)+ImageLength(RW_PSRAM_NON_RET))<PSRAM_DATA_SIZE)
#endif

  ER_IRAM0 HPSYS_RAM0_BASE  {  ; ZI data, not retained
  
   core_list_join.o (+RO)
   core_main.o (+RO)
   core_matrix.o (+RO)
   core_state.o (+RO)
   core_util.o (+RO)
   core_portme.o (+RO)
   main.o (.text.run_while_loop)
   main.o (.text.shutdown)
 }
  
  RW_IRAM1 +0 {  ; ZI data, not retained
  
   .ANY (+RW +ZI)
  
    *.o (Jlink_RTT, +First)
    *.o (.l1_ret_data_*)
    *.o (.l1_ret_bss_*)  
  
#ifdef BSP_USING_PM  
    *.o (non_ret) ; non-retention section
    *.o (STACK)   ; ISR stack
#endif
    *.o (.l1_non_ret_data_*)
    ;*.o (.l1_non_ret_bss_*)
#ifndef BSP_USING_PSRAM
    *.o (.l2_non_ret_data_*)
    *.o (.l2_non_ret_bss_*)
    *.o (.l2_cache_non_ret_data_*)
    *.o (.l2_cache_non_ret_bss_*)
    *.o (.nand_cache)
#endif
  }

  ScatterAssert(ImageLength(ER_IRAM0)+ImageLength(RW_IRAM1)<HCPU_RAM_DATA_SIZE)

  RW_IRAM_RET HPSYS_RAM1_BASE HPSYS_RAM1_SIZE {  

   *.o (.l1_ret_text_*)
   *.o (.l1_ret_rodata_*)
   *.o (.bss.retm_bss_*)
   *.o (.retm_data_*)

   drv_spi_flash.o (+RO)
   flash_table.o (.text.*)
   flash_table.o (.rodata.*)
   bf0_hal_hpaon.o (+RO)
   bf0_hal_mpi.o (+RO)
   bf0_hal_mpi_ex.o (+RO)
   bf0_hal_mpi_psram.o (+RO)
   flash.o (+RO)
   drv_psram.o (+RO)
   context_rvds.o (+RO)
   drv_common.o (.text.HAL_GetTick)
 
   bf0_hal_rcc.o   (+RO)
#ifdef BSP_USING_PM   
   bf0_pm.o        (.text.sifli_light_handler)
   bf0_pm.o        (.text.sifli_deep_handler)
   bf0_pm.o        (.text.sifli_standby_handler)
   bf0_pm.o        (.text.SystemInitFromStandby)
   bf0_pm.o        (.text.SystemPowerOnModeGet)
   bf0_pm.o        (.text.BSP_GPIO_Set)
#endif  
   bsp_init.o         (+RO)
   bsp_lcd_tp.o       (+RO)
   bsp_pinmux.o       (+RO)
   bsp_power.o        (+RO)
   bf0_hal_gpio.o     (+RO)
   bf0_hal.o          (.text.HAL_Init)
   *.o                (.text.HAL_Delay_us)
   *.o                (.text.HAL_Delay_us_)
   *.o                (.text.HAL_Delay_us2_)
   *.o                (.text.HAL_MspInit)
   *.o                (.text.HAL_Delay)
   bf0_hal_pinmux.o   (+RO)
   bf0_pin_const.o    (+RO)
   *.o                (.text.rt_memset)
   ;*.o                (.text.HAL_LPTIM_GetFreq)
    
   main.o (.text.run_coremark)    
   main.o (.text.reconfig_flash_clock)
   main.o (.text.main)
   rt_memclr*.o (.text)
   memset*.o    (.text)
    
  }

}


