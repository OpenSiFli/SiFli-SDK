#! armclang -E --target=arm-arm-none-eabi -mcpu=cortex-m33 -xc -I $SDK_ROOT/drivers/cmsis/sf32lb56x 
#include "rtconfig.h"
#include "mem_map.h"

; *************************************************************
; *** Scatter-Loading Description File generated by uVision ***
; *************************************************************

LR_IROM1 LCPU_RAM_CODE_START_ADDR LCPU_RAM_CODE_SIZE {    ; load region size_region
  ER_IROM1 LCPU_RAM_CODE_START_ADDR LPSYS_ITCM_SIZE  {  ; load address = execution address
   *.o (RESET, +First)
   *(InRoot$$Sections)
   core_list_join.o (+RO)
   core_main.o (+RO)
   core_matrix.o (+RO)
   core_state.o (+RO)
   core_util.o (+RO)
   main.o (.text.run_while_loop)

  }

  ER_IROM0 +0   {  ; load address = execution address
   *(FSymTab)
   *.o (.l1_ret_text_*)
   *.o (.l1_ret_rodata_*)
   startup_bf0_lcpu.o (.text)
   bf0_hal_mpi.o (+RO)
   bf0_hal_mpi_ex.o (+RO)
   flash_table.o (.text.*)
   flash_table.o (.rodata.*)
   bf0_hal_lpaon.o (+RO)
   drv_spi_flash.o (+RO)
   system_bf0_ap.o (+RO)
   bf0_hal.o (+RO)
   
   *.o (.text.rt_wdt_restore)
   *.o (.text.HAL_Get_backup)
   *.o (.text.HAL_LPTIM_GetFreq)
   *.o (.text.HAL_WDT_Init)
   
   bf0_hal_rcc.o   (+RO)
#ifdef BSP_USING_PM   
   bf0_pm.o        (.text.sifli_light_handler)
   bf0_pm.o        (.text.sifli_deep_handler)
   bf0_pm.o        (.text.sifli_standby_handler)
   bf0_pm.o        (.text.SystemPowerOnModeInit)
   bf0_pm.o        (.text.SystemPowerOnModeGet)
   bf0_pm.o        (.text.BSP_GPIO_Set)
   bsp_init.o         (+RO)
   bsp_lcd_tp.o       (+RO)
   bsp_pinmux.o       (+RO)
   bsp_power.o        (+RO)
   bf0_hal_gpio.o     (+RO)
   bf0_hal.o          (.text.HAL_Init)
   bf0_hal.o          (.text.HAL_Delay_us)
   bf0_hal.o          (.text.HAL_Delay_us_)   
   *.o                (.text.HAL_MspInit)
   bf0_hal_pinmux.o   (+RO)
   bf0_pin_const.o    (+RO)
   *.o                (.text.rt_memset)
   ;*.o                (.text.mpu_config)
   ;*.o                (.rodata.mpu_config)
#endif     
   context_rvds.o (+RO)
   drv_common.o (.text.HAL_GetTick)
   core_portme.o (+RO)      
   memseta.o (.text)   
   main.o (.text.run_coremark)       
   main.o (.text.coremark_entry)
  }

  ScatterAssert((ImageLength(ER_IROM0)+ImageLength(ER_IROM1))<LCPU_RAM_CODE_SIZE)

  RW_DTCM LPSYS_DTCM_BASE LPSYS_DTCM_SIZE  {  ; RW data
   core_list_join.o (+RW +ZI)
   core_main.o (+RW +ZI)
   core_matrix.o (+RW +ZI)
   core_portme.o (+RW +ZI)
   core_state.o (+RW +ZI)
   core_util.o (+RW +ZI)  
   main.o (.bss.coremark_stack)
  }

  RW_IRAM1 AlignExpr(LPSYS_RAM_BASE+LCPU_RAM_CODE_SIZE, 16) ALIGN 16 NOCOMPRESS LCPU_RAM_DATA_SIZE  {  ; RW data
   .ANY (+RW +ZI)
  }
}

LR_IROM2 LCPU_FLASH_CODE_START_ADDR LCPU_FLASH_CODE_SIZE {
   ER_IROM2 LCPU_FLASH_CODE_START_ADDR LCPU_FLASH_CODE_SIZE {
   .ANY (+RO)
  }
}
