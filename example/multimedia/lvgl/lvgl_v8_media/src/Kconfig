## example/multimedia/lvgl/lvgl_v8_media/src/Kconfig
```kconfig
if RT_USING_DFS
    config RT_USING_DFS_WINSHAREDIR
    depends on BSP_USING_PC_SIMULATOR
    bool "Enable shared file system between windows"
    default n
endif
config MEDIA_CACHE_SIZE
    int "Media cache size"
    default 4000000
```

## example/multimedia/lvgl/lvgl_v9_demos/src/lv_demos/Kconfig
```kconfig
menu "LVGL V9 Demos"   

config LV_USE_DEMO
     bool "Enable LVGL Demos"
     default n

if LV_USE_DEMO

	menu "Demos"
		config LV_USE_DEMO_WIDGETS
			bool "Show some widget"
			default n

		config LV_USE_DEMO_KEYPAD_AND_ENCODER
			bool "Demonstrate the usage of encoder and keyboard"
			default n

		config LV_USE_DEMO_BENCHMARK
			bool "Benchmark your system"
			default n
			depends on LV_FONT_MONTSERRAT_14 && LV_FONT_MONTSERRAT_24 && LV_USE_DEMO_WIDGETS
		config LV_USE_DEMO_RENDER
			bool "Render test for each primitives. Requires at least 480x272 display"
			default n

		config LV_USE_DEMO_SCROLL
			bool "Scroll settings test for LVGL"
			default n

		config LV_USE_DEMO_STRESS
			bool "Stress test for LVGL"
			default n

		config LV_USE_DEMO_TRANSFORM
			bool "Transform test for LVGL"
			default n
			depends on LV_FONT_MONTSERRAT_18

		config LV_USE_DEMO_MUSIC
			bool "Music player demo"
			default n
		config LV_DEMO_MUSIC_SQUARE
			bool "Enable Square"
			depends on LV_USE_DEMO_MUSIC
			default n
		config LV_DEMO_MUSIC_LANDSCAPE
			bool "Enable Landscape"
			depends on LV_USE_DEMO_MUSIC
			default n
		config LV_DEMO_MUSIC_ROUND
			bool "Enable Round"
			depends on LV_USE_DEMO_MUSIC
			default n
		config LV_DEMO_MUSIC_LARGE
			bool "Enable Large"
			depends on LV_USE_DEMO_MUSIC
			default n
		config LV_DEMO_MUSIC_AUTO_PLAY
			bool "Enable Auto play"
			depends on LV_USE_DEMO_MUSIC
			default n

		config LV_USE_DEMO_FLEX_LAYOUT
			bool "Flex layout previewer"
			default n
		config LV_USE_DEMO_MULTILANG
			bool "multi-language demo"
			default n
		config LV_USE_DEMO_VECTOR_GRAPHIC
			bool "vector graphic demo"
			default n
			depends on LV_USE_VECTOR_GRAPHIC
	endmenu

endif

endmenu
```

## example/multimedia/lvgl/multilingual/multilingual_v9/project/Kconfig.proj
```kconfig
#APP specific configuration.
config CUSTOM_MEM_MAP
    bool 
	select custom_mem_map
	default y if !SOC_SIMULATOR

config SOLUTION_ALLOC_MEM
    bool
    default y

config FREETYPE_TINY_FONT_FULL
    bool
    default y

menu "app cache Memory configuration"   

choice
    prompt "rotation image preferred cache memory"
    default  ROTATE_MEM_IN_PSRAM
    config ROTATE_MEM_IN_PSRAM
        depends on BSP_USING_PSRAM
        bool "PSRAM"
    config ROTATE_MEM_IN_SRAM
        bool "SRAM"
endchoice


choice
    prompt "freetype cache memory"
    default  FREETYPE_CACHE_IN_PSRAM
    config FREETYPE_CACHE_IN_PSRAM
        depends on BSP_USING_PSRAM
        bool "PSRAM"           
    config FREETYPE_CACHE_IN_SRAM_STANDALONE
        bool "SRAM STANDALONE"
    config FREETYPE_CACHE_IN_SRAM
        bool "SRAM(Share with system heap)"
endchoice


choice
    prompt "message preferred cache memory"
    default  MESSAGE_CACHE_IN_PSRAM
    config MESSAGE_CACHE_IN_PSRAM
        depends on BSP_USING_PSRAM
        bool "PSRAM"           
    config MESSAGE_CACHE_IN_SRAM_STANDALONE
        bool "SRAM STANDALONE"
    config MESSAGE_CACHE_IN_SRAM
         bool "SRAM(Share with system heap)"
endchoice


config IMAGE_CACHE_IN_PSRAM_SIZE
    int "image cache in psram size(standalone)"
    depends on BSP_USING_PSRAM
    default 2100000

config IMAGE_CACHE_IN_PSRAM_SIZE
    int
    depends on !BSP_USING_PSRAM
    default 0

config IMAGE_CACHE_IN_SRAM_SIZE
    int "image cache in sram size(standalone)"
    default 200000

    
config FT_CACHE_SIZE
    int "freetype cache size(bytes)"
    help 
        "Maximum freetype cache size(threshold), and define a standalon 
         array(size equals FT_CACHE_SIZE) if define 
         FREETYPE_CACHE_IN_PSRAM or FREETYPE_CACHE_IN_SRAM_STANDALONE"
    default 400000 if FREETYPE_CACHE_IN_PSRAM
    default 120000 if FREETYPE_CACHE_IN_SRAM_STANDALONE
    default 100000 if FREETYPE_CACHE_IN_SRAM


config MESSAGE_CACHE_SIZE
    int "message standalon cache size(bytes)"
    depends on MESSAGE_CACHE_IN_PSRAM || MESSAGE_CACHE_IN_SRAM_STANDALONE
    default 96000 if MESSAGE_CACHE_IN_PSRAM
    default 16000 if MESSAGE_CACHE_IN_SRAM_STANDALONE


endmenu
```

## example/pm/ble/common/hcpu/Kconfig.proj
```kconfig
config BF0_HCPU
    bool
    default y

config CUSTOM_MEM_MAP
    bool 
    default y    
	
```

## example/pm/coremark/common/hcpu/Kconfig.proj
```kconfig
config BF0_HCPU
    bool
    default y
    
config CUSTOM_MEM_MAP
    bool 
    select custom_mem_map
    default y    
	
config RT_USING_STATIC_STACK
    bool 
    default y    	
```

## example/pm/coremark/common/lcpu/Kconfig.proj
```kconfig
config BF0_LCPU
    bool
    default y
    
config LCPU_ROM
    bool
    default y
    
config S_SLIM
    bool
    default y
    depends on SOC_SF32LB52X 
    
config CUSTOM_MEM_MAP    
    bool
    default y    
    depends on SOC_SF32LB52X 
       
```

## example/printer/project/Kconfig.proj
```kconfig
#APP specific configuration.
config BF0_HCPU
    bool
    default y

config CUSTOM_MEM_MAP
    bool 
	select custom_mem_map
	default y    

config LTO_SUPPORT
    bool
    default n
```

## example/watch_demo/project/ec-lb583/Kconfig
```kconfig
mainmenu "Sifli Configuration"

config SIFLI_SDK
    string 
    option env="SIFLI_SDK"
    default "."

#SDK configuration	
source "$SIFLI_SDK/Kconfig"

#Application specific configuration
source "../../service/kconfig"
source "../kconfig_hcpu"
config BF0_HCPU
    bool
    default y

config SOLUTION_ALLOC_MEM
    bool
    default y

config CUSTOM_MEM_MAP
    bool 
    default y  

config FREETYPE_TINY_FONT_LITE 
    bool
    default y
    
```

## example/watch_demo/project/ec-lb587_v11/board/Kconfig
```kconfig
menu "Hardware Drivers Config"

config SOC_BF0_HCPU
    bool
    select SOC_SERIES_BF0_HCPU
    default y

endmenu
```

## example/watch_demo/project/simulator/Kconfig
```kconfig
mainmenu "Sifli Configuration"

config SIFLI_SDK
    string 
    option env="SIFLI_SDK"
    default "."

#SDK configuration	
source "$SIFLI_SDK/Kconfig"

source "../../service/kconfig"
source "../kconfig_hcpu"

config SOLUTION_ALLOC_MEM
    bool
    default y

if RT_USING_DFS
    config RT_USING_DFS_WINSHAREDIR
    bool "Enable shared file system between windows"
    default n
endif
```

## example/watch_demo/service/kconfig
```kconfig
menu "Select data service"      
    if BSP_USING_DATA_SVC
        config BSP_USING_COMP_SVC
            bool "Enable Compass Service"
            select BSP_USING_MAG_SVC
            default n
        
        config BSP_USING_MAG_SVC
            bool "Enable Magnetic Service"
            select SENSOR_USING_MAG
            select MAG_USING_MMC36X0KJ
            default n
            
        config BSP_USING_WEA_SVC
            bool "Enable Weather Service"
            select BSP_BLE_SIBLES
            default n
            
        config BSP_USING_HR_SVC
            bool "Enable HR Service"
            select SENSOR_USING_HR
            default n

        config BSP_USING_BARO_SVC
            bool "Enable Barometer Service"
            select SENSOR_USING_BAROMETER
            select SENSOR_USING_BMP280
            default n 				

        config BSP_USING_ACCE_SVC
            bool "Enable Accelerator Service"
            select ACC_USING_LSM6DSL
            default n 	

        config BSP_USING_GYRO_SVC
            bool "Enable Gyro Service"
            select ACC_USING_LSM6DSL
            default n 	

        config BSP_USING_STEP_SVC
            bool "Enable Step Service"
            select ACC_USING_LSM6DSL
            default n 	

        config BSP_USING_GPS_SVC
            bool "Enable GPS Service"
            select GPS_USING_UC6226
            default n 

        config BSP_USING_TEST_SVC
            bool "Enable Test Service"
            default n                 

        config BSP_USING_TELEPHONE_SVC
            bool "Enable telephone Service"
            default n   

        config BSP_USING_ALARM_MANAGER_SVC
            bool "Enable alarm manager Service"
            default n   
        if BSP_USING_ALARM_MANAGER_SVC
            config BSP_ALARM_MAX
                int "Max number of Alarm could set"
                default 8          
        endif
    endif        
endmenu
```

## example/zbt/bap_broadcast_assistant/project/Kconfig.proj
```kconfig
#APP specific configuration.
config CUSTOM_MEM_MAP
    bool 
	select custom_mem_map
	default y    

config SELECT_SOURCE_NAME
	string "Selected Broadcast Source name"
	default ""
	help
	  Name of broadcast source device to select. This will be used as a
	  substring matched against both BT device name and broadcast name.
	  If empty, the first broadcast source found will be chosen.
	  Matching is not case sensitive.

config SELECT_SINK_NAME
	string "Selected Broadcast Sink name"
	default ""
	help
	  Name of broadcast sink device to select. This will be used as a
	  substring matched against the BT device name.
	  If empty, the first broadcast sink found will be chosen.
	  Matching is not case sensitive.
```

## example/zbt/bap_broadcast_sink/project/Kconfig.proj
```kconfig
#APP specific configuration.
config CUSTOM_MEM_MAP
    bool 
	select custom_mem_map
	default y    
    
config SCAN_OFFLOAD
	bool "Whether to wait for a Broadcast Assistant"
	default y
	# enable PAST support if we can
	select BT_PER_ADV_SYNC_TRANSFER_RECEIVER if !BT_CTLR || BT_CTLR_SYNC_TRANSFER_RECEIVER_SUPPORT
	help
	  If set to true, the sample will start advertising connectable for
	  Broadcast Assistants.

config SCAN_SELF
	bool "Whether to scan for Broadcast Sources without Broadcast Assistant"
	default y
	help
	  If set to true, the sample will start scanning for Broadcast Sources
	  without waiting for a Broadcast Assistant to connect.

config SCAN_DELAY
	int "Delay before starting scan (in seconds)"
	range 0 255
	default 10
	depends on SCAN_SELF
	help
	  Time to advertise connectable for a Broadcast Assistant to connect
	  before starting scanning for Broadcast Sources.

config TARGET_BROADCAST_NAME
	string "Target Broadcast Device Name"
	default ""
	help
	  Name of target broadcast device. If not empty string, sink device
	  will only listen to the specified broadcast source. Not case sensitive.

config MAX_CODEC_FRAMES_PER_SDU
	int "The maximum number of codec frame per SDU supported"
	default 1
	range 1 255
	help
	  Maximum number of codec frames per SDU supported by this device. Increasing this value
	  allows support for a greater variaty of broadcasts, but also increases memory usage.

config USE_SPECIFIC_BROADCAST_CHANNEL
	bool "Use specific Broadcast Channel Audio Location"
	default y
	depends on USE_USB_AUDIO_OUTPUT
	help
	  Enables the use of a specific Channel Audio Location (see config TARGET_BROADCAST_CHANNEL).

config TARGET_BROADCAST_CHANNEL
	int "Broadcast Channel Audio Location to sync to"
	range 0 3
	default 1
	depends on USE_SPECIFIC_BROADCAST_CHANNEL
	help
	  Channel Audio Location to sync to. These corresponds to the bt_audio_location,
	  supporting mono, left and right channels    
      
```

## example/zbt/bap_broadcast_src_with_mic/project/Kconfig.proj
```kconfig
#APP specific configuration.
config CUSTOM_MEM_MAP
    bool 
	select custom_mem_map
	default y    

config BROADCAST_CODE
	string "The broadcast code (if any) to use for encrypted broadcast"
	default ""
	help
	   Setting a non-empty string for this option will encrypt the broadcast using this
	   string as the broadcast code. The length of the string shall be between 1 and 16 octets.

choice BAP_LC3_PRESET
	prompt "The BAP LC3 Preset to be used"
	default BAP_BROADCAST_16_2_1

config BAP_BROADCAST_16_2_1
	bool "BAP_LC3_BROADCAST_PRESET_16_2_1 preset"
	help
	  Using the BAP_LC3_BROADCAST_PRESET_16_2_1 preset.

config BAP_BROADCAST_24_2_1
	bool "BAP_LC3_BROADCAST_PRESET_24_2_1 preset"
	help
	  Using the BAP_LC3_BROADCAST_PRESET_24_2_1 preset.
config BAP_BROADCAST_48_2_1
	bool "BAP_LC3_BROADCAST_PRESET_48_2_1 preset"
	help
	  Using the BAP_LC3_BROADCAST_PRESET_48_2_1 preset.
endchoice       

config ENABLE_LC3
	bool "Enable the LC3 codec"
	# By default let's enable it in the platforms we know are capable of supporting it
	default y
	select LIBLC3
```

## example/zbt/ccp_call_control_server/project/Kconfig.proj
```kconfig
#APP specific configuration.
config CUSTOM_MEM_MAP
    bool 
	select custom_mem_map
	default y    
      
```

## example/zbt/hap_ha/project/Kconfig.proj
```kconfig
#APP specific configuration.
config CUSTOM_MEM_MAP
    bool 
	select custom_mem_map
	default y    


menu "Hearing Aid"

config HAP_HA_SET_RANK
	int "Device rank in set"
	depends on BT_CSIP_SET_MEMBER
	range 1 2
	help
	  Rank of this device in set.

choice HAP_HA_HEARING_AID_TYPE_CHOICE
	prompt "Hearing Aid Type selection"
	help
	  Select the Hearing Aid Type to compile.

config HAP_HA_HEARING_AID_MONAURAL
	bool "Monaural Hearing Aid"

config HAP_HA_HEARING_AID_BINAURAL
	depends on BT_CSIP_SET_MEMBER
	bool "Binaural Hearing Aid"

config HAP_HA_HEARING_AID_BANDED
	bool "Banded Hearing Aid"

endchoice # HAP_HA_HEARING_AID_TYPE_CHOICE

choice HAP_HA_HEARING_AID_LOCATION
	prompt "Hearing Aid Device Location"
	help
	  Select the Hearing Aid Device location.

config HAP_HA_HEARING_AID_LEFT
	bool "Left Ear"

config HAP_HA_HEARING_AID_RIGHT
	bool "Right Ear"

endchoice # HAP_HA_HEARING_AID_LOCATION

endmenu
```

## example/zbt/peripheral_identity/project/Kconfig.proj
```kconfig
#APP specific configuration.
config CUSTOM_MEM_MAP
    bool 
	select custom_mem_map
	default y    

config SAMPLE_CONN_ITERATIONS
	int "Connection iterations"
	range 0 255
	default 0
	help
	  Expected number of times connect and disconnect from
	  central_multilink sample.
      
```

## example/zbt/tmap_bms/project/Kconfig.proj
```kconfig
#APP specific configuration.
config CUSTOM_MEM_MAP
    bool 
	select custom_mem_map
	default y    
     

config ENABLE_LC3
	bool "Enable the LC3 codec"
	# By default let's enable it in the platforms we know are capable of supporting it
	default y
	select LIBLC3

menu "Earbuds"

config TMAP_PERIPHERAL_SET_RANK
	int "Device rank in set"
	depends on TMAP_PERIPHERAL_DUO
	range 1 2
	help
	  Rank of this device in set.

choice TMAP_PERIPHERAL_TYPE_CHOICE
	prompt "Earbuds type"
	help
	  Select the Earbuds Type to compile.

config TMAP_PERIPHERAL_SINGLE
	bool "Single ear headset"

config TMAP_PERIPHERAL_DUO
	depends on BT_CAP_ACCEPTOR_SET_MEMBER
	bool "Duo headset"

endchoice # TMAP_PERIPHERAL_TYPE_CHOICE

choice TMAP_PERIPHERAL_LOCATION
	prompt "Earbud Location"
	help
	  Select the Earbud location.

config TMAP_PERIPHERAL_LEFT
	bool "Left Ear"

config TMAP_PERIPHERAL_RIGHT
	bool "Right Ear"

endchoice # TMAP_PERIPHERAL_LOCATION

endmenu
```

## example/zbt/tmap_central/project/Kconfig.proj
```kconfig
#APP specific configuration.
config CUSTOM_MEM_MAP
    bool 
	select custom_mem_map
	default y    
     

config ENABLE_LC3
	bool "Enable the LC3 codec"
	# By default let's enable it in the platforms we know are capable of supporting it
	default y
	select LIBLC3
```

## external/CMSIS/Kconfig
```kconfig
config BSP_USING_CMSIS_NN
    bool "Enable ARM CMSIS NN"
    default n

config BSP_USING_CMSIS_DSP
    bool "Enable ARM CMSIS DSP"
    default n

config RT_USING_RTT_CMSIS
    bool "Enable RT-Thread support for CMSIS OS"
    default n
```
