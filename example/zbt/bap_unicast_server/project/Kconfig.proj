## example/zbt/bap_unicast_server/project/Kconfig.proj
```kconfig
#APP specific configuration.
config CUSTOM_MEM_MAP
    bool 
	select custom_mem_map
	default y    

config BT_DISABLE_GATT_DB_HASH
    bool "disable gatt database hash"
    default y
```

## external/audio-stretch/Kconfig
```kconfig
config PKG_USING_AUDIO_STRETCH
    bool "Enable audio strech"
    default n
    depends on AUDIO
```

## external/findmy/Kconfig
```kconfig
config PKG_USING_FMNA
    bool "Enable Apple Find My Network ADK"
    default n

config WOLFSSL_USER_SETTINGS
    bool "wolfSSL enable user setting"
    depends on PKG_USING_FMNA
    default n
```

## external/libepub/Kconfig
```kconfig
menuconfig PKG_USING_LIBEPUB
    bool "Enable libepub"
    default n
    select PKG_USING_LIBXML2 if PKG_USING_LIBEPUB
    select PKG_USING_LIBZIP if PKG_USING_LIBEPUB
    select PKG_USING_ZLIB if PKG_USING_LIBEPUB
    select PKG_USING_MBEDTLS if PKG_USING_LIBEPUB && !BSP_USING_PC_SIMULATOR
    select PKG_USING_MBEDTLS_USE_ALL_CERTS if PKG_USING_LIBEPUB && !BSP_USING_PC_SIMULATOR
    select PKG_USING_MBEDTLS_USER_CERTS if PKG_USING_LIBEPUB && !BSP_USING_PC_SIMULATOR
```

## external/libhelix-mp3/Kconfig
```kconfig
config PKG_USING_LIBHELIX
    bool "Enable libhelix mp3 decoder(code size 30K)"
    default n

if PKG_USING_LIBHELIX
    config LIBHELIX_RUN_IN_ACPU
    bool "libhelix run in acpu"
    default n
endif
```

## external/liblc3/Kconfig
```kconfig
config LC3_CODEC_ENABLE
    bool "Enable LC3 codec"
    default n
    help
      Enable the LC3 codec.
```

## external/libsbc/Kconfig
```kconfig
config PKG_USING_LIBSBC
    bool "libsbc - enable google sbc decoder/encoder"
    default n

if PKG_USING_LIBSBC
    config LIBSBC_RUN_IN_ACPU
    depends on BSP_USING_ACPU
    bool "libsbc run in acpu"
    default n
endif
```

## external/mbedtls_228/Kconfig
```kconfig
config PKG_USING_MBEDTLS
    bool "Seleted MBedTLS"
    default n

config PKG_USING_MBEDTLS_DEBUG
    bool "Seleted MBedTLS Debug function"
    depends on PKG_USING_MBEDTLS
    default n

config PKG_USING_MBEDTLS_USE_ALL_CERTS
    bool "Use All cert provided by Mbedtls"
    depends on PKG_USING_MBEDTLS
    default n
    
config PKG_USING_MBEDTLS_USER_CERTS
    bool "User provided cert"
    depends on PKG_USING_MBEDTLS
    default n

config PKG_USING_MBEDTLS_EXTRA_CERT_DIRS
    string "Extra CA cert search directories (semicolon separated)"
    depends on PKG_USING_MBEDTLS
    default ""
    help
        Specify additional directories to search for PEM CA certificates
        at build time. Multiple directories can be separated by ';'.
        Each entry may be an absolute path or a path relative to the
        mbedtls_228 package root (the folder that contains this Kconfig).
        Only PEM files whose first line starts with
        "-----BEGIN CERTIFICATE" will be collected; other files are
        skipped. Collected certificates are deduplicated with
        the built-in default/user certificate lists.

        Examples:
          /abs/path/to/my_certs
          certs/my_board;certs/customer_a
          /etc/ssl/certs

        Leave empty to keep the legacy behavior (only certs/ and
        certs/default/ are scanned).

config PKG_USING_MBEDTLS_TLS_CLIENT_CONNECT_FALLBACK_ALIAS
    bool "Enable dynamic cert fallback for mbedtls_client_connect()"
    depends on PKG_USING_MBEDTLS
    default n
    help
        When enabled, mbedtls_client_connect() is aliased at compile time
        to mbedtls_client_connect_with_fallback(). If a normal handshake
        fails with MBEDTLS_X509_BADCERT_NOT_TRUSTED, the client reconnects
        once with VERIFY_NONE to capture the peer certificate chain, takes
        the chain tail as a temporary trust anchor, then reconnects with
        verification re-enabled. See ports/src/tls_client_fallback.c for
        details and security notes.
```

## external/silk-fix/Kconfig
```kconfig
config PKG_USING_SILK_FIX
    bool "SILK SDK fixed-point (FIX) v1.0.9"
    default n
    help
        Skype SILK fixed-point codec (SILK_SDK_SRC_FIX_v1.0.9).
        Do not enable together with PKG_USING_SILK_FLP (symbol clash).
```

## external/unity/Kconfig
```kconfig
config RT_USING_UNITY
    bool "Unity C unit test framework"
    default n
    help
        Enable the Unity C unit-test framework (ThrowTheSwitch.org, MIT).
        It is linked into on-device test binaries that run the SDK's unit
        tests on the target. Enable this only for test projects under
        example/test/; production firmware should leave it off.
```

## external/vglite/Kconfig
```kconfig
menuconfig USING_VGLITE
    bool "Enable VG-Lite"
    default n
    
    if USING_VGLITE
        config USING_VGLITE_STATIC_CONT_MEM
            bool "Use static contiguous mem for VG-Lite"
            default n
        config VGLITE_CONT_MEM_SIZE
            int "VGLite contiguous memory pool size (KB)"
            default 320
            help
                Size of VGLite contiguous memory pool in KB.
                This pool is used for command buffer, tessellation buffer,
                target buffers and other VGLite runtime allocations.
                For arc mask generation (e.g. 226x226 A8), 192KB is enough.
                For full-screen VGLite rendering, 320KB or more is recommended.
        config VGLITE_CMD_BUF_SIZE_KB
            int "VGLite command buffer size (KB)"
            default 102
            help
                Size of VGLite command buffer in KB.
                The command buffer stores VGLite command sequences consumed by GPU.
        config VGLITE_TESS_WIDTH
            int "VGLite tessellation buffer width"
            default 0
            help
                Width of VGLite tessellation buffer in pixels.
                A positive value overrides the width on either CPU core.
                Zero uses the LCD width when LCD is enabled, otherwise 320.
        config VGLITE_TESS_HEIGHT
            int "VGLite tessellation buffer height"
            default 0
            help
                Height of VGLite tessellation buffer in pixels.
                A positive value overrides the height on either CPU core.
                Zero uses the LCD height when LCD is enabled, otherwise 320.
    endif
```

## external/zlib/Kconfig
```kconfig
menuconfig PKG_USING_ZLIB
    bool "Enable ZLIB"
    default n

if PKG_USING_ZLIB
    config PKG_USING_MINIZIP
        bool "Support compress/decompress .zip file"
        default n
endif
```

## middleware/Kconfig
```kconfig
menu "SiFli Built-in Components"
    choice
        prompt "HAL Assert Type"
        default BSP_USING_EMPTY_ASSERT
        config BSP_USING_FULL_ASSERT
            bool "Print and loop"
        config BSP_USING_LOOP_ASSERT
            bool "Endless Loop"
        config BSP_USING_EMPTY_ASSERT
            bool "Empty"
    endchoice

    source "$SIFLI_SDK/middleware/acpu_ctrl/Kconfig"
    source "$SIFLI_SDK/middleware/app_fwk/Kconfig"
    source "$SIFLI_SDK/middleware/audio/Kconfig"
    source "$SIFLI_SDK/middleware/audio/anyka/Kconfig"
    source "$SIFLI_SDK/middleware/barcode128/Kconfig"
    source "$SIFLI_SDK/middleware/battery/Kconfig"
    rsource "bluetooth/Kconfig"
    source "$SIFLI_SDK/middleware/rt_bt_app_core/Kconfig"

    config APP_BSP_TEST
        bool "BSP Test"
        default n

    source "$SIFLI_SDK/middleware/button/Kconfig"
    source "$SIFLI_SDK/middleware/cell_transform/Kconfig"    
    source "$SIFLI_SDK/middleware/cmsis_dsp/Kconfig"
    source "$SIFLI_SDK/middleware/context_backup/Kconfig"
    source "$SIFLI_SDK/middleware/code_convert/Kconfig"
    source "$SIFLI_SDK/middleware/coredump/Kconfig"
    source "$SIFLI_SDK/middleware/cpu_usage_profiler/Kconfig"
    source "$SIFLI_SDK/middleware/crypto/Kconfig"
    source "$SIFLI_SDK/middleware/crypt_block_dev/Kconfig"
    source "$SIFLI_SDK/middleware/data_bus/Kconfig"
    source "$SIFLI_SDK/middleware/dfu_pan/Kconfig"
    source "$SIFLI_SDK/middleware/dfu_uart/Kconfig"
    source "$SIFLI_SDK/middleware/dfu/Kconfig"
    source "$SIFLI_SDK/middleware/dfu_v2/Kconfig"
    source "$SIFLI_SDK/middleware/elm_rw/Kconfig"
    source "$SIFLI_SDK/middleware/ezipa_dec/Kconfig"
    source "$SIFLI_SDK/middleware/file_logger/Kconfig"
    source "$SIFLI_SDK/middleware/gauss_blur/Kconfig"
    source "$SIFLI_SDK/middleware/ipc_queue/Kconfig"

    config USING_LIBRARY_ONLY
        bool "Use library binary instead of source"
        default n

    config BSP_USING_LVGL_INPUT_AGENT
        bool "Input Agent for LittlevGL"
        depends on PKG_USING_LITTLEVGL2RTT
        default n

    config LVSF_USING_SWITCHANIM
        bool
        default n

   
    source "$SIFLI_SDK/middleware/metrics_collector/Kconfig"
    source "$SIFLI_SDK/middleware/mod_installer/Kconfig"
    source "$SIFLI_SDK/middleware/nvm_storage/Kconfig"
    source "$SIFLI_SDK/middleware/profiler/Kconfig"
    source "$SIFLI_SDK/middleware/partition_table/Kconfig"
    source "$SIFLI_SDK/middleware/system/Kconfig"

    config USING_SEC_ENV
        bool "Security Environment"
        depends on USING_IPC_QUEUE
        default n

    source "$SIFLI_SDK/middleware/section_var/Kconfig"    
    source "$SIFLI_SDK/middleware/boot/Kconfig"
    source "$SIFLI_SDK/middleware/share_prefs/Kconfig"

    config SF_WLAN_COEX
        depends on BF0_LCPU
        bool "WiFi Coexistence with Bluetooth"
        default n

endmenu
```

## middleware/acpu_ctrl/Kconfig
```kconfig
menuconfig USING_ACPU_CTRL_FWK
    bool "ACPU Control Framework"
    select USING_IPC_QUEUE
    select RT_USING_MUTEX
    select BSP_USING_ACPU
    default n
if USING_ACPU_CTRL_FWK
    config ACPU_CALLER_ENABLED
        bool "Enable Caller"
        default y if BF0_HCPU
    if ACPU_CALLER_ENABLED
        config ACPU2HCPU_CALL_MBOX_SIZE
            int "ACPU to HCPU call mailbox size"
            range 2 64
            default 8
            help
                Number of pending ACPU-to-HCPU calls that can be queued for
                the HCPU caller thread. It must not be smaller than the number
                of ACPU threads that can make HCPU calls concurrently.
    endif
endif
```

## middleware/audio/anyka/Kconfig
```kconfig
config PKG_USING_ANYKA
    bool "Anyka Anyblue1090 Real-time Speech Enhancement Processing"
    default n

if PKG_USING_ANYKA
    choice
        prompt "select mic num for bt voice"
        default ANYKA_ONE_MIC
        config ANYKA_ONE_MIC
            bool "one mic"
        config ANYKA_TWO_MIC
            bool "two mics"
    endchoice
endif

config ANYKA_RUN_IN_ACPU
    bool "anyka lib run in acpu"
        depends on PKG_USING_ANYKA
    default y if BF0_ACPU
    default n
```

## middleware/code_convert/Kconfig
```kconfig
config BSP_USING_CODE_CONVERT
    bool "Character encoding convert utilities"
    default n
    help
        Provide text encoding detection and conversion helpers for GBK,
        UTF-8, UTF-16LE, UTF-16BE and ASCII text.
```

## middleware/crypt_block_dev/Kconfig
```kconfig
config USING_CRYPT_BLOCK_DEV
    bool "Crypt Block Device — transparent AES-encrypted block device"
    select BSP_USING_HW_AES
    default n
    help
        Wrap any RT_Device_Class_Block device with AES-CTR encryption.
        All writes are encrypted before reaching the underlying device,
        all reads are decrypted before returning to the caller.

        Compatible with AES-128/192/256 in CTR modes.
```

## middleware/dfu_v2/Kconfig
```kconfig
    menuconfig USING_DFU_V2
        bool "DFU V2 — Next Generation Firmware Update"
        depends on BF0_HCPU
        depends on !BSP_USING_DFU
        depends on !USING_DFU_PAN
        select PKG_USING_FLASHDB
        default n
        help
            Unified DFU subsystem with modular Engine/Mode/Transport architecture.
            Replaces both legacy BLE DFU and PAN DFU.

    if USING_DFU_V2
        # Selects the OTA image-ID / partition layout (NOR vs NAND) used by the
        # BLE transport and the AES path. Shared with the legacy DFU subsystem,
        # so the OTA_55X / OTA_56X_NAND names are kept. The default tracks each
        # SoC's usual flash type; boards whose flash differs from the SoC default
        # (e.g. a NAND-based 57x board) must override in board.conf / proj.conf.
        config OTA_55X
            bool "NOR-flash OTA image layout"
            default y if SOC_SF32LB52X || SOC_SF32LB55X || SOC_SF32LB57X
            default n
            help
                NOR-flash OTA image-ID / partition layout. Default on for the
                NOR-based SoCs (52x / 55x / 57x). NOR takes priority if both
                this and OTA_56X_NAND are set.

        config OTA_56X_NAND
            bool "NAND-flash OTA image layout"
            default y if SOC_SF32LB56X || SOC_SF32LB58X
            default n
            help
                NAND-flash OTA image-ID / partition layout. Default on for the
                NAND-based SoCs (56x / 58x). Enable this (and clear OTA_55X) on
                NAND-based boards of other SoCs, e.g. a NAND 57x board.

        comment "--- Engine ---"

        config DFU_V2_ENGINE_PROGRESS_INTERVAL
            int "Progress callback interval (bytes, 0=default 4096)"
            default 0

        config DFU_V2_ENGINE_ERASE_VERIFY
            bool "Verify flash erase (read-back check)"
            default n

        comment "--- Mode ---"

        config DFU_V2_USE_HOST_MODE
            bool "Enable Host-Initiated Mode (push)"
            default y
            help
                Host pushes firmware via protocol frames (CDC or BLE).

        config DFU_V2_USE_DEVICE_MODE
            bool "Enable Device-Initiated Mode (pull)"
            default n
            help
                Device pulls firmware from server via HTTP (PAN network).

        comment "--- Push Transport (Host Mode) ---"
        choice
            prompt "Push Transport"
            optional
            depends on DFU_V2_USE_HOST_MODE
            help
                Push transport used in Host Mode. At most one transport may be
                active (mutually exclusive). May be left unselected for builds
                that drive the DFU engine directly without a push transport
                (e.g. the PAN OTA example, which writes firmware-info via the
                dfu_fwinfo API and never calls dfu_init()).

            config DFU_V2_USE_CDC_TRANSPORT
                bool "USB CDC Transport"
                help
                    USB CDC virtual COM port for PC OTA tool.
                    Uses CherryUSB directly (not RT-Thread USB device framework).

            config DFU_V2_USE_BLE_TRANSPORT
                bool "BLE Transport"
                depends on BSP_BLE_SIBLES
                help
                    BLE GATT for phone OTA. Translates legacy BLE DFU protocol.
        endchoice

        if DFU_V2_USE_CDC_TRANSPORT
            config DFU_V2_CDC_RINGBUF_SIZE
                int "CDC ring buffer size (bytes)"
                default 4096
        endif

        comment "--- Pull Transports (Device Mode) ---"

        config DFU_V2_USE_PAN_TRANSPORT
            bool "PAN HTTP Transport"
            default n
            depends on DFU_V2_USE_DEVICE_MODE
            depends on PKG_USING_WEBCLIENT
            help
                HTTP download via Bluetooth PAN network.

        if DFU_V2_USE_PAN_TRANSPORT
            config DFU_V2_PAN_RESP_BUFSZ
                int "HTTP response buffer size (bytes)"
                default 1024

            config DFU_V2_PAN_TIMEOUT_MS
                int "HTTP connection timeout (ms)"
                default 30000
        endif

        comment "--- Mailbox ---"

        config DFU_V2_MB_SIZE
            int "Mailbox capacity (messages)"
            default 32

        comment "WARNING: Device Mode enabled but no Pull Transport!"
            depends on DFU_V2_USE_DEVICE_MODE
            depends on !DFU_V2_USE_PAN_TRANSPORT

    endif
```
