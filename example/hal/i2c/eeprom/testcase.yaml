## example/hal/pwm/testcase.yaml
```yaml
# SPDX-FileCopyrightText: 2026 SiFli Technologies(Nanjing) Co., Ltd
# SPDX-License-Identifier: Apache-2.0
# pwm runs two demos back to back and then spins in an empty loop: a GPTIM channel at 200Hz/20%,
# and an ATIM channel whose frequency and duty cycle are changed three times.
# Negative check: change percentage1 of the third ATIM parameter set from 95 to 50 and the
# PWM_PULSE:950000 expectation fails, so pwm.boot must go red.

tests:
  - id: pwm.boot
    description: GPTIM outputs 200 Hz/20% and ATIM sweeps three frequency/duty sets, each printing the derived period and pulse
    harness: console
    tags: [console, hal, pwm, smoke]
    timeout: 120
    project_dir: project
    platform_allow:
      - sf32lb52-lcd_52d
      - sf32lb52-lcd_a128r16
      - sf32lb52-lcd_n16r8
      - sf32lb52-lcd_n16r8_jdi
      - sf32lb56-lcd_a128r12n1
      - sf32lb56-lcd_n16r12n1
      - sf32lb58-lcd_a128r32n1_a1_dsi
      - sf32lb58-lcd_a128r32n1_dsi
      - sf32lb58-lcd_a128r32n1_qspi
      - sf32lb58-lcd_e4r32n1_dsi
      - sf32lb58-lcd_n16r16n1_qspi
      - sf32lb58-lcd_n16r32n1_a1_dpi
      - sf32lb58-lcd_n16r32n1_a1_dsi
      - sf32lb58-lcd_n16r32n1_dpi
      - sf32lb58-lcd_n16r32n1_dsi
      - sf32lb58-lcd_n16r32n1_qspi
      - sf32lb58-lcd_n16r64n4
      - sf32lb57-lcd_n16r16_dpi
      - sf32lb57-lcd_n16r16_qspi
      - sf32lb57-lcd_n16r8_dpi
      - sf32lb57-epd_n16r16
    integration_platforms: [sf32lb52-lcd_n16r8]
    harness_config:
      record:
        - 'Start gtimer pwm demo!'
        - 'GPT_clock \d+,psc \d+, Period \d+,Pulse \d+'
        - 'gtimer pwm demo end!'
        - 'Start atimer pwm demo!'
        - 'ATIM1_Init'
        - 'frequency:50000,percentage1:50,percentage2:30'
        - 'channel1 atim1 plck freq:\d+,PWM_PERIOD:20000,PWM_PULSE:10000'
        - 'atim1 GPT_clock:\d+,period:\d+,psc:\d+'
        - 'atim1 pulse:\d+'
        - 'channel2 atim1 plck freq:\d+,PWM_PERIOD:20000,PWM_PULSE:6000'
        - 'atim1 GPT_clock:\d+,period:\d+,psc:\d+'
        - 'frequency:10000,percentage1:5,percentage2:90'
        - 'channel1 atim1 plck freq:\d+,PWM_PERIOD:100000,PWM_PULSE:5000'
        - 'atim1 GPT_clock:\d+,period:\d+,psc:\d+'
        - 'atim1 pulse:\d+'
        - 'channel2 atim1 plck freq:\d+,PWM_PERIOD:100000,PWM_PULSE:90000'
        - 'atim1 GPT_clock:\d+,period:\d+,psc:\d+'
        - 'frequency:1000,percentage1:95,percentage2:5'
        - 'channel1 atim1 plck freq:\d+,PWM_PERIOD:1000000,PWM_PULSE:950000'
        - 'atim1 GPT_clock:\d+,period:\d+,psc:\d+'
        - 'atim1 pulse:\d+'
        - 'channel2 atim1 plck freq:\d+,PWM_PERIOD:1000000,PWM_PULSE:50000'
        - 'atim1 GPT_clock:\d+,period:\d+,psc:\d+'
        - 'ATIM1_Stop!'
        - 'atimer pwm demo end!'
```

## example/hal/tsen/testcase.yaml
```yaml
# SPDX-FileCopyrightText: 2026 SiFli Technologies(Nanjing) Co., Ltd
# SPDX-License-Identifier: Apache-2.0
# tsen reads the on-die temperature sensor. testcase() repeats the same sequence forever with a
# 500 ms pause: one blocking read and one interrupt driven read.
# Negative check: make HAL_TSEN_Init return an error and none of the lines below is printed, so
# both cases go red.

tests:
  - id: tsen.boot
    description: the blocking temperature read reports a value and the sensor state sequence starts
    harness: console
    tags: [console, hal, tsen, smoke]
    timeout: 120
    project_dir: project
    platform_allow:
      - sf32lb52-lcd_52d
      - sf32lb52-lcd_a128r16
      - sf32lb52-lcd_n16r8
      - sf32lb52-lcd_n16r8_jdi
      - sf32lb56-lcd_a128r12n1
      - sf32lb56-lcd_n16r12n1
      - sf32lb58-lcd_a128r32n1_a1_dsi
      - sf32lb58-lcd_a128r32n1_dsi
      - sf32lb58-lcd_a128r32n1_qspi
      - sf32lb58-lcd_e4r32n1_dsi
      - sf32lb58-lcd_n16r16n1_qspi
      - sf32lb58-lcd_n16r32n1_a1_dpi
      - sf32lb58-lcd_n16r32n1_a1_dsi
      - sf32lb58-lcd_n16r32n1_dpi
      - sf32lb58-lcd_n16r32n1_dsi
      - sf32lb58-lcd_n16r32n1_qspi
      - sf32lb58-lcd_n16r64n4
      - sf32lb57-lcd_n16r16_dpi
      - sf32lb57-lcd_n16r16_qspi
      - sf32lb57-lcd_n16r8_dpi
      - sf32lb57-epd_n16r16
    integration_platforms:
      - sf32lb52-lcd_a128r16
      - sf32lb57-lcd_n16r16_dpi
    harness_config:
      record:
        - 'Start tsen demo!'
        - 'Sync: Current temperature is -?\d+ degree'
        - 'state1:\d+'

  - id: tsen.async
    description: the interrupt driven temperature read completes and the ISR prints its line
    harness: console
    tags: [console, hal, tsen]
    timeout: 120
    project_dir: project
    platform_allow:
      - sf32lb52-lcd_52d
      - sf32lb52-lcd_a128r16
      - sf32lb52-lcd_n16r8
      - sf32lb52-lcd_n16r8_jdi
      - sf32lb56-lcd_a128r12n1
      - sf32lb56-lcd_n16r12n1
      - sf32lb58-lcd_a128r32n1_a1_dsi
      - sf32lb58-lcd_a128r32n1_dsi
      - sf32lb58-lcd_a128r32n1_qspi
      - sf32lb58-lcd_e4r32n1_dsi
      - sf32lb58-lcd_n16r16n1_qspi
      - sf32lb58-lcd_n16r32n1_a1_dpi
      - sf32lb58-lcd_n16r32n1_a1_dsi
      - sf32lb58-lcd_n16r32n1_dpi
      - sf32lb58-lcd_n16r32n1_dsi
      - sf32lb58-lcd_n16r32n1_qspi
      - sf32lb58-lcd_n16r64n4
    integration_platforms:
      - sf32lb52-lcd_a128r16
    harness_config:
      record:
        - 'Start tsen demo!'
        - regex: 'IRQ Fired'
          ordered: false
        - 'state2:1'
        - 'Async: Current temperature is -?\d+ degree'
```

## example/hal/uart/testcase.yaml
```yaml
# SPDX-FileCopyrightText: 2026 SiFli Technologies(Nanjing) Co., Ltd
# SPDX-License-Identifier: Apache-2.0
# uart exercises UART2 through the HAL, but it prints to UART2, not to the console: _write()
# retargets printf to HAL_UART_Transmit(&UartHandle, ...) and UartHandle.Instance is hwp_usart2.

tests:
  - id: uart.build
    description: the UART2 HAL example compiles for the boards its README lists
    harness: console
    tags: [console, hal, uart, build_only]
    timeout: 900
    project_dir: project
    build_only: true
    platform_allow:
      - sf32lb52-nano_a128r16
      - sf32lb52-nano_n16r16
      - sf32lb52-lcd_52d
      - sf32lb52-lcd_a128r16
      - sf32lb52-lcd_n16r8
      - sf32lb52-lcd_n16r8_jdi
      - sf32lb58-lcd_a128r32n1_a1_dsi
      - sf32lb58-lcd_a128r32n1_dsi
      - sf32lb58-lcd_a128r32n1_qspi
      - sf32lb58-lcd_e4r32n1_dsi
      - sf32lb58-lcd_n16r16n1_qspi
      - sf32lb58-lcd_n16r32n1_a1_dpi
      - sf32lb58-lcd_n16r32n1_a1_dsi
      - sf32lb58-lcd_n16r32n1_dpi
      - sf32lb58-lcd_n16r32n1_dsi
      - sf32lb58-lcd_n16r32n1_qspi
      - sf32lb58-lcd_n16r64n4
      - sf32lb56-lcd_a128r12n1
      - sf32lb56-lcd_n16r12n1
      - sf32lb57-lcd_n16r16_dpi
      - sf32lb57-lcd_n16r16_qspi
      - sf32lb57-lcd_n16r8_dpi
      - sf32lb57-epd_n16r16
    integration_platforms: [sf32lb52-nano_a128r16, sf32lb52-lcd_n16r8, sf32lb56-lcd_n16r12n1, sf32lb58-lcd_n16r64n4, sf32lb57-lcd_n16r16_dpi]
```

## example/rt_device/bt656/project/Kconfig.proj
```kconfig
#APP specific configuration.
config CUSTOM_MEM_MAP
    bool
	select custom_mem_map
	default y

config BT656_DEMO_USING_LVGL
    bool "BT.656 + LVGL preview demo"
    depends on PKG_USING_LITTLEVGL2RTT
    depends on LVGL_V8
    default n
    help
      Build src/bt656_lvgl.c, which shows the camera frame in an LVGL
      image widget (lv_img_set_src) using the YUV422 EPIC path.
      Requires the LVGL package enabled and a CVBS (packed UYVY) input.
```
