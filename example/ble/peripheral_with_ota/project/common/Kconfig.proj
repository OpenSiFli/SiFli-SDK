## example/ble/peripheral_with_ota/project/common/Kconfig.proj
```kconfig
config BF0_HCPU
    bool
    default y
    
config CUSTOM_MEM_MAP
    bool 
	select custom_mem_map
	default y    
    
config EXTRA_LCPU_IMG
    bool "using extra lcpu imag"
	default n

config ENABLE_DFU
    bool "enable dfu and add dfu sub-project"
	default n
    
```

## example/boot_loader/project/ec-lb567xxxx001/board/Kconfig
```kconfig
menu "Hardware Drivers Config"

config SOC_BF0_HCPU
    bool
    select SOC_SERIES_BF0_HCPU
    default y

config CFG_BOOTLOADER
    bool
    default y

menu "Onboard Peripheral Drivers"

endmenu

menu "Board extended module Drivers"

endmenu

endmenu
```

## example/boot_loader/project/ec-ss6700/Kconfig
```kconfig
mainmenu "Sifli Configuration"

config SIFLI_SDK
    string 
    option env="SIFLI_SDK"
    default "."

#SDK configuration	
source "$SIFLI_SDK/Kconfig"

#Application specific configuration
config BF0_HCPU
    bool
    default y
    
config CFG_BOOTLOADER
    bool
    default y 
	
```

## example/boot_loader/project/sf32lb520/ram/Kconfig.proj
```kconfig
config BF0_HCPU
    bool
    default y
    
config CFG_BOOTLOADER
    bool
    default y

config CUSTOM_MEM_MAP
    bool
    default y
    
config LTO_SUPPORT
    bool
    default y    
```

## example/boot_loader/project/sf32lb56x_v2/Kconfig
```kconfig
source "$SIFLI_SDK/Kconfig.v2"
rsource "Kconfig.proj"
config CFG_BOOTLOADER
    bool
    default y
```

## example/boot_loader/project/sf32lb56x_v2/Kconfig.proj
```kconfig
#Application specific configuration
config BF0_HCPU
    bool
    default y
    
config CFG_BOOTLOADER
    bool
    default y

config CUSTOM_MEM_MAP
    bool
    default y
```

## example/bt/a2dp_sharing/project/Kconfig.proj
```kconfig
config BF0_HCPU
    bool
    default y

   
config CUSTOM_MEM_MAP
    bool 
	select custom_mem_map
	default y    
```

## example/bt/pan/simulator/Kconfig
```kconfig
mainmenu "Sifli Configuration"

config SIFLI_SDK
    string 
    option env="SIFLI_SDK"
    default "."
#SDK configuration	
source "$SIFLI_SDK/Kconfig"
```

## example/bt/pan_ota/project/Kconfig.proj
```kconfig
#APP specific configuration.
config BF0_HCPU
    bool
    default y

config CUSTOM_MEM_MAP
    bool 
	select custom_mem_map
	default y    

config ENABLE_DFU
    bool "enable dfu and add dfu sub-project"
	default n
```

## example/dfu_uart/project_hcpu/project/eh-ss6600A8/Kconfig
```kconfig
mainmenu "Sifli Configuration"

config SIFLI_SDK
    string 
    option env="SIFLI_SDK"
    default "."

#SDK configuration	
source "$SIFLI_SDK/Kconfig"

config BF0_HCPU
    bool
    default y
config CUSTOM_MEM_MAP
    bool "custom mem map"
	default y
```

## example/dfu_uart/project_ota/project/eh-ss6600A8/Kconfig
```kconfig
mainmenu "Sifli Configuration"

config SIFLI_SDK
    string 
    option env="SIFLI_SDK"
    default "."

#SDK configuration	
source "$SIFLI_SDK/Kconfig"

#Application specific configuration
config BF0_HCPU
    bool
    default y
    
config CUSTOM_MEM_MAP
    bool 
	select custom_mem_map
	default y
    
config BLE_TEST
	bool
	default y
       
config APP_HAL_EXAMPLE    
	bool
	default y
```

## example/dfu_uart/project_ota/project/eh-ss6600A8/board/Kconfig
```kconfig
menu "Hardware Drivers Config"

config SOC_BF0_HCPU
    bool
    select SOC_SERIES_BF0_HCPU
    default y
config CUSTOM_MEM_MAP
    bool "custom mem map"
	default y

endmenu
```

## example/flash_table/sf32lb58x_common_v2/Kconfig.proj
```kconfig
config BF0_HCPU
    bool
    default y
    

config CUSTOM_MEM_MAP
    bool
    default y

config FLASH_TABLE_ONLY
    bool
    default y
```

## example/gpadc/project/Kconfig
```kconfig
#Kconfig root for APP.
source "$SIFLI_SDK/Kconfig.v2"
rsource "Kconfig.proj"
config USE_AVERAGE_METHOD
    bool "Output the Average"
    default y
    help
        y: Output the average value multiple times, which is more stable(but takes longer to process)
        n: Collect once and output immediately.
```

## example/hal/adc/adc_battery/project/Kconfig.tmp
```kconfig
source "D:/Users/zelongjiang/Desktop/bt2/customer/boards/em-lb52d/hcpu/Kconfig.board"
source "$SIFLI_SDK/customer/boards/Kconfig.v2"
source "$SIFLI_SDK/Kconfig.v2"
rsource "Kconfig.proj"
```

## example/hal/can/can_rx/project/Kconfig.proj
```kconfig
#APP specific configuration.
config CUSTOM_MEM_MAP
    bool 
	select custom_mem_map
	default y if !SOC_SIMULATOR
```

## example/hal_example/project/common/Kconfig.proj
```kconfig
config CUSTOM_MEM_MAP
    bool 
	select custom_mem_map
	default y    
    
config BLE_TEST
	bool
	default y
       
config APP_HAL_EXAMPLE    
	bool
	default y

config RT_HAL_DEBUG
	bool
	default n
	
```

## example/micropython/simulator/Kconfig
```kconfig
mainmenu "Sifli Configuration"

config SIFLI_SDK
    string 
    option env="SIFLI_SDK"
    default "."
#SDK configuration	
source "$SIFLI_SDK/Kconfig"

if RT_USING_DFS
    config RT_USING_DFS_WINSHAREDIR
    bool "Enable shared file system between windows"
    default n
endif
```

## example/mp3online/src/lv_demos/Kconfig
```kconfig
menu "LVGL V8 Demos"   

config LV_USE_DEMO
     bool "Enable LVGL Demos"
     default n

if LV_USE_DEMO

config LV_USE_DEMO_MUSIC
    bool "Music player demo"


if LV_USE_DEMO_MUSIC
    choice 
        prompt "select LCD type"
        default LV_DEMO_MUSIC_SQUARE
        config LV_DEMO_MUSIC_SQUARE
            bool "Square"
        config LV_DEMO_MUSIC_ROUND
            bool "Round"
    endchoice
    config LV_DEMO_MUSIC_LANDSCAPE 
        depends on LV_DEMO_MUSIC_SQUARE
        bool "Landscape UI"
    config LV_DEMO_MUSIC_LARGE 
        bool "Music large fonts"
    config LV_DEMO_MUSIC_AUTO_PLAY 
        bool "Music auto play"
endif
endif

endmenu
```

## example/multicore/data_service/common/lcpu/Kconfig.proj
```kconfig
config BF0_LCPU
    bool
    default y
    
config LCPU_ROM
    bool
    default y
    
```

## example/multicore/ipc_queue/common/lcpu/Kconfig.proj
```kconfig
config BF0_LCPU
    bool
    default y
    
config LCPU_ROM
    bool
    default y
    
config CUSTOM_MEM_MAP
    bool 
    default y
```

## example/multimedia/lvgl/lvgl_v8_demos/src/lv_demos/Kconfig
```kconfig
menu "LVGL V8 Demos"   

config LV_USE_DEMO
     bool "Enable LVGL Demos"
     default n

if LV_USE_DEMO

config LV_USE_DEMO_WIDGETS
    bool "Show some widget"
config LV_USE_DEMO_KEYPAD_AND_ENCODER
    bool "Demonstrate the usage of encoder and keyboard"
config LV_USE_DEMO_BENCHMARK
    bool "Benchmark your system"
config LV_USE_DEMO_STRESS
    bool "Stress test for LVGL"
config LV_USE_DEMO_MUSIC
    bool "Music player demo"


if LV_USE_DEMO_MUSIC
    choice 
        prompt "select LCD type"
        default LV_DEMO_MUSIC_SQUARE
        config LV_DEMO_MUSIC_SQUARE
            bool "Square"
        config LV_DEMO_MUSIC_ROUND
            bool "Round"
    endchoice
    config LV_DEMO_MUSIC_LANDSCAPE 
        depends on LV_DEMO_MUSIC_SQUARE
        bool "Landscape UI"
    config LV_DEMO_MUSIC_LARGE 
        bool "Music large fonts"
    config LV_DEMO_MUSIC_AUTO_PLAY 
        bool "Music auto play"
endif
endif

endmenu
```

## example/multimedia/lvgl/lvgl_v8_examples/project/Kconfig.proj
```kconfig
#APP specific configuration.
config CUSTOM_MEM_MAP
    bool 
	select custom_mem_map
	default y    
    
config LV_BUILD_EXAMPLES
    bool 
    default y
```

## example/multimedia/lvgl/lvgl_v8_examples/simulator/Kconfig
```kconfig
mainmenu "Sifli Configuration"

config SIFLI_SDK
    string 
    option env="SIFLI_SDK"
    default "."

config LV_BUILD_EXAMPLES
    bool 
    default y

#SDK configuration	
source "$SIFLI_SDK/Kconfig"
```
