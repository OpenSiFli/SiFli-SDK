## example/hal/jpegd/project/Kconfig.proj
```kconfig
#APP specific configuration.
config CUSTOM_MEM_MAP
    bool
    select custom_mem_map
    default y

config JPEGD_USING_LCD
    bool "Display decoded image on LCD"
    depends on BSP_USING_LCD
    default n
    help
        Convert the JPEGD planar YUV420 output to RGB565 and display the
        100x100 image in the center of the LCD.
```

## example/multicore/smp/project/Kconfig
```kconfig
# SPDX-License-Identifier: Apache-2.0
source "$SIFLI_SDK/Kconfig.v2"
rsource "Kconfig.proj"
```

## example/multicore/smp/project/Kconfig.proj
```kconfig
# SPDX-License-Identifier: Apache-2.0
config CUSTOM_MEM_MAP
    bool
    select custom_mem_map
    default y

config EXAMPLE_SMP_ROUNDS
    int "SMP example thread creation rounds"
    range 1 10000
    default 32
    help
        Each round creates two threads, checks IPC and heap handoff,
        migrates each thread 32 times, and waits for full reclamation.
```

## example/multimedia/lvgl/lvgl_v8_media/project/Kconfig.proj
```kconfig
#APP specific configuration.
config CUSTOM_MEM_MAP
    bool 
	select custom_mem_map
	default y if !SOC_SIMULATOR

config SOLUTION_ALLOC_MEM
    bool
    default y

menu "app cache Memory configuration"


config IMAGE_CACHE_IN_PSRAM_SIZE
    int "image cache in psram size(standalone)"
    depends on BSP_USING_PSRAM
    default 2100000

config IMAGE_CACHE_IN_PSRAM_SIZE
    int
    depends on !BSP_USING_PSRAM
    default 0

config IMAGE_CACHE_IN_SRAM_SIZE
    int "image cache in sram size(standalone)"
    default 200000


config MESSAGE_CACHE_SIZE
    int "message standalon cache size(bytes)"
    depends on MESSAGE_CACHE_IN_PSRAM || MESSAGE_CACHE_IN_SRAM_STANDALONE
    default 96000 if MESSAGE_CACHE_IN_PSRAM
    default 16000 if MESSAGE_CACHE_IN_SRAM_STANDALONE

endmenu

rsource "../src/Kconfig"
```

## example/multimedia/lvgl/lvsf_v8_examples/src/Kconfig
```kconfig
# Select one SiFli custom widget example to run
menu "LVSF v8 widget examples"

choice
    prompt "Select widget example"
    default LV_WIDGET_DEMO_BASECHART

config LV_WIDGET_DEMO_BASECHART
    bool "basechart - base chart widget"
config LV_WIDGET_DEMO_BASELABEL
    bool "baselabel - base label widget"
config LV_WIDGET_DEMO_FOLLOW
    bool "follow - follow/scroll text widget"
config LV_WIDGET_DEMO_IMGARRAY
    bool "imgarray - image array widget"
config LV_WIDGET_DEMO_IMGBAR
    bool "imgbar - image progress bar widget"
config LV_WIDGET_DEMO_MULROLLER
    bool "mulroller - multi-function roller widget"
config LV_WIDGET_DEMO_MULTANIM
    bool "multanim - multi animation image widget"
config LV_WIDGET_DEMO_MULTLIST
    bool "multlist - multi-function list (gui_app framework)"
config LV_WIDGET_DEMO_MULTROLLER
    bool "multroller - multi roller widget"
config LV_WIDGET_DEMO_MULTSLIDER
    bool "multslider - multi-function slider widget"
config LV_WIDGET_DEMO_SECTOR
    bool "sector - sector/ring widget"
config LV_WIDGET_DEMO_SELECT
    bool "select - select widget"
config LV_WIDGET_DEMO_TIMELINE
    bool "timeline - timeline widget"

endchoice

endmenu
```
